/******************************************************************************
* ASAP2 file: HANcoder_E407_TTA_Group2.a2l
* Academic License - for use in teaching, academic research, and meeting
* course requirements at degree granting institutions only. Not for
* government, commercial, or other organizational use.
* Code generation for model "HANcoder_E407_TTA_Group2".
* Model version : 1.168
* Simulink Coder version : 9.0 (R2018b) 24-May-2018
* C source code generated on : Sun May 22 19:10:39 2022
* Target selection: ert.tlc
* Embedded hardware selection: ARM Compatible->ARM Cortex
* Code generation objectives: Unspecified
* Validation result: Not run
* (add additional file header information here)
******************************************************************************/ ASAP2_VERSION 1 31
/* Version 1.31 */
/begin PROJECT ProjectName "HANcoder_E407_TTA_Group2_softwareID_v1_220522_191017"
/begin HEADER "Header Comments go here" /end HEADER
/begin MODULE ModuleName "Module Comment Goes Here"
/begin MOD_PAR "MOD PAR Comment Goes Here" ADDR_EPK 0x0800c47c CPU_TYPE "STM32F407" ECU "E407" EPK "HANcoder_E407_TTA_Group2_softwareID_v1_220522_191017"
 SYSTEM_CONSTANT "XcpStationID string length" "0x00000034"
 SYSTEM_CONSTANT "RAM-FlashOffset" "-402510752" /end MOD_PAR
/begin MOD_COMMON "Mod Common Comment Here" BYTE_ORDER MSB_LAST /end MOD_COMMON
/begin RECORD_LAYOUT Scalar_BOOLEAN FNC_VALUES 1 UBYTE COLUMN_DIR DIRECT /end RECORD_LAYOUT
/begin RECORD_LAYOUT Scalar_UBYTE FNC_VALUES 1 UBYTE COLUMN_DIR DIRECT /end RECORD_LAYOUT
/begin RECORD_LAYOUT Scalar_BYTE FNC_VALUES 1 SBYTE COLUMN_DIR DIRECT /end RECORD_LAYOUT
/begin RECORD_LAYOUT Scalar_UWORD FNC_VALUES 1 UWORD COLUMN_DIR DIRECT /end RECORD_LAYOUT
/begin RECORD_LAYOUT Scalar_SWORD FNC_VALUES 1 SWORD COLUMN_DIR DIRECT /end RECORD_LAYOUT
/begin RECORD_LAYOUT Scalar_ULONG FNC_VALUES 1 ULONG COLUMN_DIR DIRECT /end RECORD_LAYOUT
/begin RECORD_LAYOUT Scalar_LONG FNC_VALUES 1 SLONG COLUMN_DIR DIRECT /end RECORD_LAYOUT
/begin RECORD_LAYOUT Scalar_FLOAT32_IEEE FNC_VALUES 1 FLOAT32_IEEE COLUMN_DIR DIRECT /end RECORD_LAYOUT
/begin RECORD_LAYOUT Scalar_FLOAT64_IEEE FNC_VALUES 1 FLOAT64_IEEE COLUMN_DIR DIRECT /end RECORD_LAYOUT
/begin RECORD_LAYOUT Lookup1D_BYTE FNC_VALUES 1 SBYTE COLUMN_DIR DIRECT /end RECORD_LAYOUT
/begin RECORD_LAYOUT Lookup1D_X_BYTE AXIS_PTS_X 1 SBYTE INDEX_INCR DIRECT /end RECORD_LAYOUT
/begin RECORD_LAYOUT Lookup1D_UBYTE FNC_VALUES 1 UBYTE COLUMN_DIR DIRECT /end RECORD_LAYOUT
/begin RECORD_LAYOUT Lookup1D_X_UBYTE AXIS_PTS_X 1 UBYTE INDEX_INCR DIRECT /end RECORD_LAYOUT
/begin RECORD_LAYOUT Lookup1D_UWORD FNC_VALUES 1 UWORD COLUMN_DIR DIRECT /end RECORD_LAYOUT
/begin RECORD_LAYOUT Lookup1D_X_UWORD AXIS_PTS_X 1 UWORD INDEX_INCR DIRECT /end RECORD_LAYOUT
/begin RECORD_LAYOUT Lookup1D_WORD FNC_VALUES 1 SWORD COLUMN_DIR DIRECT /end RECORD_LAYOUT
/begin RECORD_LAYOUT Lookup1D_X_WORD AXIS_PTS_X 1 SWORD INDEX_INCR DIRECT /end RECORD_LAYOUT
/begin RECORD_LAYOUT Lookup1D_ULONG FNC_VALUES 1 ULONG COLUMN_DIR DIRECT /end RECORD_LAYOUT
/begin RECORD_LAYOUT Lookup1D_X_ULONG AXIS_PTS_X 1 ULONG INDEX_INCR DIRECT /end RECORD_LAYOUT
/begin RECORD_LAYOUT Lookup1D_SLONG FNC_VALUES 1 SLONG COLUMN_DIR DIRECT /end RECORD_LAYOUT
/begin RECORD_LAYOUT Lookup1D_X_LONG AXIS_PTS_X 1 SLONG INDEX_INCR DIRECT /end RECORD_LAYOUT
/begin RECORD_LAYOUT Lookup1D_FLOAT32_IEEE FNC_VALUES 1 FLOAT32_IEEE COLUMN_DIR DIRECT /end RECORD_LAYOUT
/begin RECORD_LAYOUT Lookup1D_X_FLOAT32_IEEE AXIS_PTS_X 1 FLOAT32_IEEE INDEX_INCR DIRECT /end RECORD_LAYOUT
/begin RECORD_LAYOUT Lookup1D_FLOAT64_IEEE FNC_VALUES 1 FLOAT64_IEEE COLUMN_DIR DIRECT /end RECORD_LAYOUT
/begin RECORD_LAYOUT Lookup1D_X_FLOAT64_IEEE AXIS_PTS_X 1 FLOAT64_IEEE INDEX_INCR DIRECT /end RECORD_LAYOUT
/begin RECORD_LAYOUT Lookup2D_UBYTE FNC_VALUES 1 UBYTE COLUMN_DIR DIRECT /end RECORD_LAYOUT
/begin RECORD_LAYOUT Lookup2D_X_UBYTE AXIS_PTS_X 1 UBYTE INDEX_INCR DIRECT /end RECORD_LAYOUT
/begin RECORD_LAYOUT Lookup2D_BYTE FNC_VALUES 1 SBYTE COLUMN_DIR DIRECT /end RECORD_LAYOUT
/begin RECORD_LAYOUT Lookup2D_X_BYTE AXIS_PTS_X 1 SBYTE INDEX_INCR DIRECT /end RECORD_LAYOUT
/begin RECORD_LAYOUT Lookup2D_UWORD FNC_VALUES 1 UWORD COLUMN_DIR DIRECT /end RECORD_LAYOUT
/begin RECORD_LAYOUT Lookup2D_X_UWORD AXIS_PTS_X 1 UWORD INDEX_INCR DIRECT /end RECORD_LAYOUT
/begin RECORD_LAYOUT Lookup2D_WORD FNC_VALUES 1 SWORD COLUMN_DIR DIRECT /end RECORD_LAYOUT
/begin RECORD_LAYOUT Lookup2D_X_WORD AXIS_PTS_X 1 SWORD INDEX_INCR DIRECT /end RECORD_LAYOUT
/begin RECORD_LAYOUT Lookup2D_ULONG FNC_VALUES 1 ULONG COLUMN_DIR DIRECT /end RECORD_LAYOUT
/begin RECORD_LAYOUT Lookup2D_X_ULONG AXIS_PTS_X 1 ULONG INDEX_INCR DIRECT /end RECORD_LAYOUT
/begin RECORD_LAYOUT Lookup2D_LONG FNC_VALUES 1 SLONG COLUMN_DIR DIRECT /end RECORD_LAYOUT
/begin RECORD_LAYOUT Lookup2D_X_LONG AXIS_PTS_X 1 SLONG INDEX_INCR DIRECT /end RECORD_LAYOUT
/begin RECORD_LAYOUT Lookup2D_FLOAT32_IEEE FNC_VALUES 1 FLOAT32_IEEE COLUMN_DIR DIRECT /end RECORD_LAYOUT
/begin RECORD_LAYOUT Lookup2D_X_FLOAT32_IEEE AXIS_PTS_X 1 FLOAT32_IEEE INDEX_INCR DIRECT /end RECORD_LAYOUT
/begin RECORD_LAYOUT Lookup2D_FLOAT64_IEEE FNC_VALUES 1 FLOAT64_IEEE COLUMN_DIR DIRECT /end RECORD_LAYOUT
/begin RECORD_LAYOUT Lookup2D_X_FLOAT64_IEEE AXIS_PTS_X 1 FLOAT64_IEEE INDEX_INCR DIRECT /end RECORD_LAYOUT
/begin CHARACTERISTIC COMM_Phase1 "" VALUE 0x20000038 Scalar_FLOAT64_IEEE 0 HANcoder_E407_TTA_Group2_CM_double -1.7E+308 1.7E+308 /end CHARACTERISTIC
/begin CHARACTERISTIC COMM_Phase2 "" VALUE 0x20000040 Scalar_FLOAT64_IEEE 0 HANcoder_E407_TTA_Group2_CM_double -1.7E+308 1.7E+308 /end CHARACTERISTIC
/begin CHARACTERISTIC COMM_Phase_init1 "" VALUE 0x20000050 Scalar_FLOAT64_IEEE 0 HANcoder_E407_TTA_Group2_CM_double -1.7E+308 1.7E+308 /end CHARACTERISTIC
/begin CHARACTERISTIC COMM_Phase_init2 "" VALUE 0x20000058 Scalar_FLOAT64_IEEE 0 HANcoder_E407_TTA_Group2_CM_double -1.7E+308 1.7E+308 /end CHARACTERISTIC
/begin CHARACTERISTIC delta_a_set "" VALUE 0x20000060 Scalar_FLOAT64_IEEE 0 HANcoder_E407_TTA_Group2_CM_double -1.7E+308 1.7E+308 /end CHARACTERISTIC
/begin CHARACTERISTIC delta_f_set "" VALUE 0x20000008 Scalar_FLOAT64_IEEE 0 HANcoder_E407_TTA_Group2_CM_double -1.7E+308 1.7E+308 /end CHARACTERISTIC
/begin CHARACTERISTIC script_run "" VALUE 0x20000028 Scalar_FLOAT64_IEEE 0 HANcoder_E407_TTA_Group2_CM_double -1.7E+308 1.7E+308 /end CHARACTERISTIC
/begin CHARACTERISTIC testV_1 "" VALUE 0x20000048 Scalar_FLOAT64_IEEE 0 HANcoder_E407_TTA_Group2_CM_double -1.7E+308 1.7E+308 /end CHARACTERISTIC
/begin CHARACTERISTIC testV_2 "" VALUE 0x20000030 Scalar_FLOAT64_IEEE 0 HANcoder_E407_TTA_Group2_CM_double -1.7E+308 1.7E+308 /end CHARACTERISTIC
/begin CHARACTERISTIC testV_3 "" VALUE 0x20000018 Scalar_FLOAT64_IEEE 0 HANcoder_E407_TTA_Group2_CM_double -1.7E+308 1.7E+308 /end CHARACTERISTIC
/begin CHARACTERISTIC v_set "" VALUE 0x20000020 Scalar_FLOAT64_IEEE 0 HANcoder_E407_TTA_Group2_CM_double -1.7E+308 1.7E+308 /end CHARACTERISTIC
/begin CHARACTERISTIC HANtuneOverride "" VALUE 0x20000010 Scalar_BOOLEAN 0 HANcoder_E407_TTA_Group2_CM_boolean 0 1 /end CHARACTERISTIC
/begin MEASUREMENT simulation_time "" FLOAT64_IEEE HANcoder_E407_TTA_Group2_CM_double 0 0 -1.7E+308 1.7E+308 ECU_ADDRESS 0x2000be40 /end MEASUREMENT
/begin MEASUREMENT script_run_s "" FLOAT64_IEEE HANcoder_E407_TTA_Group2_CM_double 0 0 -1.7E+308 1.7E+308 ECU_ADDRESS 0x2000be00 /end MEASUREMENT
/begin MEASUREMENT Board_ID_s "" FLOAT64_IEEE HANcoder_E407_TTA_Group2_CM_double 0 0 -1.7E+308 1.7E+308 ECU_ADDRESS 0x2000bd78 /end MEASUREMENT
/begin MEASUREMENT SI_FreeHeap "" ULONG HANcoder_E407_TTA_Group2_CM_uint32 0 0 0 4294967295 ECU_ADDRESS 0x2000bdc4 /end MEASUREMENT
/begin MEASUREMENT SI_FreeStack "" ULONG HANcoder_E407_TTA_Group2_CM_uint32 0 0 0 4294967295 ECU_ADDRESS 0x2000be58 /end MEASUREMENT
/begin MEASUREMENT local_ticks_interrupt "" UWORD HANcoder_E407_TTA_Group2_CM_uint16 0 0 0 65535 ECU_ADDRESS 0x2000c102 /end MEASUREMENT
/begin MEASUREMENT SI_CPUload "" UBYTE HANcoder_E407_TTA_Group2_CM_uint8 0 0 0 255 ECU_ADDRESS 0x2000c0d2 /end MEASUREMENT
/begin MEASUREMENT LedValue "" UBYTE HANcoder_E407_TTA_Group2_CM_boolean 0 0 0 1 ECU_ADDRESS 0x2000bdf8 /end MEASUREMENT
/begin MEASUREMENT Master_ID_ing_s "" FLOAT64_IEEE HANcoder_E407_TTA_Group2_CM_double 0 0 -1.7E+308 1.7E+308 ECU_ADDRESS 0x2000be20 /end MEASUREMENT
/begin MEASUREMENT Role_ID_ing_s "" FLOAT64_IEEE HANcoder_E407_TTA_Group2_CM_double 0 0 -1.7E+308 1.7E+308 ECU_ADDRESS 0x2000bda8 /end MEASUREMENT
/begin MEASUREMENT sync_bc1_miss_counter_ing "" FLOAT64_IEEE HANcoder_E407_TTA_Group2_CM_double 0 0 -1.7E+308 1.7E+308 ECU_ADDRESS 0x2000bd80 /end MEASUREMENT
/begin MEASUREMENT sync_bc0_miss_counter_ing "" FLOAT64_IEEE HANcoder_E407_TTA_Group2_CM_double 0 0 -1.7E+308 1.7E+308 ECU_ADDRESS 0x2000bdc8 /end MEASUREMENT
/begin MEASUREMENT msg_count_DEBUG_ing_s "" FLOAT64_IEEE HANcoder_E407_TTA_Group2_CM_double 0 0 -1.7E+308 1.7E+308 ECU_ADDRESS 0x2000bb58 /end MEASUREMENT
/begin MEASUREMENT Desync_Sync_bc1_ing_s "" FLOAT64_IEEE HANcoder_E407_TTA_Group2_CM_double 0 0 -1.7E+308 1.7E+308 ECU_ADDRESS 0x2000bb10 /end MEASUREMENT
/begin MEASUREMENT v_set_s "" FLOAT64_IEEE HANcoder_E407_TTA_Group2_CM_double 0 0 -1.7E+308 1.7E+308 ECU_ADDRESS 0x2000bb30 /end MEASUREMENT
/begin MEASUREMENT Desync_Sync_bc0_ing_s "" FLOAT64_IEEE HANcoder_E407_TTA_Group2_CM_double 0 0 -1.7E+308 1.7E+308 ECU_ADDRESS 0x2000bb20 /end MEASUREMENT
/begin MEASUREMENT Master_ID_s "" FLOAT64_IEEE HANcoder_E407_TTA_Group2_CM_double 0 0 -1.7E+308 1.7E+308 ECU_ADDRESS 0x2000bdf0 /end MEASUREMENT
/begin MEASUREMENT Role_ID_s "" FLOAT64_IEEE HANcoder_E407_TTA_Group2_CM_double 0 0 -1.7E+308 1.7E+308 ECU_ADDRESS 0x2000bb28 /end MEASUREMENT
/begin MEASUREMENT sync_bc0_miss_counter_s "" FLOAT64_IEEE HANcoder_E407_TTA_Group2_CM_double 0 0 -1.7E+308 1.7E+308 ECU_ADDRESS 0x2000c108 /end MEASUREMENT
/begin MEASUREMENT sync_bc1_miss_counter_s "" FLOAT64_IEEE HANcoder_E407_TTA_Group2_CM_double 0 0 -1.7E+308 1.7E+308 ECU_ADDRESS 0x2000bdd8 /end MEASUREMENT
/begin MEASUREMENT votes_Board_1_DEBUG "" FLOAT64_IEEE HANcoder_E407_TTA_Group2_CM_double 0 0 -1.7E+308 1.7E+308 ECU_ADDRESS 0x2000c0f0 /end MEASUREMENT
/begin MEASUREMENT votes_Board_2_DEBUG "" FLOAT64_IEEE HANcoder_E407_TTA_Group2_CM_double 0 0 -1.7E+308 1.7E+308 ECU_ADDRESS 0x2000c0d8 /end MEASUREMENT
/begin MEASUREMENT votes_Board_3_DEBUG "" FLOAT64_IEEE HANcoder_E407_TTA_Group2_CM_double 0 0 -1.7E+308 1.7E+308 ECU_ADDRESS 0x2000bd88 /end MEASUREMENT
/begin MEASUREMENT Board_1_error_counter_s "" FLOAT64_IEEE HANcoder_E407_TTA_Group2_CM_double 0 0 -1.7E+308 1.7E+308 ECU_ADDRESS 0x2000bdb8 /end MEASUREMENT
/begin MEASUREMENT Board_2_error_counter_s "" FLOAT64_IEEE HANcoder_E407_TTA_Group2_CM_double 0 0 -1.7E+308 1.7E+308 ECU_ADDRESS 0x2000bb38 /end MEASUREMENT
/begin MEASUREMENT Board_3_error_counter_s "" FLOAT64_IEEE HANcoder_E407_TTA_Group2_CM_double 0 0 -1.7E+308 1.7E+308 ECU_ADDRESS 0x2000c0c0 /end MEASUREMENT
/begin MEASUREMENT msg_count_DEBUG_s "" FLOAT64_IEEE HANcoder_E407_TTA_Group2_CM_double 0 0 -1.7E+308 1.7E+308 ECU_ADDRESS 0x2000bda0 /end MEASUREMENT
/begin MEASUREMENT Desync_Sync_bc1_s "" FLOAT64_IEEE HANcoder_E407_TTA_Group2_CM_double 0 0 -1.7E+308 1.7E+308 ECU_ADDRESS 0x2000be30 /end MEASUREMENT
/begin MEASUREMENT Desync_Sync_bc0_s "" FLOAT64_IEEE HANcoder_E407_TTA_Group2_CM_double 0 0 -1.7E+308 1.7E+308 ECU_ADDRESS 0x2000bb40 /end MEASUREMENT
/begin MEASUREMENT TM1_timeout_counter_s "" FLOAT64_IEEE HANcoder_E407_TTA_Group2_CM_double 0 0 -1.7E+308 1.7E+308 ECU_ADDRESS 0x2000bd90 /end MEASUREMENT
/begin MEASUREMENT TM2_timeout_counter_s "" FLOAT64_IEEE HANcoder_E407_TTA_Group2_CM_double 0 0 -1.7E+308 1.7E+308 ECU_ADDRESS 0x2000be50 /end MEASUREMENT
/begin MEASUREMENT TM3_timeout_counter_s "" FLOAT64_IEEE HANcoder_E407_TTA_Group2_CM_double 0 0 -1.7E+308 1.7E+308 ECU_ADDRESS 0x2000bde0 /end MEASUREMENT
/begin MEASUREMENT Rx_init_LT "" UWORD HANcoder_E407_TTA_Group2_CM_uint16 0 0 0 65535 ECU_ADDRESS 0x2000be3e /end MEASUREMENT
/begin MEASUREMENT test2_s "" UWORD HANcoder_E407_TTA_Group2_CM_ufix16_En7 0 0 0 511.9921875 ECU_ADDRESS 0x2000bdb0 /end MEASUREMENT
/begin MEASUREMENT test1_s "" UWORD HANcoder_E407_TTA_Group2_CM_ufix16_En7 0 0 0 511.9921875 ECU_ADDRESS 0x2000be28 /end MEASUREMENT
/begin MEASUREMENT test3_s "" UWORD HANcoder_E407_TTA_Group2_CM_ufix16_En7 0 0 0 511.9921875 ECU_ADDRESS 0x2000c0e0 /end MEASUREMENT
/begin MEASUREMENT Vote_s "" UBYTE HANcoder_E407_TTA_Group2_CM_uint8 0 0 0 255 ECU_ADDRESS 0x2000bb18 /end MEASUREMENT
/begin MEASUREMENT Rx_init_id "" UBYTE HANcoder_E407_TTA_Group2_CM_uint8 0 0 0 255 ECU_ADDRESS 0x2000c0c8 /end MEASUREMENT
/begin MEASUREMENT Rx_init_mc "" UBYTE HANcoder_E407_TTA_Group2_CM_uint8 0 0 0 255 ECU_ADDRESS 0x2000c0d1 /end MEASUREMENT
/begin MEASUREMENT Rx_init_bc "" UBYTE HANcoder_E407_TTA_Group2_CM_uint8 0 0 0 255 ECU_ADDRESS 0x2000bdc0 /end MEASUREMENT
/begin MEASUREMENT bacic_cycle_s "" UBYTE HANcoder_E407_TTA_Group2_CM_uint8 0 0 0 255 ECU_ADDRESS 0x2000bdb2 /end MEASUREMENT
/begin MEASUREMENT BC1_sync_processed_ing_s "" UBYTE HANcoder_E407_TTA_Group2_CM_boolean 0 0 0 1 ECU_ADDRESS 0x2000be48 /end MEASUREMENT
/begin MEASUREMENT BC0_sync_processed_ing_s "" UBYTE HANcoder_E407_TTA_Group2_CM_boolean 0 0 0 1 ECU_ADDRESS 0x2000c0c9 /end MEASUREMENT
/begin MEASUREMENT reset_ing_s "" UBYTE HANcoder_E407_TTA_Group2_CM_boolean 0 0 0 1 ECU_ADDRESS 0x2000bdea /end MEASUREMENT
/begin MEASUREMENT BC1_sync_processed_s "" UBYTE HANcoder_E407_TTA_Group2_CM_boolean 0 0 0 1 ECU_ADDRESS 0x2000c0d0 /end MEASUREMENT
/begin MEASUREMENT BC0_sync_processed_s "" UBYTE HANcoder_E407_TTA_Group2_CM_boolean 0 0 0 1 ECU_ADDRESS 0x2000bb19 /end MEASUREMENT
/begin MEASUREMENT BC0_vote1_processed_s "" UBYTE HANcoder_E407_TTA_Group2_CM_boolean 0 0 0 1 ECU_ADDRESS 0x2000be09 /end MEASUREMENT
/begin MEASUREMENT BC0_vote2_processed_s "" UBYTE HANcoder_E407_TTA_Group2_CM_boolean 0 0 0 1 ECU_ADDRESS 0x2000be5c /end MEASUREMENT
/begin MEASUREMENT BC0_vote3_processed_s "" UBYTE HANcoder_E407_TTA_Group2_CM_boolean 0 0 0 1 ECU_ADDRESS 0x2000be18 /end MEASUREMENT
/begin MEASUREMENT new_sensor_rx_s "" UBYTE HANcoder_E407_TTA_Group2_CM_boolean 0 0 0 1 ECU_ADDRESS 0x2000bdc1 /end MEASUREMENT
/begin MEASUREMENT new_set_rx_s "" UBYTE HANcoder_E407_TTA_Group2_CM_boolean 0 0 0 1 ECU_ADDRESS 0x2000bb1a /end MEASUREMENT
/begin MEASUREMENT reset_s "" UBYTE HANcoder_E407_TTA_Group2_CM_boolean 0 0 0 1 ECU_ADDRESS 0x2000be3c /end MEASUREMENT
/begin MEASUREMENT Tx_temporal_msg_CAN2 "" FLOAT64_IEEE HANcoder_E407_TTA_Group2_CM_double 0 0 -1.7E+308 1.7E+308 ECU_ADDRESS 0x2000bd98 /end MEASUREMENT
/begin MEASUREMENT TxCAN2_counter_s "" ULONG HANcoder_E407_TTA_Group2_CM_uint32 0 0 0 4294967295 ECU_ADDRESS 0x2000be38 /end MEASUREMENT
/begin MEASUREMENT TxID_CAN2_s "" ULONG HANcoder_E407_TTA_Group2_CM_uint32 0 0 0 4294967295 ECU_ADDRESS 0x2000bb54 /end MEASUREMENT
/begin MEASUREMENT Rx_temporal_msg_CAN2 "" FLOAT64_IEEE HANcoder_E407_TTA_Group2_CM_double 0 0 -1.7E+308 1.7E+308 ECU_ADDRESS 0x2000c0e8 /end MEASUREMENT
/begin MEASUREMENT RxCAN2_counter_s "" ULONG HANcoder_E407_TTA_Group2_CM_uint32 0 0 0 4294967295 ECU_ADDRESS 0x2000be2c /end MEASUREMENT
/begin MEASUREMENT RxID_CAN2_s "" ULONG HANcoder_E407_TTA_Group2_CM_uint32 0 0 0 4294967295 ECU_ADDRESS 0x2000c0e4 /end MEASUREMENT
/begin MEASUREMENT Rx_msg_ticks_CAN2 "" UWORD HANcoder_E407_TTA_Group2_CM_uint16 0 0 0 65535 ECU_ADDRESS 0x2000c100 /end MEASUREMENT
/begin MEASUREMENT Rx_temporal_msg_CAN1 "" FLOAT64_IEEE HANcoder_E407_TTA_Group2_CM_double 0 0 -1.7E+308 1.7E+308 ECU_ADDRESS 0x2000be10 /end MEASUREMENT
/begin MEASUREMENT RxCAN1_counter_s "" ULONG HANcoder_E407_TTA_Group2_CM_uint32 0 0 0 4294967295 ECU_ADDRESS 0x2000bd70 /end MEASUREMENT
/begin MEASUREMENT RxID_CAN1_s "" ULONG HANcoder_E407_TTA_Group2_CM_uint32 0 0 0 4294967295 ECU_ADDRESS 0x2000bdec /end MEASUREMENT
/begin MEASUREMENT Rx_msg_ticks_CAN1 "" UWORD HANcoder_E407_TTA_Group2_CM_uint16 0 0 0 65535 ECU_ADDRESS 0x2000bde8 /end MEASUREMENT
/begin MEASUREMENT Tx_temporal_msg_CAN1 "" FLOAT64_IEEE HANcoder_E407_TTA_Group2_CM_double 0 0 -1.7E+308 1.7E+308 ECU_ADDRESS 0x2000c0f8 /end MEASUREMENT
/begin MEASUREMENT TxCAN1_counter_s "" ULONG HANcoder_E407_TTA_Group2_CM_uint32 0 0 0 4294967295 ECU_ADDRESS 0x2000c0cc /end MEASUREMENT
/begin MEASUREMENT TxID_CAN1_s "" ULONG HANcoder_E407_TTA_Group2_CM_uint32 0 0 0 4294967295 ECU_ADDRESS 0x2000bdd0 /end MEASUREMENT
/begin COMPU_METHOD HANcoder_E407_TTA_Group2_CM_double "Q = V" RAT_FUNC "%15.10" "" COEFFS 0 1 0 0 0 1 /end COMPU_METHOD
/begin COMPU_METHOD HANcoder_E407_TTA_Group2_CM_boolean "Q = V" RAT_FUNC "%1.0" "" COEFFS 0 1 0 0 0 1 /end COMPU_METHOD
/begin COMPU_METHOD HANcoder_E407_TTA_Group2_CM_uint32 "Q = V" RAT_FUNC "%10.0" "" COEFFS 0 1 0 0 0 1 /end COMPU_METHOD
/begin COMPU_METHOD HANcoder_E407_TTA_Group2_CM_uint16 "Q = V" RAT_FUNC "%5.0" "" COEFFS 0 1 0 0 0 1 /end COMPU_METHOD
/begin COMPU_METHOD HANcoder_E407_TTA_Group2_CM_uint8 "Q = V" RAT_FUNC "%3.0" "" COEFFS 0 1 0 0 0 1 /end COMPU_METHOD
/begin COMPU_METHOD HANcoder_E407_TTA_Group2_CM_ufix16_En7 "Q = V*128.000000" RAT_FUNC "%10.7" "" COEFFS 0 128.000000 0.000000 0 0 1.000000 /end COMPU_METHOD
/begin GROUP HANcoder_E407_TTA_Group2 "HANcoder_E407_TTA_Group2" /* Root */ ROOT /begin SUB_GROUP Root_HANcoder_STM32_Target___E407_STM32_algorithm /end SUB_GROUP /end GROUP
/begin GROUP Root_HANcoder_STM32_Target___E407_STM32_algorithm "HANcoder_E407_TTA_Group2/HANcoder STM32 Target - E407-STM32 algorithm" /begin SUB_GROUP S1_Algorithm S1_System_information S1_TTA_CAN_System /end SUB_GROUP /end GROUP
/begin GROUP S1_Algorithm "HANcoder_E407_TTA_Group2/HANcoder STM32 Target - E407-STM32 algorithm/Algorithm" /begin REF_CHARACTERISTIC HANtuneOverride /end REF_CHARACTERISTIC /begin REF_MEASUREMENT LedValue /end REF_MEASUREMENT /end GROUP
/begin GROUP S1_System_information "HANcoder_E407_TTA_Group2/HANcoder STM32 Target - E407-STM32 algorithm/System information" /begin SUB_GROUP S9_Get_CPU_load S9_Get_free_Heap S9_Get_free_Stack /end SUB_GROUP /end GROUP
/begin GROUP S1_TTA_CAN_System "HANcoder_E407_TTA_Group2/HANcoder STM32 Target - E407-STM32 algorithm/TTA CAN System"
 /begin SUB_GROUP S10_CAN1_Recieve S10_CAN1_Send S10_CAN2_Recieve S10_CAN2_Send S10_If_Action_Subsystem S10_Local_Time_generation S10_TTA_System /end SUB_GROUP
 /begin REF_CHARACTERISTIC script_run /end REF_CHARACTERISTIC
 /begin REF_MEASUREMENT script_run_s simulation_time /end REF_MEASUREMENT
/end GROUP
/begin GROUP S9_Get_CPU_load "HANcoder_E407_TTA_Group2/HANcoder STM32 Target - E407-STM32 algorithm/System information/Get CPU load" /begin REF_MEASUREMENT SI_CPUload /end REF_MEASUREMENT /end GROUP
/begin GROUP S9_Get_free_Heap "HANcoder_E407_TTA_Group2/HANcoder STM32 Target - E407-STM32 algorithm/System information/Get free Heap" /begin REF_MEASUREMENT SI_FreeHeap /end REF_MEASUREMENT /end GROUP
/begin GROUP S9_Get_free_Stack "HANcoder_E407_TTA_Group2/HANcoder STM32 Target - E407-STM32 algorithm/System information/Get free Stack" /begin REF_MEASUREMENT SI_FreeStack /end REF_MEASUREMENT /end GROUP
/begin GROUP S10_CAN1_Recieve "HANcoder_E407_TTA_Group2/HANcoder STM32 Target - E407-STM32 algorithm/TTA CAN System/CAN1 Recieve" /begin SUB_GROUP S26_Update_message_buffers /end SUB_GROUP /begin REF_MEASUREMENT RxCAN1_counter_s RxID_CAN1_s /end REF_MEASUREMENT /end GROUP
/begin GROUP S10_CAN1_Send "HANcoder_E407_TTA_Group2/HANcoder STM32 Target - E407-STM32 algorithm/TTA CAN System/CAN1 Send" /begin REF_MEASUREMENT TxCAN1_counter_s TxID_CAN1_s Tx_temporal_msg_CAN1 /end REF_MEASUREMENT /end GROUP
/begin GROUP S10_CAN2_Recieve "HANcoder_E407_TTA_Group2/HANcoder STM32 Target - E407-STM32 algorithm/TTA CAN System/CAN2 Recieve" /begin SUB_GROUP S28_Update_message_buffers /end SUB_GROUP /begin REF_MEASUREMENT RxCAN2_counter_s RxID_CAN2_s /end REF_MEASUREMENT /end GROUP
/begin GROUP S10_CAN2_Send "HANcoder_E407_TTA_Group2/HANcoder STM32 Target - E407-STM32 algorithm/TTA CAN System/CAN2 Send" /begin REF_MEASUREMENT TxCAN2_counter_s TxID_CAN2_s Tx_temporal_msg_CAN2 /end REF_MEASUREMENT /end GROUP
/begin GROUP S10_If_Action_Subsystem "HANcoder_E407_TTA_Group2/HANcoder STM32 Target - E407-STM32 algorithm/TTA CAN System/If Action Subsystem" /begin REF_MEASUREMENT Board_ID_s /end REF_MEASUREMENT /end GROUP
/begin GROUP S10_Local_Time_generation "HANcoder_E407_TTA_Group2/HANcoder STM32 Target - E407-STM32 algorithm/TTA CAN System/Local Time generation" /begin REF_MEASUREMENT local_ticks_interrupt /end REF_MEASUREMENT /end GROUP
/begin GROUP S10_TTA_System "HANcoder_E407_TTA_Group2/HANcoder STM32 Target - E407-STM32 algorithm/TTA CAN System/TTA System"
 /begin SUB_GROUP S36_Basic_Cycle_Increment S36_Initialization S36_LT_Update_Desync_Positive S36_Matrix_Cycle_Manager /end SUB_GROUP
/end GROUP
/begin GROUP S26_Update_message_buffers "HANcoder_E407_TTA_Group2/HANcoder STM32 Target - E407-STM32 algorithm/TTA CAN System/CAN1 Recieve/Update message buffers" /begin REF_MEASUREMENT Rx_msg_ticks_CAN1 Rx_temporal_msg_CAN1 /end REF_MEASUREMENT /end GROUP
/begin GROUP S28_Update_message_buffers "HANcoder_E407_TTA_Group2/HANcoder STM32 Target - E407-STM32 algorithm/TTA CAN System/CAN2 Recieve/Update message buffers" /begin REF_MEASUREMENT Rx_msg_ticks_CAN2 Rx_temporal_msg_CAN2 /end REF_MEASUREMENT /end GROUP
/begin GROUP S36_Basic_Cycle_Increment "HANcoder_E407_TTA_Group2/HANcoder STM32 Target - E407-STM32 algorithm/TTA CAN System/TTA System/Basic Cycle Increment" /begin REF_MEASUREMENT bacic_cycle_s /end REF_MEASUREMENT /end GROUP
/begin GROUP S36_Initialization "HANcoder_E407_TTA_Group2/HANcoder STM32 Target - E407-STM32 algorithm/TTA CAN System/TTA System/Initialization" /begin SUB_GROUP S126_RoleID_and_Global_Time_init /end SUB_GROUP /end GROUP
/begin GROUP S36_LT_Update_Desync_Positive "HANcoder_E407_TTA_Group2/HANcoder STM32 Target - E407-STM32 algorithm/TTA CAN System/TTA System/LT_Update Desync_Positive" /begin REF_CHARACTERISTIC COMM_Phase1 COMM_Phase2 COMM_Phase_init1 COMM_Phase_init2 /end REF_CHARACTERISTIC /end GROUP
/begin GROUP S36_Matrix_Cycle_Manager "HANcoder_E407_TTA_Group2/HANcoder STM32 Target - E407-STM32 algorithm/TTA CAN System/TTA System/Matrix Cycle Manager"
 /begin SUB_GROUP S132_Controller_Matrix_Cycle S132_Input_Generator_Matrix_Cycle /end SUB_GROUP
/end GROUP
/begin GROUP S126_RoleID_and_Global_Time_init "HANcoder_E407_TTA_Group2/HANcoder STM32 Target - E407-STM32 algorithm/TTA CAN System/TTA System/Initialization/RoleID and Global Time init" /begin SUB_GROUP S139_Global_Time_Initialization_Slave /end SUB_GROUP /end GROUP
/begin GROUP S132_Controller_Matrix_Cycle "HANcoder_E407_TTA_Group2/HANcoder STM32 Target - E407-STM32 algorithm/TTA CAN System/TTA System/Matrix Cycle Manager/Controller Matrix Cycle"
 /begin SUB_GROUP S159_Matrix_Cycle_Observation_DEBUG S159_controller_basic_cycle_0 S159_controller_basic_cycle_1 S159_msg_count_DEBUG_observer /end SUB_GROUP
/end GROUP
/begin GROUP S132_Input_Generator_Matrix_Cycle "HANcoder_E407_TTA_Group2/HANcoder STM32 Target - E407-STM32 algorithm/TTA CAN System/TTA System/Matrix Cycle Manager/Input Generator Matrix Cycle"
 /begin SUB_GROUP S160_Matrix_Cycle_Observation_DEBUG S160_input_generator_basic_cycle_0 S160_input_generator_basic_cycle_1 S160_msg_count_DEBUG_observer /end SUB_GROUP
/end GROUP
/begin GROUP S139_Global_Time_Initialization_Slave "HANcoder_E407_TTA_Group2/HANcoder STM32 Target - E407-STM32 algorithm/TTA CAN System/TTA System/Initialization/RoleID and Global Time init/Global Time Initialization Slave" /begin SUB_GROUP S141_msg_decoding /end SUB_GROUP /begin REF_CHARACTERISTIC COMM_Phase1 COMM_Phase2 /end REF_CHARACTERISTIC /begin REF_MEASUREMENT Rx_init_LT /end REF_MEASUREMENT /end GROUP
/begin GROUP S159_Matrix_Cycle_Observation_DEBUG "HANcoder_E407_TTA_Group2/HANcoder STM32 Target - E407-STM32 algorithm/TTA CAN System/TTA System/Matrix Cycle Manager/Controller Matrix Cycle/Matrix_Cycle_Observation_DEBUG"
 /begin REF_MEASUREMENT BC0_sync_processed_s BC0_vote1_processed_s BC0_vote2_processed_s BC0_vote3_processed_s BC1_sync_processed_s Board_1_error_counter_s Board_2_error_counter_s Board_3_error_counter_s Master_ID_s Role_ID_s sync_bc0_miss_counter_s sync_bc1_miss_counter_s votes_Board_1_DEBUG votes_Board_2_DEBUG votes_Board_3_DEBUG /end REF_MEASUREMENT
/end GROUP
/begin GROUP S159_controller_basic_cycle_0 "HANcoder_E407_TTA_Group2/HANcoder STM32 Target - E407-STM32 algorithm/TTA CAN System/TTA System/Matrix Cycle Manager/Controller Matrix Cycle/controller basic cycle 0"
 /begin SUB_GROUP S162_COMM_Task___Sync_bc_0 S162_COMM_Task___Vote1 S162_COMM_Task___Vote2 S162_COMM_Task___Vote3 S162_COMP_Task___Check_Timeouts S162_COMP_Task___Reset_Board S162_COMP_Task___Sync_bc0_check S162_COMP_Task___Vote_Decision /end SUB_GROUP
/end GROUP
/begin GROUP S159_controller_basic_cycle_1 "HANcoder_E407_TTA_Group2/HANcoder STM32 Target - E407-STM32 algorithm/TTA CAN System/TTA System/Matrix Cycle Manager/Controller Matrix Cycle/controller basic cycle 1"
 /begin SUB_GROUP S163_COMM_Task___Set_Values S163_COMM_Task___Sync_bc_1 S163_COMM_Task___Test S163_COMP_Task___Rx_Set_Values_Check S163_COMP_Task___Sync_bc1_check S163_COMP_Task___Test_Receive /end SUB_GROUP
/end GROUP
/begin GROUP S159_msg_count_DEBUG_observer "HANcoder_E407_TTA_Group2/HANcoder STM32 Target - E407-STM32 algorithm/TTA CAN System/TTA System/Matrix Cycle Manager/Controller Matrix Cycle/msg_count_DEBUG observer" /begin REF_MEASUREMENT msg_count_DEBUG_s /end REF_MEASUREMENT /end GROUP
/begin GROUP S160_Matrix_Cycle_Observation_DEBUG "HANcoder_E407_TTA_Group2/HANcoder STM32 Target - E407-STM32 algorithm/TTA CAN System/TTA System/Matrix Cycle Manager/Input Generator Matrix Cycle/Matrix_Cycle_Observation_DEBUG"
 /begin REF_MEASUREMENT BC0_sync_processed_ing_s BC1_sync_processed_ing_s Master_ID_ing_s Role_ID_ing_s sync_bc0_miss_counter_ing sync_bc1_miss_counter_ing /end REF_MEASUREMENT
/end GROUP
/begin GROUP S160_input_generator_basic_cycle_0 "HANcoder_E407_TTA_Group2/HANcoder STM32 Target - E407-STM32 algorithm/TTA CAN System/TTA System/Matrix Cycle Manager/Input Generator Matrix Cycle/input generator basic cycle 0"
 /begin SUB_GROUP S573_COMM_Task___Sync_bc_0 S573_COMP_Task___Reset_Board S573_COMP_Task___Sync_bc0_check /end SUB_GROUP
/end GROUP
/begin GROUP S160_input_generator_basic_cycle_1 "HANcoder_E407_TTA_Group2/HANcoder STM32 Target - E407-STM32 algorithm/TTA CAN System/TTA System/Matrix Cycle Manager/Input Generator Matrix Cycle/input generator basic cycle 1"
 /begin SUB_GROUP S574_COMM_Task___Set_Values S574_COMM_Task___Sync_bc_1 S574_COMP_Task___Sync_bc1_check /end SUB_GROUP
/end GROUP
/begin GROUP S160_msg_count_DEBUG_observer "HANcoder_E407_TTA_Group2/HANcoder STM32 Target - E407-STM32 algorithm/TTA CAN System/TTA System/Matrix Cycle Manager/Input Generator Matrix Cycle/msg_count_DEBUG observer" /begin REF_MEASUREMENT msg_count_DEBUG_ing_s /end REF_MEASUREMENT /end GROUP
/begin GROUP S141_msg_decoding "HANcoder_E407_TTA_Group2/HANcoder STM32 Target - E407-STM32 algorithm/TTA CAN System/TTA System/Initialization/RoleID and Global Time init/Global Time Initialization Slave/msg_decoding" /begin SUB_GROUP S142_Bit_Shift S142_Bit_Shift1 S142_Bit_Shift2 /end SUB_GROUP /end GROUP
/begin GROUP S162_COMM_Task___Sync_bc_0 "HANcoder_E407_TTA_Group2/HANcoder STM32 Target - E407-STM32 algorithm/TTA CAN System/TTA System/Matrix Cycle Manager/Controller Matrix Cycle/controller basic cycle 0/COMM Task - Sync bc 0" /begin SUB_GROUP S165_Transmission_subtasks /end SUB_GROUP /end GROUP
/begin GROUP S162_COMM_Task___Vote1 "HANcoder_E407_TTA_Group2/HANcoder STM32 Target - E407-STM32 algorithm/TTA CAN System/TTA System/Matrix Cycle Manager/Controller Matrix Cycle/controller basic cycle 0/COMM Task - Vote1" /begin SUB_GROUP S166_Transmission_subtasks /end SUB_GROUP /end GROUP
/begin GROUP S162_COMM_Task___Vote2 "HANcoder_E407_TTA_Group2/HANcoder STM32 Target - E407-STM32 algorithm/TTA CAN System/TTA System/Matrix Cycle Manager/Controller Matrix Cycle/controller basic cycle 0/COMM Task - Vote2" /begin SUB_GROUP S167_Transmission_subtasks /end SUB_GROUP /end GROUP
/begin GROUP S162_COMM_Task___Vote3 "HANcoder_E407_TTA_Group2/HANcoder STM32 Target - E407-STM32 algorithm/TTA CAN System/TTA System/Matrix Cycle Manager/Controller Matrix Cycle/controller basic cycle 0/COMM Task - Vote3" /begin SUB_GROUP S168_Transmission_subtasks /end SUB_GROUP /end GROUP
/begin GROUP S162_COMP_Task___Check_Timeouts "HANcoder_E407_TTA_Group2/HANcoder STM32 Target - E407-STM32 algorithm/TTA CAN System/TTA System/Matrix Cycle Manager/Controller Matrix Cycle/controller basic cycle 0/COMP Task - Check Timeouts" /begin SUB_GROUP S169_Timeout_and_Board_error_counter /end SUB_GROUP /end GROUP
/begin GROUP S162_COMP_Task___Reset_Board "HANcoder_E407_TTA_Group2/HANcoder STM32 Target - E407-STM32 algorithm/TTA CAN System/TTA System/Matrix Cycle Manager/Controller Matrix Cycle/controller basic cycle 0/COMP Task - Reset Board" /begin REF_MEASUREMENT reset_s /end REF_MEASUREMENT /end GROUP
/begin GROUP S162_COMP_Task___Sync_bc0_check "HANcoder_E407_TTA_Group2/HANcoder STM32 Target - E407-STM32 algorithm/TTA CAN System/TTA System/Matrix Cycle Manager/Controller Matrix Cycle/controller basic cycle 0/COMP Task - Sync bc0 check" /begin SUB_GROUP S173_Process_Messages /end SUB_GROUP /end GROUP
/begin GROUP S162_COMP_Task___Vote_Decision "HANcoder_E407_TTA_Group2/HANcoder STM32 Target - E407-STM32 algorithm/TTA CAN System/TTA System/Matrix Cycle Manager/Controller Matrix Cycle/controller basic cycle 0/COMP Task - Vote Decision" /begin SUB_GROUP S175_Vote_Decision /end SUB_GROUP /end GROUP
/begin GROUP S163_COMM_Task___Set_Values "HANcoder_E407_TTA_Group2/HANcoder STM32 Target - E407-STM32 algorithm/TTA CAN System/TTA System/Matrix Cycle Manager/Controller Matrix Cycle/controller basic cycle 1/COMM Task - Set_Values" /begin SUB_GROUP S386_Transmission_subtasks /end SUB_GROUP /end GROUP
/begin GROUP S163_COMM_Task___Sync_bc_1 "HANcoder_E407_TTA_Group2/HANcoder STM32 Target - E407-STM32 algorithm/TTA CAN System/TTA System/Matrix Cycle Manager/Controller Matrix Cycle/controller basic cycle 1/COMM Task - Sync bc 1" /begin SUB_GROUP S387_Transmission_subtasks1 /end SUB_GROUP /end GROUP
/begin GROUP S163_COMM_Task___Test "HANcoder_E407_TTA_Group2/HANcoder STM32 Target - E407-STM32 algorithm/TTA CAN System/TTA System/Matrix Cycle Manager/Controller Matrix Cycle/controller basic cycle 1/COMM Task - Test" /begin SUB_GROUP S388_Transmission_subtasks1 /end SUB_GROUP /end GROUP
/begin GROUP S163_COMP_Task___Rx_Set_Values_Check "HANcoder_E407_TTA_Group2/HANcoder STM32 Target - E407-STM32 algorithm/TTA CAN System/TTA System/Matrix Cycle Manager/Controller Matrix Cycle/controller basic cycle 1/COMP Task - Rx_Set_Values_Check" /begin SUB_GROUP S391_Update_Msg_buffer /end SUB_GROUP /end GROUP
/begin GROUP S163_COMP_Task___Sync_bc1_check "HANcoder_E407_TTA_Group2/HANcoder STM32 Target - E407-STM32 algorithm/TTA CAN System/TTA System/Matrix Cycle Manager/Controller Matrix Cycle/controller basic cycle 1/COMP Task - Sync bc1 check" /begin SUB_GROUP S392_Process_Messages /end SUB_GROUP /end GROUP
/begin GROUP S163_COMP_Task___Test_Receive "HANcoder_E407_TTA_Group2/HANcoder STM32 Target - E407-STM32 algorithm/TTA CAN System/TTA System/Matrix Cycle Manager/Controller Matrix Cycle/controller basic cycle 1/COMP Task - Test Receive" /begin SUB_GROUP S393_Update_Msg_buffer /end SUB_GROUP /end GROUP
/begin GROUP S573_COMM_Task___Sync_bc_0 "HANcoder_E407_TTA_Group2/HANcoder STM32 Target - E407-STM32 algorithm/TTA CAN System/TTA System/Matrix Cycle Manager/Input Generator Matrix Cycle/input generator basic cycle 0/COMM Task - Sync bc 0" /begin SUB_GROUP S576_Transmission_subtasks /end SUB_GROUP /end GROUP
/begin GROUP S573_COMP_Task___Reset_Board "HANcoder_E407_TTA_Group2/HANcoder STM32 Target - E407-STM32 algorithm/TTA CAN System/TTA System/Matrix Cycle Manager/Input Generator Matrix Cycle/input generator basic cycle 0/COMP Task - Reset Board" /begin REF_MEASUREMENT reset_ing_s /end REF_MEASUREMENT /end GROUP
/begin GROUP S573_COMP_Task___Sync_bc0_check "HANcoder_E407_TTA_Group2/HANcoder STM32 Target - E407-STM32 algorithm/TTA CAN System/TTA System/Matrix Cycle Manager/Input Generator Matrix Cycle/input generator basic cycle 0/COMP Task - Sync bc0 check" /begin SUB_GROUP S579_Process_Messages /end SUB_GROUP /end GROUP
/begin GROUP S574_COMM_Task___Set_Values "HANcoder_E407_TTA_Group2/HANcoder STM32 Target - E407-STM32 algorithm/TTA CAN System/TTA System/Matrix Cycle Manager/Input Generator Matrix Cycle/input generator basic cycle 1/COMM Task - Set_Values" /begin SUB_GROUP S635_Transmission_subtasks /end SUB_GROUP /end GROUP
/begin GROUP S574_COMM_Task___Sync_bc_1 "HANcoder_E407_TTA_Group2/HANcoder STM32 Target - E407-STM32 algorithm/TTA CAN System/TTA System/Matrix Cycle Manager/Input Generator Matrix Cycle/input generator basic cycle 1/COMM Task - Sync bc 1" /begin SUB_GROUP S636_Transmission_subtasks /end SUB_GROUP /end GROUP
/begin GROUP S574_COMP_Task___Sync_bc1_check "HANcoder_E407_TTA_Group2/HANcoder STM32 Target - E407-STM32 algorithm/TTA CAN System/TTA System/Matrix Cycle Manager/Input Generator Matrix Cycle/input generator basic cycle 1/COMP Task - Sync bc1 check" /begin SUB_GROUP S640_Process_Messages /end SUB_GROUP /end GROUP
/begin GROUP S142_Bit_Shift "HANcoder_E407_TTA_Group2/HANcoder STM32 Target - E407-STM32 algorithm/TTA CAN System/TTA System/Initialization/RoleID and Global Time init/Global Time Initialization Slave/msg_decoding/Bit Shift" /begin REF_MEASUREMENT Rx_init_bc /end REF_MEASUREMENT /end GROUP
/begin GROUP S142_Bit_Shift1 "HANcoder_E407_TTA_Group2/HANcoder STM32 Target - E407-STM32 algorithm/TTA CAN System/TTA System/Initialization/RoleID and Global Time init/Global Time Initialization Slave/msg_decoding/Bit Shift1" /begin REF_MEASUREMENT Rx_init_mc /end REF_MEASUREMENT /end GROUP
/begin GROUP S142_Bit_Shift2 "HANcoder_E407_TTA_Group2/HANcoder STM32 Target - E407-STM32 algorithm/TTA CAN System/TTA System/Initialization/RoleID and Global Time init/Global Time Initialization Slave/msg_decoding/Bit Shift2" /begin REF_MEASUREMENT Rx_init_id /end REF_MEASUREMENT /end GROUP
/begin GROUP S165_Transmission_subtasks "HANcoder_E407_TTA_Group2/HANcoder STM32 Target - E407-STM32 algorithm/TTA CAN System/TTA System/Matrix Cycle Manager/Controller Matrix Cycle/controller basic cycle 0/COMM Task - Sync bc 0/Transmission subtasks"
 /begin SUB_GROUP S183_Check_msg_transmission_CAN1 S183_Check_msg_transmission_CAN2 /end SUB_GROUP
/end GROUP
/begin GROUP S166_Transmission_subtasks "HANcoder_E407_TTA_Group2/HANcoder STM32 Target - E407-STM32 algorithm/TTA CAN System/TTA System/Matrix Cycle Manager/Controller Matrix Cycle/controller basic cycle 0/COMM Task - Vote1/Transmission subtasks"
 /begin SUB_GROUP S201_Check_msg_transmission_CAN1 S201_Check_msg_transmission_CAN2 /end SUB_GROUP
/end GROUP
/begin GROUP S167_Transmission_subtasks "HANcoder_E407_TTA_Group2/HANcoder STM32 Target - E407-STM32 algorithm/TTA CAN System/TTA System/Matrix Cycle Manager/Controller Matrix Cycle/controller basic cycle 0/COMM Task - Vote2/Transmission subtasks"
 /begin SUB_GROUP S219_Check_msg_transmission_CAN1 S219_Check_msg_transmission_CAN2 /end SUB_GROUP
/end GROUP
/begin GROUP S168_Transmission_subtasks "HANcoder_E407_TTA_Group2/HANcoder STM32 Target - E407-STM32 algorithm/TTA CAN System/TTA System/Matrix Cycle Manager/Controller Matrix Cycle/controller basic cycle 0/COMM Task - Vote3/Transmission subtasks"
 /begin SUB_GROUP S237_Check_msg_transmission_CAN1 S237_Check_msg_transmission_CAN2 /end SUB_GROUP
/end GROUP
/begin GROUP S169_Timeout_and_Board_error_counter "HANcoder_E407_TTA_Group2/HANcoder STM32 Target - E407-STM32 algorithm/TTA CAN System/TTA System/Matrix Cycle Manager/Controller Matrix Cycle/controller basic cycle 0/COMP Task - Check Timeouts/Timeout and Board error counter"
 /begin SUB_GROUP S254_Timeout_Counter_1_DEBUG S254_Timeout_Counter_2_DEBUG S254_Timeout_Counter_3_DEBUG /end SUB_GROUP
/end GROUP
/begin GROUP S173_Process_Messages "HANcoder_E407_TTA_Group2/HANcoder STM32 Target - E407-STM32 algorithm/TTA CAN System/TTA System/Matrix Cycle Manager/Controller Matrix Cycle/controller basic cycle 0/COMP Task - Sync bc0 check/Process_Messages" /begin SUB_GROUP S263_Desync_calculation /end SUB_GROUP /end GROUP
/begin GROUP S175_Vote_Decision "HANcoder_E407_TTA_Group2/HANcoder STM32 Target - E407-STM32 algorithm/TTA CAN System/TTA System/Matrix Cycle Manager/Controller Matrix Cycle/controller basic cycle 0/COMP Task - Vote Decision/Vote Decision" /begin REF_MEASUREMENT Vote_s /end REF_MEASUREMENT /end GROUP
/begin GROUP S386_Transmission_subtasks "HANcoder_E407_TTA_Group2/HANcoder STM32 Target - E407-STM32 algorithm/TTA CAN System/TTA System/Matrix Cycle Manager/Controller Matrix Cycle/controller basic cycle 1/COMM Task - Set_Values/Transmission subtasks"
 /begin SUB_GROUP S397_Check_msg_transmission_CAN1 S397_Check_msg_transmission_CAN2 S397_Msg_Value_Data_Encoded /end SUB_GROUP
/end GROUP
/begin GROUP S387_Transmission_subtasks1 "HANcoder_E407_TTA_Group2/HANcoder STM32 Target - E407-STM32 algorithm/TTA CAN System/TTA System/Matrix Cycle Manager/Controller Matrix Cycle/controller basic cycle 1/COMM Task - Sync bc 1/Transmission subtasks1"
 /begin SUB_GROUP S424_Check_msg_transmission_CAN1 S424_Check_msg_transmission_CAN2 /end SUB_GROUP
/end GROUP
/begin GROUP S388_Transmission_subtasks1 "HANcoder_E407_TTA_Group2/HANcoder STM32 Target - E407-STM32 algorithm/TTA CAN System/TTA System/Matrix Cycle Manager/Controller Matrix Cycle/controller basic cycle 1/COMM Task - Test/Transmission subtasks1"
 /begin SUB_GROUP S442_Check_msg_transmission_CAN1 S442_Check_msg_transmission_CAN2 S442_Msg_Value_Data_Encoded /end SUB_GROUP
/end GROUP
/begin GROUP S391_Update_Msg_buffer "HANcoder_E407_TTA_Group2/HANcoder STM32 Target - E407-STM32 algorithm/TTA CAN System/TTA System/Matrix Cycle Manager/Controller Matrix Cycle/controller basic cycle 1/COMP Task - Rx_Set_Values_Check/Update Msg buffer" /begin REF_MEASUREMENT new_set_rx_s /end REF_MEASUREMENT /end GROUP
/begin GROUP S392_Process_Messages "HANcoder_E407_TTA_Group2/HANcoder STM32 Target - E407-STM32 algorithm/TTA CAN System/TTA System/Matrix Cycle Manager/Controller Matrix Cycle/controller basic cycle 1/COMP Task - Sync bc1 check/Process_Messages" /begin SUB_GROUP S508_Desync_calculation /end SUB_GROUP /end GROUP
/begin GROUP S393_Update_Msg_buffer "HANcoder_E407_TTA_Group2/HANcoder STM32 Target - E407-STM32 algorithm/TTA CAN System/TTA System/Matrix Cycle Manager/Controller Matrix Cycle/controller basic cycle 1/COMP Task - Test Receive/Update Msg buffer" /begin SUB_GROUP S539_Set_Values_Update /end SUB_GROUP /begin REF_MEASUREMENT new_sensor_rx_s /end REF_MEASUREMENT /end GROUP
/begin GROUP S576_Transmission_subtasks "HANcoder_E407_TTA_Group2/HANcoder STM32 Target - E407-STM32 algorithm/TTA CAN System/TTA System/Matrix Cycle Manager/Input Generator Matrix Cycle/input generator basic cycle 0/COMM Task - Sync bc 0/Transmission subtasks"
 /begin SUB_GROUP S582_Check_msg_transmission_CAN1 S582_Check_msg_transmission_CAN2 /end SUB_GROUP
/end GROUP
/begin GROUP S579_Process_Messages "HANcoder_E407_TTA_Group2/HANcoder STM32 Target - E407-STM32 algorithm/TTA CAN System/TTA System/Matrix Cycle Manager/Input Generator Matrix Cycle/input generator basic cycle 0/COMP Task - Sync bc0 check/Process_Messages" /begin SUB_GROUP S602_Desync_calculation /end SUB_GROUP /end GROUP
/begin GROUP S635_Transmission_subtasks "HANcoder_E407_TTA_Group2/HANcoder STM32 Target - E407-STM32 algorithm/TTA CAN System/TTA System/Matrix Cycle Manager/Input Generator Matrix Cycle/input generator basic cycle 1/COMM Task - Set_Values/Transmission subtasks"
 /begin SUB_GROUP S643_Check_msg_transmission_CAN1 S643_Check_msg_transmission_CAN2 S643_Msg_Value_Data_Encoded /end SUB_GROUP
/end GROUP
/begin GROUP S636_Transmission_subtasks "HANcoder_E407_TTA_Group2/HANcoder STM32 Target - E407-STM32 algorithm/TTA CAN System/TTA System/Matrix Cycle Manager/Input Generator Matrix Cycle/input generator basic cycle 1/COMM Task - Sync bc 1/Transmission subtasks"
 /begin SUB_GROUP S670_Check_msg_transmission_CAN1 S670_Check_msg_transmission_CAN2 /end SUB_GROUP
/end GROUP
/begin GROUP S640_Process_Messages "HANcoder_E407_TTA_Group2/HANcoder STM32 Target - E407-STM32 algorithm/TTA CAN System/TTA System/Matrix Cycle Manager/Input Generator Matrix Cycle/input generator basic cycle 1/COMP Task - Sync bc1 check/Process_Messages" /begin SUB_GROUP S691_Desync_calculation /end SUB_GROUP /end GROUP
/begin GROUP S183_Check_msg_transmission_CAN1 "HANcoder_E407_TTA_Group2/HANcoder STM32 Target - E407-STM32 algorithm/TTA CAN System/TTA System/Matrix Cycle Manager/Controller Matrix Cycle/controller basic cycle 0/COMM Task - Sync bc 0/Transmission subtasks/Check msg transmission CAN1" /begin REF_CHARACTERISTIC COMM_Phase1 COMM_Phase_init1 /end REF_CHARACTERISTIC /end GROUP
/begin GROUP S183_Check_msg_transmission_CAN2 "HANcoder_E407_TTA_Group2/HANcoder STM32 Target - E407-STM32 algorithm/TTA CAN System/TTA System/Matrix Cycle Manager/Controller Matrix Cycle/controller basic cycle 0/COMM Task - Sync bc 0/Transmission subtasks/Check msg transmission CAN2" /begin REF_CHARACTERISTIC COMM_Phase2 COMM_Phase_init2 /end REF_CHARACTERISTIC /end GROUP
/begin GROUP S201_Check_msg_transmission_CAN1 "HANcoder_E407_TTA_Group2/HANcoder STM32 Target - E407-STM32 algorithm/TTA CAN System/TTA System/Matrix Cycle Manager/Controller Matrix Cycle/controller basic cycle 0/COMM Task - Vote1/Transmission subtasks/Check msg transmission CAN1" /begin REF_CHARACTERISTIC COMM_Phase1 COMM_Phase_init1 /end REF_CHARACTERISTIC /end GROUP
/begin GROUP S201_Check_msg_transmission_CAN2 "HANcoder_E407_TTA_Group2/HANcoder STM32 Target - E407-STM32 algorithm/TTA CAN System/TTA System/Matrix Cycle Manager/Controller Matrix Cycle/controller basic cycle 0/COMM Task - Vote1/Transmission subtasks/Check msg transmission CAN2" /begin REF_CHARACTERISTIC COMM_Phase2 COMM_Phase_init2 /end REF_CHARACTERISTIC /end GROUP
/begin GROUP S219_Check_msg_transmission_CAN1 "HANcoder_E407_TTA_Group2/HANcoder STM32 Target - E407-STM32 algorithm/TTA CAN System/TTA System/Matrix Cycle Manager/Controller Matrix Cycle/controller basic cycle 0/COMM Task - Vote2/Transmission subtasks/Check msg transmission CAN1" /begin REF_CHARACTERISTIC COMM_Phase1 COMM_Phase_init1 /end REF_CHARACTERISTIC /end GROUP
/begin GROUP S219_Check_msg_transmission_CAN2 "HANcoder_E407_TTA_Group2/HANcoder STM32 Target - E407-STM32 algorithm/TTA CAN System/TTA System/Matrix Cycle Manager/Controller Matrix Cycle/controller basic cycle 0/COMM Task - Vote2/Transmission subtasks/Check msg transmission CAN2" /begin REF_CHARACTERISTIC COMM_Phase2 COMM_Phase_init2 /end REF_CHARACTERISTIC /end GROUP
/begin GROUP S237_Check_msg_transmission_CAN1 "HANcoder_E407_TTA_Group2/HANcoder STM32 Target - E407-STM32 algorithm/TTA CAN System/TTA System/Matrix Cycle Manager/Controller Matrix Cycle/controller basic cycle 0/COMM Task - Vote3/Transmission subtasks/Check msg transmission CAN1" /begin REF_CHARACTERISTIC COMM_Phase1 COMM_Phase_init1 /end REF_CHARACTERISTIC /end GROUP
/begin GROUP S237_Check_msg_transmission_CAN2 "HANcoder_E407_TTA_Group2/HANcoder STM32 Target - E407-STM32 algorithm/TTA CAN System/TTA System/Matrix Cycle Manager/Controller Matrix Cycle/controller basic cycle 0/COMM Task - Vote3/Transmission subtasks/Check msg transmission CAN2" /begin REF_CHARACTERISTIC COMM_Phase2 COMM_Phase_init2 /end REF_CHARACTERISTIC /end GROUP
/begin GROUP S254_Timeout_Counter_1_DEBUG "HANcoder_E407_TTA_Group2/HANcoder STM32 Target - E407-STM32 algorithm/TTA CAN System/TTA System/Matrix Cycle Manager/Controller Matrix Cycle/controller basic cycle 0/COMP Task - Check Timeouts/Timeout and Board error counter/Timeout Counter 1 DEBUG" /begin REF_MEASUREMENT TM1_timeout_counter_s /end REF_MEASUREMENT /end GROUP
/begin GROUP S254_Timeout_Counter_2_DEBUG "HANcoder_E407_TTA_Group2/HANcoder STM32 Target - E407-STM32 algorithm/TTA CAN System/TTA System/Matrix Cycle Manager/Controller Matrix Cycle/controller basic cycle 0/COMP Task - Check Timeouts/Timeout and Board error counter/Timeout Counter 2 DEBUG" /begin REF_MEASUREMENT TM2_timeout_counter_s /end REF_MEASUREMENT /end GROUP
/begin GROUP S254_Timeout_Counter_3_DEBUG "HANcoder_E407_TTA_Group2/HANcoder STM32 Target - E407-STM32 algorithm/TTA CAN System/TTA System/Matrix Cycle Manager/Controller Matrix Cycle/controller basic cycle 0/COMP Task - Check Timeouts/Timeout and Board error counter/Timeout Counter 3 DEBUG" /begin REF_MEASUREMENT TM3_timeout_counter_s /end REF_MEASUREMENT /end GROUP
/begin GROUP S263_Desync_calculation "HANcoder_E407_TTA_Group2/HANcoder STM32 Target - E407-STM32 algorithm/TTA CAN System/TTA System/Matrix Cycle Manager/Controller Matrix Cycle/controller basic cycle 0/COMP Task - Sync bc0 check/Process_Messages/Desync calculation" /begin REF_CHARACTERISTIC COMM_Phase1 COMM_Phase2 /end REF_CHARACTERISTIC /begin REF_MEASUREMENT Desync_Sync_bc0_s /end REF_MEASUREMENT /end GROUP
/begin GROUP S397_Check_msg_transmission_CAN1 "HANcoder_E407_TTA_Group2/HANcoder STM32 Target - E407-STM32 algorithm/TTA CAN System/TTA System/Matrix Cycle Manager/Controller Matrix Cycle/controller basic cycle 1/COMM Task - Set_Values/Transmission subtasks/Check msg transmission CAN1" /begin REF_CHARACTERISTIC COMM_Phase1 COMM_Phase_init1 /end REF_CHARACTERISTIC /end GROUP
/begin GROUP S397_Check_msg_transmission_CAN2 "HANcoder_E407_TTA_Group2/HANcoder STM32 Target - E407-STM32 algorithm/TTA CAN System/TTA System/Matrix Cycle Manager/Controller Matrix Cycle/controller basic cycle 1/COMM Task - Set_Values/Transmission subtasks/Check msg transmission CAN2" /begin REF_CHARACTERISTIC COMM_Phase2 COMM_Phase_init2 /end REF_CHARACTERISTIC /end GROUP
/begin GROUP S397_Msg_Value_Data_Encoded "HANcoder_E407_TTA_Group2/HANcoder STM32 Target - E407-STM32 algorithm/TTA CAN System/TTA System/Matrix Cycle Manager/Controller Matrix Cycle/controller basic cycle 1/COMM Task - Set_Values/Transmission subtasks/Msg_Value_Data_Encoded" /begin REF_CHARACTERISTIC delta_a_set delta_f_set v_set /end REF_CHARACTERISTIC /end GROUP
/begin GROUP S424_Check_msg_transmission_CAN1 "HANcoder_E407_TTA_Group2/HANcoder STM32 Target - E407-STM32 algorithm/TTA CAN System/TTA System/Matrix Cycle Manager/Controller Matrix Cycle/controller basic cycle 1/COMM Task - Sync bc 1/Transmission subtasks1/Check msg transmission CAN1" /begin REF_CHARACTERISTIC COMM_Phase1 COMM_Phase_init1 /end REF_CHARACTERISTIC /end GROUP
/begin GROUP S424_Check_msg_transmission_CAN2 "HANcoder_E407_TTA_Group2/HANcoder STM32 Target - E407-STM32 algorithm/TTA CAN System/TTA System/Matrix Cycle Manager/Controller Matrix Cycle/controller basic cycle 1/COMM Task - Sync bc 1/Transmission subtasks1/Check msg transmission CAN2" /begin REF_CHARACTERISTIC COMM_Phase2 COMM_Phase_init2 /end REF_CHARACTERISTIC /end GROUP
/begin GROUP S442_Check_msg_transmission_CAN1 "HANcoder_E407_TTA_Group2/HANcoder STM32 Target - E407-STM32 algorithm/TTA CAN System/TTA System/Matrix Cycle Manager/Controller Matrix Cycle/controller basic cycle 1/COMM Task - Test/Transmission subtasks1/Check msg transmission CAN1" /begin REF_CHARACTERISTIC COMM_Phase1 COMM_Phase_init1 /end REF_CHARACTERISTIC /end GROUP
/begin GROUP S442_Check_msg_transmission_CAN2 "HANcoder_E407_TTA_Group2/HANcoder STM32 Target - E407-STM32 algorithm/TTA CAN System/TTA System/Matrix Cycle Manager/Controller Matrix Cycle/controller basic cycle 1/COMM Task - Test/Transmission subtasks1/Check msg transmission CAN2" /begin REF_CHARACTERISTIC COMM_Phase2 COMM_Phase_init2 /end REF_CHARACTERISTIC /end GROUP
/begin GROUP S442_Msg_Value_Data_Encoded "HANcoder_E407_TTA_Group2/HANcoder STM32 Target - E407-STM32 algorithm/TTA CAN System/TTA System/Matrix Cycle Manager/Controller Matrix Cycle/controller basic cycle 1/COMM Task - Test/Transmission subtasks1/Msg_Value_Data_Encoded" /begin REF_CHARACTERISTIC testV_1 testV_2 testV_3 /end REF_CHARACTERISTIC /end GROUP
/begin GROUP S508_Desync_calculation "HANcoder_E407_TTA_Group2/HANcoder STM32 Target - E407-STM32 algorithm/TTA CAN System/TTA System/Matrix Cycle Manager/Controller Matrix Cycle/controller basic cycle 1/COMP Task - Sync bc1 check/Process_Messages/Desync calculation" /begin REF_CHARACTERISTIC COMM_Phase1 COMM_Phase2 /end REF_CHARACTERISTIC /begin REF_MEASUREMENT Desync_Sync_bc1_s /end REF_MEASUREMENT /end GROUP
/begin GROUP S539_Set_Values_Update "HANcoder_E407_TTA_Group2/HANcoder STM32 Target - E407-STM32 algorithm/TTA CAN System/TTA System/Matrix Cycle Manager/Controller Matrix Cycle/controller basic cycle 1/COMP Task - Test Receive/Update Msg buffer/Set Values Update" /begin REF_MEASUREMENT test1_s test2_s test3_s /end REF_MEASUREMENT /end GROUP
/begin GROUP S582_Check_msg_transmission_CAN1 "HANcoder_E407_TTA_Group2/HANcoder STM32 Target - E407-STM32 algorithm/TTA CAN System/TTA System/Matrix Cycle Manager/Input Generator Matrix Cycle/input generator basic cycle 0/COMM Task - Sync bc 0/Transmission subtasks/Check msg transmission CAN1" /begin REF_CHARACTERISTIC COMM_Phase1 COMM_Phase_init1 /end REF_CHARACTERISTIC /end GROUP
/begin GROUP S582_Check_msg_transmission_CAN2 "HANcoder_E407_TTA_Group2/HANcoder STM32 Target - E407-STM32 algorithm/TTA CAN System/TTA System/Matrix Cycle Manager/Input Generator Matrix Cycle/input generator basic cycle 0/COMM Task - Sync bc 0/Transmission subtasks/Check msg transmission CAN2" /begin REF_CHARACTERISTIC COMM_Phase2 COMM_Phase_init2 /end REF_CHARACTERISTIC /end GROUP
/begin GROUP S602_Desync_calculation "HANcoder_E407_TTA_Group2/HANcoder STM32 Target - E407-STM32 algorithm/TTA CAN System/TTA System/Matrix Cycle Manager/Input Generator Matrix Cycle/input generator basic cycle 0/COMP Task - Sync bc0 check/Process_Messages/Desync calculation" /begin REF_CHARACTERISTIC COMM_Phase1 COMM_Phase2 /end REF_CHARACTERISTIC /begin REF_MEASUREMENT Desync_Sync_bc0_ing_s /end REF_MEASUREMENT /end GROUP
/begin GROUP S643_Check_msg_transmission_CAN1 "HANcoder_E407_TTA_Group2/HANcoder STM32 Target - E407-STM32 algorithm/TTA CAN System/TTA System/Matrix Cycle Manager/Input Generator Matrix Cycle/input generator basic cycle 1/COMM Task - Set_Values/Transmission subtasks/Check msg transmission CAN1" /begin REF_CHARACTERISTIC COMM_Phase1 COMM_Phase_init1 /end REF_CHARACTERISTIC /end GROUP
/begin GROUP S643_Check_msg_transmission_CAN2 "HANcoder_E407_TTA_Group2/HANcoder STM32 Target - E407-STM32 algorithm/TTA CAN System/TTA System/Matrix Cycle Manager/Input Generator Matrix Cycle/input generator basic cycle 1/COMM Task - Set_Values/Transmission subtasks/Check msg transmission CAN2" /begin REF_CHARACTERISTIC COMM_Phase2 COMM_Phase_init2 /end REF_CHARACTERISTIC /end GROUP
/begin GROUP S643_Msg_Value_Data_Encoded "HANcoder_E407_TTA_Group2/HANcoder STM32 Target - E407-STM32 algorithm/TTA CAN System/TTA System/Matrix Cycle Manager/Input Generator Matrix Cycle/input generator basic cycle 1/COMM Task - Set_Values/Transmission subtasks/Msg_Value_Data_Encoded" /begin REF_CHARACTERISTIC delta_a_set delta_f_set v_set /end REF_CHARACTERISTIC /begin REF_MEASUREMENT v_set_s /end REF_MEASUREMENT /end GROUP
/begin GROUP S670_Check_msg_transmission_CAN1 "HANcoder_E407_TTA_Group2/HANcoder STM32 Target - E407-STM32 algorithm/TTA CAN System/TTA System/Matrix Cycle Manager/Input Generator Matrix Cycle/input generator basic cycle 1/COMM Task - Sync bc 1/Transmission subtasks/Check msg transmission CAN1" /begin REF_CHARACTERISTIC COMM_Phase1 COMM_Phase_init1 /end REF_CHARACTERISTIC /end GROUP
/begin GROUP S670_Check_msg_transmission_CAN2 "HANcoder_E407_TTA_Group2/HANcoder STM32 Target - E407-STM32 algorithm/TTA CAN System/TTA System/Matrix Cycle Manager/Input Generator Matrix Cycle/input generator basic cycle 1/COMM Task - Sync bc 1/Transmission subtasks/Check msg transmission CAN2" /begin REF_CHARACTERISTIC COMM_Phase2 COMM_Phase_init2 /end REF_CHARACTERISTIC /end GROUP
/begin GROUP S691_Desync_calculation "HANcoder_E407_TTA_Group2/HANcoder STM32 Target - E407-STM32 algorithm/TTA CAN System/TTA System/Matrix Cycle Manager/Input Generator Matrix Cycle/input generator basic cycle 1/COMP Task - Sync bc1 check/Process_Messages/Desync calculation" /begin REF_CHARACTERISTIC COMM_Phase1 COMM_Phase2 /end REF_CHARACTERISTIC /begin REF_MEASUREMENT Desync_Sync_bc1_ing_s /end REF_MEASUREMENT /end GROUP
/end MODULE
/end PROJECT
/* (add any file trailer comments here) */
/* EOF HANcoder_E407_TTA_Group2.a2l */
