/******************************************************************************
* ASAP2 file: HANcoder_E407_TTA_Group2.a2l
* Academic License - for use in teaching, academic research, and meeting
* course requirements at degree granting institutions only. Not for
* government, commercial, or other organizational use.
* Code generation for model "HANcoder_E407_TTA_Group2".
* Model version : 1.293
* Simulink Coder version : 9.0 (R2018b) 24-May-2018
* C source code generated on : Wed Jun 15 20:34:01 2022
* Target selection: ert.tlc
* Embedded hardware selection: ARM Compatible->ARM Cortex
* Code generation objectives: Unspecified
* Validation result: Not run
* (add additional file header information here)
******************************************************************************/ ASAP2_VERSION 1 31
/* Version 1.31 */
/begin PROJECT ProjectName "HANcoder_E407_TTA_Group2_softwareID_v1_150622_203303"
/begin HEADER "Header Comments go here" /end HEADER
/begin MODULE ModuleName "Module Comment Goes Here"
/begin MOD_PAR "MOD PAR Comment Goes Here" ADDR_EPK 0x0800caac CPU_TYPE "STM32F407" ECU "E407" EPK "HANcoder_E407_TTA_Group2_softwareID_v1_150622_203303"
 SYSTEM_CONSTANT "XcpStationID string length" "0x00000034"
 SYSTEM_CONSTANT "RAM-FlashOffset" "-402476192" /end MOD_PAR
/begin MOD_COMMON "Mod Common Comment Here" BYTE_ORDER MSB_LAST /end MOD_COMMON
/begin RECORD_LAYOUT Scalar_BOOLEAN FNC_VALUES 1 UBYTE COLUMN_DIR DIRECT /end RECORD_LAYOUT
/begin RECORD_LAYOUT Scalar_UBYTE FNC_VALUES 1 UBYTE COLUMN_DIR DIRECT /end RECORD_LAYOUT
/begin RECORD_LAYOUT Scalar_BYTE FNC_VALUES 1 SBYTE COLUMN_DIR DIRECT /end RECORD_LAYOUT
/begin RECORD_LAYOUT Scalar_UWORD FNC_VALUES 1 UWORD COLUMN_DIR DIRECT /end RECORD_LAYOUT
/begin RECORD_LAYOUT Scalar_SWORD FNC_VALUES 1 SWORD COLUMN_DIR DIRECT /end RECORD_LAYOUT
/begin RECORD_LAYOUT Scalar_ULONG FNC_VALUES 1 ULONG COLUMN_DIR DIRECT /end RECORD_LAYOUT
/begin RECORD_LAYOUT Scalar_LONG FNC_VALUES 1 SLONG COLUMN_DIR DIRECT /end RECORD_LAYOUT
/begin RECORD_LAYOUT Scalar_FLOAT32_IEEE FNC_VALUES 1 FLOAT32_IEEE COLUMN_DIR DIRECT /end RECORD_LAYOUT
/begin RECORD_LAYOUT Scalar_FLOAT64_IEEE FNC_VALUES 1 FLOAT64_IEEE COLUMN_DIR DIRECT /end RECORD_LAYOUT
/begin RECORD_LAYOUT Lookup1D_BYTE FNC_VALUES 1 SBYTE COLUMN_DIR DIRECT /end RECORD_LAYOUT
/begin RECORD_LAYOUT Lookup1D_X_BYTE AXIS_PTS_X 1 SBYTE INDEX_INCR DIRECT /end RECORD_LAYOUT
/begin RECORD_LAYOUT Lookup1D_UBYTE FNC_VALUES 1 UBYTE COLUMN_DIR DIRECT /end RECORD_LAYOUT
/begin RECORD_LAYOUT Lookup1D_X_UBYTE AXIS_PTS_X 1 UBYTE INDEX_INCR DIRECT /end RECORD_LAYOUT
/begin RECORD_LAYOUT Lookup1D_UWORD FNC_VALUES 1 UWORD COLUMN_DIR DIRECT /end RECORD_LAYOUT
/begin RECORD_LAYOUT Lookup1D_X_UWORD AXIS_PTS_X 1 UWORD INDEX_INCR DIRECT /end RECORD_LAYOUT
/begin RECORD_LAYOUT Lookup1D_WORD FNC_VALUES 1 SWORD COLUMN_DIR DIRECT /end RECORD_LAYOUT
/begin RECORD_LAYOUT Lookup1D_X_WORD AXIS_PTS_X 1 SWORD INDEX_INCR DIRECT /end RECORD_LAYOUT
/begin RECORD_LAYOUT Lookup1D_ULONG FNC_VALUES 1 ULONG COLUMN_DIR DIRECT /end RECORD_LAYOUT
/begin RECORD_LAYOUT Lookup1D_X_ULONG AXIS_PTS_X 1 ULONG INDEX_INCR DIRECT /end RECORD_LAYOUT
/begin RECORD_LAYOUT Lookup1D_SLONG FNC_VALUES 1 SLONG COLUMN_DIR DIRECT /end RECORD_LAYOUT
/begin RECORD_LAYOUT Lookup1D_X_LONG AXIS_PTS_X 1 SLONG INDEX_INCR DIRECT /end RECORD_LAYOUT
/begin RECORD_LAYOUT Lookup1D_FLOAT32_IEEE FNC_VALUES 1 FLOAT32_IEEE COLUMN_DIR DIRECT /end RECORD_LAYOUT
/begin RECORD_LAYOUT Lookup1D_X_FLOAT32_IEEE AXIS_PTS_X 1 FLOAT32_IEEE INDEX_INCR DIRECT /end RECORD_LAYOUT
/begin RECORD_LAYOUT Lookup1D_FLOAT64_IEEE FNC_VALUES 1 FLOAT64_IEEE COLUMN_DIR DIRECT /end RECORD_LAYOUT
/begin RECORD_LAYOUT Lookup1D_X_FLOAT64_IEEE AXIS_PTS_X 1 FLOAT64_IEEE INDEX_INCR DIRECT /end RECORD_LAYOUT
/begin RECORD_LAYOUT Lookup2D_UBYTE FNC_VALUES 1 UBYTE COLUMN_DIR DIRECT /end RECORD_LAYOUT
/begin RECORD_LAYOUT Lookup2D_X_UBYTE AXIS_PTS_X 1 UBYTE INDEX_INCR DIRECT /end RECORD_LAYOUT
/begin RECORD_LAYOUT Lookup2D_BYTE FNC_VALUES 1 SBYTE COLUMN_DIR DIRECT /end RECORD_LAYOUT
/begin RECORD_LAYOUT Lookup2D_X_BYTE AXIS_PTS_X 1 SBYTE INDEX_INCR DIRECT /end RECORD_LAYOUT
/begin RECORD_LAYOUT Lookup2D_UWORD FNC_VALUES 1 UWORD COLUMN_DIR DIRECT /end RECORD_LAYOUT
/begin RECORD_LAYOUT Lookup2D_X_UWORD AXIS_PTS_X 1 UWORD INDEX_INCR DIRECT /end RECORD_LAYOUT
/begin RECORD_LAYOUT Lookup2D_WORD FNC_VALUES 1 SWORD COLUMN_DIR DIRECT /end RECORD_LAYOUT
/begin RECORD_LAYOUT Lookup2D_X_WORD AXIS_PTS_X 1 SWORD INDEX_INCR DIRECT /end RECORD_LAYOUT
/begin RECORD_LAYOUT Lookup2D_ULONG FNC_VALUES 1 ULONG COLUMN_DIR DIRECT /end RECORD_LAYOUT
/begin RECORD_LAYOUT Lookup2D_X_ULONG AXIS_PTS_X 1 ULONG INDEX_INCR DIRECT /end RECORD_LAYOUT
/begin RECORD_LAYOUT Lookup2D_LONG FNC_VALUES 1 SLONG COLUMN_DIR DIRECT /end RECORD_LAYOUT
/begin RECORD_LAYOUT Lookup2D_X_LONG AXIS_PTS_X 1 SLONG INDEX_INCR DIRECT /end RECORD_LAYOUT
/begin RECORD_LAYOUT Lookup2D_FLOAT32_IEEE FNC_VALUES 1 FLOAT32_IEEE COLUMN_DIR DIRECT /end RECORD_LAYOUT
/begin RECORD_LAYOUT Lookup2D_X_FLOAT32_IEEE AXIS_PTS_X 1 FLOAT32_IEEE INDEX_INCR DIRECT /end RECORD_LAYOUT
/begin RECORD_LAYOUT Lookup2D_FLOAT64_IEEE FNC_VALUES 1 FLOAT64_IEEE COLUMN_DIR DIRECT /end RECORD_LAYOUT
/begin RECORD_LAYOUT Lookup2D_X_FLOAT64_IEEE AXIS_PTS_X 1 FLOAT64_IEEE INDEX_INCR DIRECT /end RECORD_LAYOUT
/begin CHARACTERISTIC COMM_Phase1 "" VALUE 0x20000078 Scalar_FLOAT64_IEEE 0 HANcoder_E407_TTA_Group2_CM_double -1.7E+308 1.7E+308 /end CHARACTERISTIC
/begin CHARACTERISTIC COMM_Phase2 "" VALUE 0x20000098 Scalar_FLOAT64_IEEE 0 HANcoder_E407_TTA_Group2_CM_double -1.7E+308 1.7E+308 /end CHARACTERISTIC
/begin CHARACTERISTIC COMM_Phase_init1 "" VALUE 0x200000a8 Scalar_FLOAT64_IEEE 0 HANcoder_E407_TTA_Group2_CM_double -1.7E+308 1.7E+308 /end CHARACTERISTIC
/begin CHARACTERISTIC COMM_Phase_init2 "" VALUE 0x200000b0 Scalar_FLOAT64_IEEE 0 HANcoder_E407_TTA_Group2_CM_double -1.7E+308 1.7E+308 /end CHARACTERISTIC
/begin CHARACTERISTIC delta_a_set "" VALUE 0x20000060 Scalar_FLOAT64_IEEE 0 HANcoder_E407_TTA_Group2_CM_double -1.7E+308 1.7E+308 /end CHARACTERISTIC
/begin CHARACTERISTIC delta_f_set "" VALUE 0x20000088 Scalar_FLOAT64_IEEE 0 HANcoder_E407_TTA_Group2_CM_double -1.7E+308 1.7E+308 /end CHARACTERISTIC
/begin CHARACTERISTIC membership_switch "" VALUE 0x20000018 Scalar_FLOAT64_IEEE 0 HANcoder_E407_TTA_Group2_CM_double -1.7E+308 1.7E+308 /end CHARACTERISTIC
/begin CHARACTERISTIC script_run "" VALUE 0x20000090 Scalar_FLOAT64_IEEE 0 HANcoder_E407_TTA_Group2_CM_double -1.7E+308 1.7E+308 /end CHARACTERISTIC
/begin CHARACTERISTIC speed_k_d "" VALUE 0x20000010 Scalar_FLOAT64_IEEE 0 HANcoder_E407_TTA_Group2_CM_double -1.7E+308 1.7E+308 /end CHARACTERISTIC
/begin CHARACTERISTIC speed_k_i "" VALUE 0x20000020 Scalar_FLOAT64_IEEE 0 HANcoder_E407_TTA_Group2_CM_double -1.7E+308 1.7E+308 /end CHARACTERISTIC
/begin CHARACTERISTIC speed_k_p "" VALUE 0x20000028 Scalar_FLOAT64_IEEE 0 HANcoder_E407_TTA_Group2_CM_double -1.7E+308 1.7E+308 /end CHARACTERISTIC
/begin CHARACTERISTIC torque_a_k_d "" VALUE 0x20000038 Scalar_FLOAT64_IEEE 0 HANcoder_E407_TTA_Group2_CM_double -1.7E+308 1.7E+308 /end CHARACTERISTIC
/begin CHARACTERISTIC torque_a_k_i "" VALUE 0x20000048 Scalar_FLOAT64_IEEE 0 HANcoder_E407_TTA_Group2_CM_double -1.7E+308 1.7E+308 /end CHARACTERISTIC
/begin CHARACTERISTIC torque_a_k_p "" VALUE 0x20000058 Scalar_FLOAT64_IEEE 0 HANcoder_E407_TTA_Group2_CM_double -1.7E+308 1.7E+308 /end CHARACTERISTIC
/begin CHARACTERISTIC torque_f_k_d "" VALUE 0x20000068 Scalar_FLOAT64_IEEE 0 HANcoder_E407_TTA_Group2_CM_double -1.7E+308 1.7E+308 /end CHARACTERISTIC
/begin CHARACTERISTIC torque_f_k_i "" VALUE 0x20000070 Scalar_FLOAT64_IEEE 0 HANcoder_E407_TTA_Group2_CM_double -1.7E+308 1.7E+308 /end CHARACTERISTIC
/begin CHARACTERISTIC torque_f_k_p "" VALUE 0x20000080 Scalar_FLOAT64_IEEE 0 HANcoder_E407_TTA_Group2_CM_double -1.7E+308 1.7E+308 /end CHARACTERISTIC
/begin CHARACTERISTIC v_set "" VALUE 0x20000008 Scalar_FLOAT64_IEEE 0 HANcoder_E407_TTA_Group2_CM_double -1.7E+308 1.7E+308 /end CHARACTERISTIC
/begin CHARACTERISTIC HANtuneOverride "" VALUE 0x200000a0 Scalar_BOOLEAN 0 HANcoder_E407_TTA_Group2_CM_boolean 0 1 /end CHARACTERISTIC
/begin CHARACTERISTIC switch_agree_tau_fr_out "" VALUE 0x20000040 Scalar_BOOLEAN 0 HANcoder_E407_TTA_Group2_CM_boolean 0 1 /end CHARACTERISTIC
/begin CHARACTERISTIC switch_agree_tau_fr_out1 "" VALUE 0x20000030 Scalar_BOOLEAN 0 HANcoder_E407_TTA_Group2_CM_boolean 0 1 /end CHARACTERISTIC
/begin CHARACTERISTIC switch_agree_tau_fr_out2 "" VALUE 0x20000032 Scalar_BOOLEAN 0 HANcoder_E407_TTA_Group2_CM_boolean 0 1 /end CHARACTERISTIC
/begin CHARACTERISTIC switch_manipulate_torque "" VALUE 0x20000031 Scalar_BOOLEAN 0 HANcoder_E407_TTA_Group2_CM_boolean 0 1 /end CHARACTERISTIC
/begin CHARACTERISTIC torque_fr_set_manipulated "" VALUE 0x20000050 Scalar_BOOLEAN 0 HANcoder_E407_TTA_Group2_CM_boolean 0 1 /end CHARACTERISTIC
/begin MEASUREMENT simulation_time "" FLOAT64_IEEE HANcoder_E407_TTA_Group2_CM_double 0 0 -1.7E+308 1.7E+308 ECU_ADDRESS 0x2000c2a8 /end MEASUREMENT
/begin MEASUREMENT script_run_s "" FLOAT64_IEEE HANcoder_E407_TTA_Group2_CM_double 0 0 -1.7E+308 1.7E+308 ECU_ADDRESS 0x2000c200 /end MEASUREMENT
/begin MEASUREMENT Board_ID_s "" FLOAT64_IEEE HANcoder_E407_TTA_Group2_CM_double 0 0 -1.7E+308 1.7E+308 ECU_ADDRESS 0x2000c108 /end MEASUREMENT
/begin MEASUREMENT SI_FreeHeap "" ULONG HANcoder_E407_TTA_Group2_CM_uint32 0 0 0 4294967295 ECU_ADDRESS 0x2000c1b8 /end MEASUREMENT
/begin MEASUREMENT SI_FreeStack "" ULONG HANcoder_E407_TTA_Group2_CM_uint32 0 0 0 4294967295 ECU_ADDRESS 0x2000c2e0 /end MEASUREMENT
/begin MEASUREMENT local_ticks_interrupt "" UWORD HANcoder_E407_TTA_Group2_CM_uint16 0 0 0 65535 ECU_ADDRESS 0x2000c7e8 /end MEASUREMENT
/begin MEASUREMENT SI_CPUload "" UBYTE HANcoder_E407_TTA_Group2_CM_uint8 0 0 0 255 ECU_ADDRESS 0x2000c789 /end MEASUREMENT
/begin MEASUREMENT LedValue "" UBYTE HANcoder_E407_TTA_Group2_CM_boolean 0 0 0 1 ECU_ADDRESS 0x2000c1f8 /end MEASUREMENT
/begin MEASUREMENT Master_ID_vem_s "" FLOAT64_IEEE HANcoder_E407_TTA_Group2_CM_double 0 0 -1.7E+308 1.7E+308 ECU_ADDRESS 0x2000c7c0 /end MEASUREMENT
/begin MEASUREMENT Role_ID_vem_s "" FLOAT64_IEEE HANcoder_E407_TTA_Group2_CM_double 0 0 -1.7E+308 1.7E+308 ECU_ADDRESS 0x2000c0f8 /end MEASUREMENT
/begin MEASUREMENT sync_bc1_miss_counter_vem "" FLOAT64_IEEE HANcoder_E407_TTA_Group2_CM_double 0 0 -1.7E+308 1.7E+308 ECU_ADDRESS 0x2000c1a0 /end MEASUREMENT
/begin MEASUREMENT sync_bc0_miss_counter_vem "" FLOAT64_IEEE HANcoder_E407_TTA_Group2_CM_double 0 0 -1.7E+308 1.7E+308 ECU_ADDRESS 0x2000bba8 /end MEASUREMENT
/begin MEASUREMENT outcont_miss_counter_vem "" FLOAT64_IEEE HANcoder_E407_TTA_Group2_CM_double 0 0 -1.7E+308 1.7E+308 ECU_ADDRESS 0x2000c748 /end MEASUREMENT
/begin MEASUREMENT msg_count_DEBUG_vem_s "" FLOAT64_IEEE HANcoder_E407_TTA_Group2_CM_double 0 0 -1.7E+308 1.7E+308 ECU_ADDRESS 0x2000bbe0 /end MEASUREMENT
/begin MEASUREMENT Desync_Sync_bc1_vem_s "" FLOAT64_IEEE HANcoder_E407_TTA_Group2_CM_double 0 0 -1.7E+308 1.7E+308 ECU_ADDRESS 0x2000c7f0 /end MEASUREMENT
/begin MEASUREMENT Desync_Sync_bc0_vem_s "" FLOAT64_IEEE HANcoder_E407_TTA_Group2_CM_double 0 0 -1.7E+308 1.7E+308 ECU_ADDRESS 0x2000bb90 /end MEASUREMENT
/begin MEASUREMENT Master_ID_ing_s "" FLOAT64_IEEE HANcoder_E407_TTA_Group2_CM_double 0 0 -1.7E+308 1.7E+308 ECU_ADDRESS 0x2000c268 /end MEASUREMENT
/begin MEASUREMENT Role_ID_ing_s "" FLOAT64_IEEE HANcoder_E407_TTA_Group2_CM_double 0 0 -1.7E+308 1.7E+308 ECU_ADDRESS 0x2000c178 /end MEASUREMENT
/begin MEASUREMENT sync_bc1_miss_counter_ing "" FLOAT64_IEEE HANcoder_E407_TTA_Group2_CM_double 0 0 -1.7E+308 1.7E+308 ECU_ADDRESS 0x2000c130 /end MEASUREMENT
/begin MEASUREMENT sync_bc0_miss_counter_ing "" FLOAT64_IEEE HANcoder_E407_TTA_Group2_CM_double 0 0 -1.7E+308 1.7E+308 ECU_ADDRESS 0x2000c1c8 /end MEASUREMENT
/begin MEASUREMENT msg_count_DEBUG_ing_s "" FLOAT64_IEEE HANcoder_E407_TTA_Group2_CM_double 0 0 -1.7E+308 1.7E+308 ECU_ADDRESS 0x2000bc28 /end MEASUREMENT
/begin MEASUREMENT Desync_Sync_bc1_ing_s "" FLOAT64_IEEE HANcoder_E407_TTA_Group2_CM_double 0 0 -1.7E+308 1.7E+308 ECU_ADDRESS 0x2000bb80 /end MEASUREMENT
/begin MEASUREMENT Desync_Sync_bc0_ing_s "" FLOAT64_IEEE HANcoder_E407_TTA_Group2_CM_double 0 0 -1.7E+308 1.7E+308 ECU_ADDRESS 0x2000bbc0 /end MEASUREMENT
/begin MEASUREMENT Master_ID_s "" FLOAT64_IEEE HANcoder_E407_TTA_Group2_CM_double 0 0 -1.7E+308 1.7E+308 ECU_ADDRESS 0x2000c1f0 /end MEASUREMENT
/begin MEASUREMENT Role_ID_s "" FLOAT64_IEEE HANcoder_E407_TTA_Group2_CM_double 0 0 -1.7E+308 1.7E+308 ECU_ADDRESS 0x2000bbd0 /end MEASUREMENT
/begin MEASUREMENT sync_bc0_miss_counter_s "" FLOAT64_IEEE HANcoder_E407_TTA_Group2_CM_double 0 0 -1.7E+308 1.7E+308 ECU_ADDRESS 0x2000c7f8 /end MEASUREMENT
/begin MEASUREMENT sync_bc1_miss_counter_s "" FLOAT64_IEEE HANcoder_E407_TTA_Group2_CM_double 0 0 -1.7E+308 1.7E+308 ECU_ADDRESS 0x2000c1d8 /end MEASUREMENT
/begin MEASUREMENT Board_4_error_counter_s "" FLOAT64_IEEE HANcoder_E407_TTA_Group2_CM_double 0 0 -1.7E+308 1.7E+308 ECU_ADDRESS 0x2000c170 /end MEASUREMENT
/begin MEASUREMENT Voter_ID_s "" FLOAT64_IEEE HANcoder_E407_TTA_Group2_CM_double 0 0 -1.7E+308 1.7E+308 ECU_ADDRESS 0x2000c220 /end MEASUREMENT
/begin MEASUREMENT Slave_ID_s "" FLOAT64_IEEE HANcoder_E407_TTA_Group2_CM_double 0 0 -1.7E+308 1.7E+308 ECU_ADDRESS 0x2000c1c0 /end MEASUREMENT
/begin MEASUREMENT BackUP_ID_s "" FLOAT64_IEEE HANcoder_E407_TTA_Group2_CM_double 0 0 -1.7E+308 1.7E+308 ECU_ADDRESS 0x2000c7b0 /end MEASUREMENT
/begin MEASUREMENT votes_Board_1_DEBUG "" FLOAT64_IEEE HANcoder_E407_TTA_Group2_CM_double 0 0 -1.7E+308 1.7E+308 ECU_ADDRESS 0x2000c7c8 /end MEASUREMENT
/begin MEASUREMENT votes_Board_2_DEBUG "" FLOAT64_IEEE HANcoder_E407_TTA_Group2_CM_double 0 0 -1.7E+308 1.7E+308 ECU_ADDRESS 0x2000c798 /end MEASUREMENT
/begin MEASUREMENT votes_Board_3_DEBUG "" FLOAT64_IEEE HANcoder_E407_TTA_Group2_CM_double 0 0 -1.7E+308 1.7E+308 ECU_ADDRESS 0x2000c138 /end MEASUREMENT
/begin MEASUREMENT Board_1_error_counter_s "" FLOAT64_IEEE HANcoder_E407_TTA_Group2_CM_double 0 0 -1.7E+308 1.7E+308 ECU_ADDRESS 0x2000c188 /end MEASUREMENT
/begin MEASUREMENT Board_2_error_counter_s "" FLOAT64_IEEE HANcoder_E407_TTA_Group2_CM_double 0 0 -1.7E+308 1.7E+308 ECU_ADDRESS 0x2000bbf8 /end MEASUREMENT
/begin MEASUREMENT Board_3_error_counter_s "" FLOAT64_IEEE HANcoder_E407_TTA_Group2_CM_double 0 0 -1.7E+308 1.7E+308 ECU_ADDRESS 0x2000c740 /end MEASUREMENT
/begin MEASUREMENT msg_count_DEBUG_s "" FLOAT64_IEEE HANcoder_E407_TTA_Group2_CM_double 0 0 -1.7E+308 1.7E+308 ECU_ADDRESS 0x2000c160 /end MEASUREMENT
/begin MEASUREMENT torque_fr_set_out_s "" FLOAT64_IEEE HANcoder_E407_TTA_Group2_CM_double 0 0 -1.7E+308 1.7E+308 ECU_ADDRESS 0x2000c2c0 /end MEASUREMENT
/begin MEASUREMENT torque_fl_set_out_s "" FLOAT64_IEEE HANcoder_E407_TTA_Group2_CM_double 0 0 -1.7E+308 1.7E+308 ECU_ADDRESS 0x2000c790 /end MEASUREMENT
/begin MEASUREMENT torque_ar_set_out_s "" FLOAT64_IEEE HANcoder_E407_TTA_Group2_CM_double 0 0 -1.7E+308 1.7E+308 ECU_ADDRESS 0x2000c228 /end MEASUREMENT
/begin MEASUREMENT torque_al_set_out_s "" FLOAT64_IEEE HANcoder_E407_TTA_Group2_CM_double 0 0 -1.7E+308 1.7E+308 ECU_ADDRESS 0x2000c148 /end MEASUREMENT
/begin MEASUREMENT torque_fr_out2_s "" FLOAT64_IEEE HANcoder_E407_TTA_Group2_CM_double 0 0 -1.7E+308 1.7E+308 ECU_ADDRESS 0x2000c7e0 /end MEASUREMENT
/begin MEASUREMENT torque_fl_out2_s "" FLOAT64_IEEE HANcoder_E407_TTA_Group2_CM_double 0 0 -1.7E+308 1.7E+308 ECU_ADDRESS 0x2000bbb0 /end MEASUREMENT
/begin MEASUREMENT torque_ar_out2_s "" FLOAT64_IEEE HANcoder_E407_TTA_Group2_CM_double 0 0 -1.7E+308 1.7E+308 ECU_ADDRESS 0x2000bbf0 /end MEASUREMENT
/begin MEASUREMENT torque_al_out2_s "" FLOAT64_IEEE HANcoder_E407_TTA_Group2_CM_double 0 0 -1.7E+308 1.7E+308 ECU_ADDRESS 0x2000c260 /end MEASUREMENT
/begin MEASUREMENT torque_fr_out1_s "" FLOAT64_IEEE HANcoder_E407_TTA_Group2_CM_double 0 0 -1.7E+308 1.7E+308 ECU_ADDRESS 0x2000c198 /end MEASUREMENT
/begin MEASUREMENT torque_fl_out1_s "" FLOAT64_IEEE HANcoder_E407_TTA_Group2_CM_double 0 0 -1.7E+308 1.7E+308 ECU_ADDRESS 0x2000c208 /end MEASUREMENT
/begin MEASUREMENT torque_ar_out1_s "" FLOAT64_IEEE HANcoder_E407_TTA_Group2_CM_double 0 0 -1.7E+308 1.7E+308 ECU_ADDRESS 0x2000c168 /end MEASUREMENT
/begin MEASUREMENT torque_al_out1_s "" FLOAT64_IEEE HANcoder_E407_TTA_Group2_CM_double 0 0 -1.7E+308 1.7E+308 ECU_ADDRESS 0x2000c2a0 /end MEASUREMENT
/begin MEASUREMENT Desync_Sync_bc1_s "" FLOAT64_IEEE HANcoder_E407_TTA_Group2_CM_double 0 0 -1.7E+308 1.7E+308 ECU_ADDRESS 0x2000c278 /end MEASUREMENT
/begin MEASUREMENT mc_counter_s "" FLOAT64_IEEE HANcoder_E407_TTA_Group2_CM_double 0 0 -1.7E+308 1.7E+308 ECU_ADDRESS 0x2000bbb8 /end MEASUREMENT
/begin MEASUREMENT rx_data_incr_time_s "" FLOAT64_IEEE HANcoder_E407_TTA_Group2_CM_double 0 0 -1.7E+308 1.7E+308 ECU_ADDRESS 0x2000c118 /end MEASUREMENT
/begin MEASUREMENT theta_fr_stored_s "" FLOAT64_IEEE HANcoder_E407_TTA_Group2_CM_double 0 0 -1.7E+308 1.7E+308 ECU_ADDRESS 0x2000c770 /end MEASUREMENT
/begin MEASUREMENT theta_fl_stored_s "" FLOAT64_IEEE HANcoder_E407_TTA_Group2_CM_double 0 0 -1.7E+308 1.7E+308 ECU_ADDRESS 0x2000c150 /end MEASUREMENT
/begin MEASUREMENT theta_ar_stored_s "" FLOAT64_IEEE HANcoder_E407_TTA_Group2_CM_double 0 0 -1.7E+308 1.7E+308 ECU_ADDRESS 0x2000c758 /end MEASUREMENT
/begin MEASUREMENT theta_al_stored_s "" FLOAT64_IEEE HANcoder_E407_TTA_Group2_CM_double 0 0 -1.7E+308 1.7E+308 ECU_ADDRESS 0x2000c238 /end MEASUREMENT
/begin MEASUREMENT v_est_s "" FLOAT64_IEEE HANcoder_E407_TTA_Group2_CM_double 0 0 -1.7E+308 1.7E+308 ECU_ADDRESS 0x2000c290 /end MEASUREMENT
/begin MEASUREMENT v_integral_s "" FLOAT64_IEEE HANcoder_E407_TTA_Group2_CM_double 0 0 -1.7E+308 1.7E+308 ECU_ADDRESS 0x2000bb98 /end MEASUREMENT
/begin MEASUREMENT v_ctreff_s "" FLOAT64_IEEE HANcoder_E407_TTA_Group2_CM_double 0 0 -1.7E+308 1.7E+308 ECU_ADDRESS 0x2000c2d8 /end MEASUREMENT
/begin MEASUREMENT torque_fr_set_s "" FLOAT64_IEEE HANcoder_E407_TTA_Group2_CM_double 0 0 -1.7E+308 1.7E+308 ECU_ADDRESS 0x2000c2b0 /end MEASUREMENT
/begin MEASUREMENT torque_fl_set_s "" FLOAT64_IEEE HANcoder_E407_TTA_Group2_CM_double 0 0 -1.7E+308 1.7E+308 ECU_ADDRESS 0x2000c120 /end MEASUREMENT
/begin MEASUREMENT torque_ar_set_s "" FLOAT64_IEEE HANcoder_E407_TTA_Group2_CM_double 0 0 -1.7E+308 1.7E+308 ECU_ADDRESS 0x2000c240 /end MEASUREMENT
/begin MEASUREMENT torque_al_set_s "" FLOAT64_IEEE HANcoder_E407_TTA_Group2_CM_double 0 0 -1.7E+308 1.7E+308 ECU_ADDRESS 0x2000c780 /end MEASUREMENT
/begin MEASUREMENT Desync_Sync_bc0_s "" FLOAT64_IEEE HANcoder_E407_TTA_Group2_CM_double 0 0 -1.7E+308 1.7E+308 ECU_ADDRESS 0x2000bc00 /end MEASUREMENT
/begin MEASUREMENT decision_voter_s "" FLOAT64_IEEE HANcoder_E407_TTA_Group2_CM_double 0 0 -1.7E+308 1.7E+308 ECU_ADDRESS 0x2000c210 /end MEASUREMENT
/begin MEASUREMENT Vote1_s "" FLOAT64_IEEE HANcoder_E407_TTA_Group2_CM_double 0 0 -1.7E+308 1.7E+308 ECU_ADDRESS 0x2000c760 /end MEASUREMENT
/begin MEASUREMENT Vote2_s "" FLOAT64_IEEE HANcoder_E407_TTA_Group2_CM_double 0 0 -1.7E+308 1.7E+308 ECU_ADDRESS 0x2000c738 /end MEASUREMENT
/begin MEASUREMENT Vote3_s "" FLOAT64_IEEE HANcoder_E407_TTA_Group2_CM_double 0 0 -1.7E+308 1.7E+308 ECU_ADDRESS 0x2000c7b8 /end MEASUREMENT
/begin MEASUREMENT Vote4_s "" FLOAT64_IEEE HANcoder_E407_TTA_Group2_CM_double 0 0 -1.7E+308 1.7E+308 ECU_ADDRESS 0x2000bc20 /end MEASUREMENT
/begin MEASUREMENT TM1_timeout_counter_s "" FLOAT64_IEEE HANcoder_E407_TTA_Group2_CM_double 0 0 -1.7E+308 1.7E+308 ECU_ADDRESS 0x2000c140 /end MEASUREMENT
/begin MEASUREMENT TM2_timeout_counter_s "" FLOAT64_IEEE HANcoder_E407_TTA_Group2_CM_double 0 0 -1.7E+308 1.7E+308 ECU_ADDRESS 0x2000c2c8 /end MEASUREMENT
/begin MEASUREMENT TM3_timeout_counter_s "" FLOAT64_IEEE HANcoder_E407_TTA_Group2_CM_double 0 0 -1.7E+308 1.7E+308 ECU_ADDRESS 0x2000c1e0 /end MEASUREMENT
/begin MEASUREMENT TM4_timeout_counter_s "" FLOAT64_IEEE HANcoder_E407_TTA_Group2_CM_double 0 0 -1.7E+308 1.7E+308 ECU_ADDRESS 0x2000c1b0 /end MEASUREMENT
/begin MEASUREMENT Rx_init_LT "" UWORD HANcoder_E407_TTA_Group2_CM_uint16 0 0 0 65535 ECU_ADDRESS 0x2000c286 /end MEASUREMENT
/begin MEASUREMENT error_log1_s "" UBYTE HANcoder_E407_TTA_Group2_CM_uint8 0 0 0 255 ECU_ADDRESS 0x2000c750 /end MEASUREMENT
/begin MEASUREMENT error_log2_s "" UBYTE HANcoder_E407_TTA_Group2_CM_uint8 0 0 0 255 ECU_ADDRESS 0x2000c298 /end MEASUREMENT
/begin MEASUREMENT error_log3_s "" UBYTE HANcoder_E407_TTA_Group2_CM_uint8 0 0 0 255 ECU_ADDRESS 0x2000c2e5 /end MEASUREMENT
/begin MEASUREMENT Vote_s "" UBYTE HANcoder_E407_TTA_Group2_CM_uint8 0 0 0 255 ECU_ADDRESS 0x2000bb88 /end MEASUREMENT
/begin MEASUREMENT Error2_s "" UBYTE HANcoder_E407_TTA_Group2_CM_uint8 0 0 0 255 ECU_ADDRESS 0x2000c0f0 /end MEASUREMENT
/begin MEASUREMENT Error1_s "" UBYTE HANcoder_E407_TTA_Group2_CM_uint8 0 0 0 255 ECU_ADDRESS 0x2000c0f2 /end MEASUREMENT
/begin MEASUREMENT Error3_s "" UBYTE HANcoder_E407_TTA_Group2_CM_uint8 0 0 0 255 ECU_ADDRESS 0x2000bc14 /end MEASUREMENT
/begin MEASUREMENT tau_al2_disagree_s "" UBYTE HANcoder_E407_TTA_Group2_CM_uint8 0 0 0 255 ECU_ADDRESS 0x2000bbd8 /end MEASUREMENT
/begin MEASUREMENT tau_ar2_disagree_s "" UBYTE HANcoder_E407_TTA_Group2_CM_uint8 0 0 0 255 ECU_ADDRESS 0x2000bbe8 /end MEASUREMENT
/begin MEASUREMENT tau_fl2_disagree_s "" UBYTE HANcoder_E407_TTA_Group2_CM_uint8 0 0 0 255 ECU_ADDRESS 0x2000bb89 /end MEASUREMENT
/begin MEASUREMENT tau_fr2_disagree_s "" UBYTE HANcoder_E407_TTA_Group2_CM_uint8 0 0 0 255 ECU_ADDRESS 0x2000bbc9 /end MEASUREMENT
/begin MEASUREMENT TMR_miss2_sensor "" UBYTE HANcoder_E407_TTA_Group2_CM_uint8 0 0 0 255 ECU_ADDRESS 0x2000c299 /end MEASUREMENT
/begin MEASUREMENT TMR_miss2_set "" UBYTE HANcoder_E407_TTA_Group2_CM_uint8 0 0 0 255 ECU_ADDRESS 0x2000c128 /end MEASUREMENT
/begin MEASUREMENT TMR_miss_out2 "" UBYTE HANcoder_E407_TTA_Group2_CM_uint8 0 0 0 255 ECU_ADDRESS 0x2000c288 /end MEASUREMENT
/begin MEASUREMENT tau_al1_disagree_s "" UBYTE HANcoder_E407_TTA_Group2_CM_uint8 0 0 0 255 ECU_ADDRESS 0x2000bbc8 /end MEASUREMENT
/begin MEASUREMENT tau_ar1_disagree_s "" UBYTE HANcoder_E407_TTA_Group2_CM_uint8 0 0 0 255 ECU_ADDRESS 0x2000c289 /end MEASUREMENT
/begin MEASUREMENT tau_fl1_disagree_s "" UBYTE HANcoder_E407_TTA_Group2_CM_uint8 0 0 0 255 ECU_ADDRESS 0x2000bb8b /end MEASUREMENT
/begin MEASUREMENT tau_fr1_disagree_s "" UBYTE HANcoder_E407_TTA_Group2_CM_uint8 0 0 0 255 ECU_ADDRESS 0x2000c2e6 /end MEASUREMENT
/begin MEASUREMENT TMR_miss1_sensor "" UBYTE HANcoder_E407_TTA_Group2_CM_uint8 0 0 0 255 ECU_ADDRESS 0x2000c259 /end MEASUREMENT
/begin MEASUREMENT TMR_miss1_set "" UBYTE HANcoder_E407_TTA_Group2_CM_uint8 0 0 0 255 ECU_ADDRESS 0x2000c7a0 /end MEASUREMENT
/begin MEASUREMENT TMR_miss_out1 "" UBYTE HANcoder_E407_TTA_Group2_CM_uint8 0 0 0 255 ECU_ADDRESS 0x2000c230 /end MEASUREMENT
/begin MEASUREMENT tau_al_disagree_s "" UBYTE HANcoder_E407_TTA_Group2_CM_uint8 0 0 0 255 ECU_ADDRESS 0x2000c180 /end MEASUREMENT
/begin MEASUREMENT tau_ar_disagree_s "" UBYTE HANcoder_E407_TTA_Group2_CM_uint8 0 0 0 255 ECU_ADDRESS 0x2000c181 /end MEASUREMENT
/begin MEASUREMENT tau_fl_disagree_s "" UBYTE HANcoder_E407_TTA_Group2_CM_uint8 0 0 0 255 ECU_ADDRESS 0x2000bbd9 /end MEASUREMENT
/begin MEASUREMENT tau_fr_disagree_s "" UBYTE HANcoder_E407_TTA_Group2_CM_uint8 0 0 0 255 ECU_ADDRESS 0x2000c7a2 /end MEASUREMENT
/begin MEASUREMENT TMR_miss_sensor "" UBYTE HANcoder_E407_TTA_Group2_CM_uint8 0 0 0 255 ECU_ADDRESS 0x2000c1a8 /end MEASUREMENT
/begin MEASUREMENT TMR_miss_set "" UBYTE HANcoder_E407_TTA_Group2_CM_uint8 0 0 0 255 ECU_ADDRESS 0x2000c104 /end MEASUREMENT
/begin MEASUREMENT Rx_init_id "" UBYTE HANcoder_E407_TTA_Group2_CM_uint8 0 0 0 255 ECU_ADDRESS 0x2000c768 /end MEASUREMENT
/begin MEASUREMENT Rx_init_mc "" UBYTE HANcoder_E407_TTA_Group2_CM_uint8 0 0 0 255 ECU_ADDRESS 0x2000c788 /end MEASUREMENT
/begin MEASUREMENT Rx_init_bc "" UBYTE HANcoder_E407_TTA_Group2_CM_uint8 0 0 0 255 ECU_ADDRESS 0x2000c190 /end MEASUREMENT
/begin MEASUREMENT bacic_cycle_s "" UBYTE HANcoder_E407_TTA_Group2_CM_uint8 0 0 0 255 ECU_ADDRESS 0x2000c182 /end MEASUREMENT
/begin MEASUREMENT BC1_sync_processed_vem__s "" UBYTE HANcoder_E407_TTA_Group2_CM_boolean 0 0 0 1 ECU_ADDRESS 0x2000bba2 /end MEASUREMENT
/begin MEASUREMENT BC0_sync_processed_vem__s "" UBYTE HANcoder_E407_TTA_Group2_CM_boolean 0 0 0 1 ECU_ADDRESS 0x2000c105 /end MEASUREMENT
/begin MEASUREMENT new_sensor_rx_vem_s "" UBYTE HANcoder_E407_TTA_Group2_CM_boolean 0 0 0 1 ECU_ADDRESS 0x2000bba0 /end MEASUREMENT
/begin MEASUREMENT reset_vem_s "" UBYTE HANcoder_E407_TTA_Group2_CM_boolean 0 0 0 1 ECU_ADDRESS 0x2000c110 /end MEASUREMENT
/begin MEASUREMENT BC1_sync_processed_ing_s "" UBYTE HANcoder_E407_TTA_Group2_CM_boolean 0 0 0 1 ECU_ADDRESS 0x2000c2b8 /end MEASUREMENT
/begin MEASUREMENT BC0_sync_processed_ing_s "" UBYTE HANcoder_E407_TTA_Group2_CM_boolean 0 0 0 1 ECU_ADDRESS 0x2000c769 /end MEASUREMENT
/begin MEASUREMENT reset_ing_s "" UBYTE HANcoder_E407_TTA_Group2_CM_boolean 0 0 0 1 ECU_ADDRESS 0x2000c1ea /end MEASUREMENT
/begin MEASUREMENT BC1_sync_processed_s "" UBYTE HANcoder_E407_TTA_Group2_CM_boolean 0 0 0 1 ECU_ADDRESS 0x2000c778 /end MEASUREMENT
/begin MEASUREMENT BC0_vote4_processed_s "" UBYTE HANcoder_E407_TTA_Group2_CM_boolean 0 0 0 1 ECU_ADDRESS 0x2000c7a1 /end MEASUREMENT
/begin MEASUREMENT BC0_sync_processed_s "" UBYTE HANcoder_E407_TTA_Group2_CM_boolean 0 0 0 1 ECU_ADDRESS 0x2000bb8a /end MEASUREMENT
/begin MEASUREMENT BC0_vote1_processed_s "" UBYTE HANcoder_E407_TTA_Group2_CM_boolean 0 0 0 1 ECU_ADDRESS 0x2000c248 /end MEASUREMENT
/begin MEASUREMENT BC0_vote2_processed_s "" UBYTE HANcoder_E407_TTA_Group2_CM_boolean 0 0 0 1 ECU_ADDRESS 0x2000c2e4 /end MEASUREMENT
/begin MEASUREMENT BC0_vote3_processed_s "" UBYTE HANcoder_E407_TTA_Group2_CM_boolean 0 0 0 1 ECU_ADDRESS 0x2000c258 /end MEASUREMENT
/begin MEASUREMENT new_set_rx_s "" UBYTE HANcoder_E407_TTA_Group2_CM_boolean 0 0 0 1 ECU_ADDRESS 0x2000bba1 /end MEASUREMENT
/begin MEASUREMENT new_sensor_rx_s "" UBYTE HANcoder_E407_TTA_Group2_CM_boolean 0 0 0 1 ECU_ADDRESS 0x2000c191 /end MEASUREMENT
/begin MEASUREMENT out2_rx_s "" UBYTE HANcoder_E407_TTA_Group2_CM_boolean 0 0 0 1 ECU_ADDRESS 0x2000c111 /end MEASUREMENT
/begin MEASUREMENT out1_rx_s "" UBYTE HANcoder_E407_TTA_Group2_CM_boolean 0 0 0 1 ECU_ADDRESS 0x2000c7d8 /end MEASUREMENT
/begin MEASUREMENT new_error_rx_s "" UBYTE HANcoder_E407_TTA_Group2_CM_boolean 0 0 0 1 ECU_ADDRESS 0x2000c7eb /end MEASUREMENT
/begin MEASUREMENT reset_s "" UBYTE HANcoder_E407_TTA_Group2_CM_boolean 0 0 0 1 ECU_ADDRESS 0x2000c284 /end MEASUREMENT
/begin MEASUREMENT Master_error_s "" UBYTE HANcoder_E407_TTA_Group2_CM_boolean 0 0 0 1 ECU_ADDRESS 0x2000c0f1 /end MEASUREMENT
/begin MEASUREMENT Voter_error_s "" UBYTE HANcoder_E407_TTA_Group2_CM_boolean 0 0 0 1 ECU_ADDRESS 0x2000c2d0 /end MEASUREMENT
/begin MEASUREMENT Slave_error_s "" UBYTE HANcoder_E407_TTA_Group2_CM_boolean 0 0 0 1 ECU_ADDRESS 0x2000c129 /end MEASUREMENT
/begin MEASUREMENT membership_s "" UBYTE HANcoder_E407_TTA_Group2_CM_boolean 0 0 0 1 ECU_ADDRESS 0x2000c7ea /end MEASUREMENT
/begin MEASUREMENT Tx_temporal_msg_CAN2 "" FLOAT64_IEEE HANcoder_E407_TTA_Group2_CM_double 0 0 -1.7E+308 1.7E+308 ECU_ADDRESS 0x2000c158 /end MEASUREMENT
/begin MEASUREMENT TxCAN2_counter_s "" ULONG HANcoder_E407_TTA_Group2_CM_uint32 0 0 0 4294967295 ECU_ADDRESS 0x2000c280 /end MEASUREMENT
/begin MEASUREMENT TxID_CAN2_s "" ULONG HANcoder_E407_TTA_Group2_CM_uint32 0 0 0 4294967295 ECU_ADDRESS 0x2000bc18 /end MEASUREMENT
/begin MEASUREMENT Rx_temporal_msg_CAN2 "" FLOAT64_IEEE HANcoder_E407_TTA_Group2_CM_double 0 0 -1.7E+308 1.7E+308 ECU_ADDRESS 0x2000c7a8 /end MEASUREMENT
/begin MEASUREMENT RxCAN2_counter_s "" ULONG HANcoder_E407_TTA_Group2_CM_uint32 0 0 0 4294967295 ECU_ADDRESS 0x2000c270 /end MEASUREMENT
/begin MEASUREMENT RxID_CAN2_s "" ULONG HANcoder_E407_TTA_Group2_CM_uint32 0 0 0 4294967295 ECU_ADDRESS 0x2000c7a4 /end MEASUREMENT
/begin MEASUREMENT Rx_msg_ticks_CAN2 "" UWORD HANcoder_E407_TTA_Group2_CM_uint16 0 0 0 65535 ECU_ADDRESS 0x2000c7da /end MEASUREMENT
/begin MEASUREMENT Rx_temporal_msg_CAN1 "" FLOAT64_IEEE HANcoder_E407_TTA_Group2_CM_double 0 0 -1.7E+308 1.7E+308 ECU_ADDRESS 0x2000c250 /end MEASUREMENT
/begin MEASUREMENT RxCAN1_counter_s "" ULONG HANcoder_E407_TTA_Group2_CM_uint32 0 0 0 4294967295 ECU_ADDRESS 0x2000c100 /end MEASUREMENT
/begin MEASUREMENT RxID_CAN1_s "" ULONG HANcoder_E407_TTA_Group2_CM_uint32 0 0 0 4294967295 ECU_ADDRESS 0x2000c1ec /end MEASUREMENT
/begin MEASUREMENT Rx_msg_ticks_CAN1 "" UWORD HANcoder_E407_TTA_Group2_CM_uint16 0 0 0 65535 ECU_ADDRESS 0x2000c1e8 /end MEASUREMENT
/begin MEASUREMENT Tx_temporal_msg_CAN1 "" FLOAT64_IEEE HANcoder_E407_TTA_Group2_CM_double 0 0 -1.7E+308 1.7E+308 ECU_ADDRESS 0x2000c7d0 /end MEASUREMENT
/begin MEASUREMENT TxCAN1_counter_s "" ULONG HANcoder_E407_TTA_Group2_CM_uint32 0 0 0 4294967295 ECU_ADDRESS 0x2000c76c /end MEASUREMENT
/begin MEASUREMENT TxID_CAN1_s "" ULONG HANcoder_E407_TTA_Group2_CM_uint32 0 0 0 4294967295 ECU_ADDRESS 0x2000c1d0 /end MEASUREMENT
/begin COMPU_METHOD HANcoder_E407_TTA_Group2_CM_double "Q = V" RAT_FUNC "%15.10" "" COEFFS 0 1 0 0 0 1 /end COMPU_METHOD
/begin COMPU_METHOD HANcoder_E407_TTA_Group2_CM_boolean "Q = V" RAT_FUNC "%1.0" "" COEFFS 0 1 0 0 0 1 /end COMPU_METHOD
/begin COMPU_METHOD HANcoder_E407_TTA_Group2_CM_uint32 "Q = V" RAT_FUNC "%10.0" "" COEFFS 0 1 0 0 0 1 /end COMPU_METHOD
/begin COMPU_METHOD HANcoder_E407_TTA_Group2_CM_uint16 "Q = V" RAT_FUNC "%5.0" "" COEFFS 0 1 0 0 0 1 /end COMPU_METHOD
/begin COMPU_METHOD HANcoder_E407_TTA_Group2_CM_uint8 "Q = V" RAT_FUNC "%3.0" "" COEFFS 0 1 0 0 0 1 /end COMPU_METHOD
/begin GROUP HANcoder_E407_TTA_Group2 "HANcoder_E407_TTA_Group2" /* Root */ ROOT /begin SUB_GROUP Root_HANcoder_STM32_Target___E407_STM32_algorithm /end SUB_GROUP /end GROUP
/begin GROUP Root_HANcoder_STM32_Target___E407_STM32_algorithm "HANcoder_E407_TTA_Group2/HANcoder STM32 Target - E407-STM32 algorithm" /begin SUB_GROUP S1_Algorithm S1_System_information S1_TTA_CAN_System /end SUB_GROUP /end GROUP
/begin GROUP S1_Algorithm "HANcoder_E407_TTA_Group2/HANcoder STM32 Target - E407-STM32 algorithm/Algorithm" /begin REF_CHARACTERISTIC HANtuneOverride /end REF_CHARACTERISTIC /begin REF_MEASUREMENT LedValue /end REF_MEASUREMENT /end GROUP
/begin GROUP S1_System_information "HANcoder_E407_TTA_Group2/HANcoder STM32 Target - E407-STM32 algorithm/System information" /begin SUB_GROUP S9_Get_CPU_load S9_Get_free_Heap S9_Get_free_Stack /end SUB_GROUP /end GROUP
/begin GROUP S1_TTA_CAN_System "HANcoder_E407_TTA_Group2/HANcoder STM32 Target - E407-STM32 algorithm/TTA CAN System"
 /begin SUB_GROUP S10_CAN1_Recieve S10_CAN1_Send S10_CAN2_Recieve S10_CAN2_Send S10_If_Action_Subsystem S10_Local_Time_generation S10_TTA_System /end SUB_GROUP
 /begin REF_CHARACTERISTIC script_run /end REF_CHARACTERISTIC
 /begin REF_MEASUREMENT script_run_s simulation_time /end REF_MEASUREMENT
/end GROUP
/begin GROUP S9_Get_CPU_load "HANcoder_E407_TTA_Group2/HANcoder STM32 Target - E407-STM32 algorithm/System information/Get CPU load" /begin REF_MEASUREMENT SI_CPUload /end REF_MEASUREMENT /end GROUP
/begin GROUP S9_Get_free_Heap "HANcoder_E407_TTA_Group2/HANcoder STM32 Target - E407-STM32 algorithm/System information/Get free Heap" /begin REF_MEASUREMENT SI_FreeHeap /end REF_MEASUREMENT /end GROUP
/begin GROUP S9_Get_free_Stack "HANcoder_E407_TTA_Group2/HANcoder STM32 Target - E407-STM32 algorithm/System information/Get free Stack" /begin REF_MEASUREMENT SI_FreeStack /end REF_MEASUREMENT /end GROUP
/begin GROUP S10_CAN1_Recieve "HANcoder_E407_TTA_Group2/HANcoder STM32 Target - E407-STM32 algorithm/TTA CAN System/CAN1 Recieve" /begin SUB_GROUP S26_Update_message_buffers /end SUB_GROUP /begin REF_MEASUREMENT RxCAN1_counter_s RxID_CAN1_s /end REF_MEASUREMENT /end GROUP
/begin GROUP S10_CAN1_Send "HANcoder_E407_TTA_Group2/HANcoder STM32 Target - E407-STM32 algorithm/TTA CAN System/CAN1 Send" /begin REF_MEASUREMENT TxCAN1_counter_s TxID_CAN1_s Tx_temporal_msg_CAN1 /end REF_MEASUREMENT /end GROUP
/begin GROUP S10_CAN2_Recieve "HANcoder_E407_TTA_Group2/HANcoder STM32 Target - E407-STM32 algorithm/TTA CAN System/CAN2 Recieve" /begin SUB_GROUP S28_Update_message_buffers /end SUB_GROUP /begin REF_MEASUREMENT RxCAN2_counter_s RxID_CAN2_s /end REF_MEASUREMENT /end GROUP
/begin GROUP S10_CAN2_Send "HANcoder_E407_TTA_Group2/HANcoder STM32 Target - E407-STM32 algorithm/TTA CAN System/CAN2 Send" /begin REF_MEASUREMENT TxCAN2_counter_s TxID_CAN2_s Tx_temporal_msg_CAN2 /end REF_MEASUREMENT /end GROUP
/begin GROUP S10_If_Action_Subsystem "HANcoder_E407_TTA_Group2/HANcoder STM32 Target - E407-STM32 algorithm/TTA CAN System/If Action Subsystem" /begin REF_MEASUREMENT Board_ID_s /end REF_MEASUREMENT /end GROUP
/begin GROUP S10_Local_Time_generation "HANcoder_E407_TTA_Group2/HANcoder STM32 Target - E407-STM32 algorithm/TTA CAN System/Local Time generation" /begin REF_MEASUREMENT local_ticks_interrupt /end REF_MEASUREMENT /end GROUP
/begin GROUP S10_TTA_System "HANcoder_E407_TTA_Group2/HANcoder STM32 Target - E407-STM32 algorithm/TTA CAN System/TTA System"
 /begin SUB_GROUP S36_Basic_Cycle_Increment S36_Initialization S36_LT_Update_Desync_Positive S36_Matrix_Cycle_Manager /end SUB_GROUP
/end GROUP
/begin GROUP S26_Update_message_buffers "HANcoder_E407_TTA_Group2/HANcoder STM32 Target - E407-STM32 algorithm/TTA CAN System/CAN1 Recieve/Update message buffers" /begin REF_MEASUREMENT Rx_msg_ticks_CAN1 Rx_temporal_msg_CAN1 /end REF_MEASUREMENT /end GROUP
/begin GROUP S28_Update_message_buffers "HANcoder_E407_TTA_Group2/HANcoder STM32 Target - E407-STM32 algorithm/TTA CAN System/CAN2 Recieve/Update message buffers" /begin REF_MEASUREMENT Rx_msg_ticks_CAN2 Rx_temporal_msg_CAN2 /end REF_MEASUREMENT /end GROUP
/begin GROUP S36_Basic_Cycle_Increment "HANcoder_E407_TTA_Group2/HANcoder STM32 Target - E407-STM32 algorithm/TTA CAN System/TTA System/Basic Cycle Increment" /begin REF_MEASUREMENT bacic_cycle_s /end REF_MEASUREMENT /end GROUP
/begin GROUP S36_Initialization "HANcoder_E407_TTA_Group2/HANcoder STM32 Target - E407-STM32 algorithm/TTA CAN System/TTA System/Initialization" /begin SUB_GROUP S138_RoleID_and_Global_Time_init /end SUB_GROUP /end GROUP
/begin GROUP S36_LT_Update_Desync_Positive "HANcoder_E407_TTA_Group2/HANcoder STM32 Target - E407-STM32 algorithm/TTA CAN System/TTA System/LT_Update Desync_Positive" /begin REF_CHARACTERISTIC COMM_Phase1 COMM_Phase2 COMM_Phase_init1 COMM_Phase_init2 /end REF_CHARACTERISTIC /end GROUP
/begin GROUP S36_Matrix_Cycle_Manager "HANcoder_E407_TTA_Group2/HANcoder STM32 Target - E407-STM32 algorithm/TTA CAN System/TTA System/Matrix Cycle Manager"
 /begin SUB_GROUP S144_Controller_Matrix_Cycle S144_Input_Generator_Matrix_Cycle S144_Vehicle_Emulator_Matrix_Cycle /end SUB_GROUP
/end GROUP
/begin GROUP S138_RoleID_and_Global_Time_init "HANcoder_E407_TTA_Group2/HANcoder STM32 Target - E407-STM32 algorithm/TTA CAN System/TTA System/Initialization/RoleID and Global Time init" /begin SUB_GROUP S151_Global_Time_Initialization_Slave /end SUB_GROUP /end GROUP
/begin GROUP S144_Controller_Matrix_Cycle "HANcoder_E407_TTA_Group2/HANcoder STM32 Target - E407-STM32 algorithm/TTA CAN System/TTA System/Matrix Cycle Manager/Controller Matrix Cycle"
 /begin SUB_GROUP S171_Matrix_Cycle_Observation_DEBUG S171_controller_basic_cycle_0 S171_controller_basic_cycle_1 S171_msg_count_DEBUG_observer /end SUB_GROUP
/end GROUP
/begin GROUP S144_Input_Generator_Matrix_Cycle "HANcoder_E407_TTA_Group2/HANcoder STM32 Target - E407-STM32 algorithm/TTA CAN System/TTA System/Matrix Cycle Manager/Input Generator Matrix Cycle"
 /begin SUB_GROUP S172_Matrix_Cycle_Observation_DEBUG S172_input_generator_basic_cycle_0 S172_input_generator_basic_cycle_1 S172_msg_count_DEBUG_observer /end SUB_GROUP
/end GROUP
/begin GROUP S144_Vehicle_Emulator_Matrix_Cycle "HANcoder_E407_TTA_Group2/HANcoder STM32 Target - E407-STM32 algorithm/TTA CAN System/TTA System/Matrix Cycle Manager/Vehicle Emulator Matrix Cycle"
 /begin SUB_GROUP S173_Matrix_Cycle_Observation_DEBUG S173_msg_count_DEBUG_observer S173_vehicle_emulator_basic_cycle_0 S173_vehicle_emulator_basic_cycle_1 /end SUB_GROUP
/end GROUP
/begin GROUP S151_Global_Time_Initialization_Slave "HANcoder_E407_TTA_Group2/HANcoder STM32 Target - E407-STM32 algorithm/TTA CAN System/TTA System/Initialization/RoleID and Global Time init/Global Time Initialization Slave" /begin SUB_GROUP S153_msg_decoding /end SUB_GROUP /begin REF_CHARACTERISTIC COMM_Phase1 COMM_Phase2 /end REF_CHARACTERISTIC /begin REF_MEASUREMENT Rx_init_LT /end REF_MEASUREMENT /end GROUP
/begin GROUP S171_Matrix_Cycle_Observation_DEBUG "HANcoder_E407_TTA_Group2/HANcoder STM32 Target - E407-STM32 algorithm/TTA CAN System/TTA System/Matrix Cycle Manager/Controller Matrix Cycle/Matrix_Cycle_Observation_DEBUG"
 /begin REF_MEASUREMENT BC0_sync_processed_s BC0_vote1_processed_s BC0_vote2_processed_s BC0_vote3_processed_s BC0_vote4_processed_s BC1_sync_processed_s BackUP_ID_s Board_1_error_counter_s Board_2_error_counter_s Board_3_error_counter_s Board_4_error_counter_s Master_ID_s Role_ID_s Slave_ID_s Voter_ID_s sync_bc0_miss_counter_s sync_bc1_miss_counter_s votes_Board_1_DEBUG votes_Board_2_DEBUG votes_Board_3_DEBUG /end REF_MEASUREMENT
/end GROUP
/begin GROUP S171_controller_basic_cycle_0 "HANcoder_E407_TTA_Group2/HANcoder STM32 Target - E407-STM32 algorithm/TTA CAN System/TTA System/Matrix Cycle Manager/Controller Matrix Cycle/controller basic cycle 0"
 /begin SUB_GROUP S175_COMM_Task___Sync_bc_0 S175_COMM_Task___Vote1 S175_COMM_Task___Vote2 S175_COMM_Task___Vote3 S175_COMM_Task___Vote4 S175_COMP_Task___Check_Timeouts S175_COMP_Task___New_Master S175_COMP_Task___Reset_Board S175_COMP_Task___Sync_bc0_check S175_COMP_Task___Vote_Decision /end SUB_GROUP
/end GROUP
/begin GROUP S171_controller_basic_cycle_1 "HANcoder_E407_TTA_Group2/HANcoder STM32 Target - E407-STM32 algorithm/TTA CAN System/TTA System/Matrix Cycle Manager/Controller Matrix Cycle/controller basic cycle 1"
 /begin SUB_GROUP S176_COMM_Task___Error_Values_ S176_COMM_Task___Output_Control1 S176_COMM_Task___Output_Control2 S176_COMM_Task___Output_Emulator S176_COMM_Task___Sensor_Values S176_COMM_Task___Set_Values S176_COMM_Task___Sync_bc_1 S176_COMP_Task___Calculate_Speed S176_COMP_Task___Calculate_Steer S176_COMP_Task___Calculate_Torque S176_COMP_Task___Check_Error_Values S176_COMP_Task___Rx_Output_Control1_Check S176_COMP_Task___Rx_Output_Control2_Check S176_COMP_Task___Rx_Sensor_Values_Check S176_COMP_Task___Rx_Set_Values_Check S176_COMP_Task___Sync_bc1_check S176_COMP_Task___TMR /end SUB_GROUP
/end GROUP
/begin GROUP S171_msg_count_DEBUG_observer "HANcoder_E407_TTA_Group2/HANcoder STM32 Target - E407-STM32 algorithm/TTA CAN System/TTA System/Matrix Cycle Manager/Controller Matrix Cycle/msg_count_DEBUG observer" /begin REF_MEASUREMENT msg_count_DEBUG_s /end REF_MEASUREMENT /end GROUP
/begin GROUP S172_Matrix_Cycle_Observation_DEBUG "HANcoder_E407_TTA_Group2/HANcoder STM32 Target - E407-STM32 algorithm/TTA CAN System/TTA System/Matrix Cycle Manager/Input Generator Matrix Cycle/Matrix_Cycle_Observation_DEBUG"
 /begin REF_MEASUREMENT BC0_sync_processed_ing_s BC1_sync_processed_ing_s Master_ID_ing_s Role_ID_ing_s sync_bc0_miss_counter_ing sync_bc1_miss_counter_ing /end REF_MEASUREMENT
/end GROUP
/begin GROUP S172_input_generator_basic_cycle_0 "HANcoder_E407_TTA_Group2/HANcoder STM32 Target - E407-STM32 algorithm/TTA CAN System/TTA System/Matrix Cycle Manager/Input Generator Matrix Cycle/input generator basic cycle 0"
 /begin SUB_GROUP S1112_COMM_Task___Sync_bc_0 S1112_COMP_Task___Reset_Board S1112_COMP_Task___Sync_bc0_check /end SUB_GROUP
/end GROUP
/begin GROUP S172_input_generator_basic_cycle_1 "HANcoder_E407_TTA_Group2/HANcoder STM32 Target - E407-STM32 algorithm/TTA CAN System/TTA System/Matrix Cycle Manager/Input Generator Matrix Cycle/input generator basic cycle 1"
 /begin SUB_GROUP S1113_COMM_Task___Set_Values S1113_COMM_Task___Sync_bc_1 S1113_COMP_Task___Sync_bc1_check /end SUB_GROUP
/end GROUP
/begin GROUP S172_msg_count_DEBUG_observer "HANcoder_E407_TTA_Group2/HANcoder STM32 Target - E407-STM32 algorithm/TTA CAN System/TTA System/Matrix Cycle Manager/Input Generator Matrix Cycle/msg_count_DEBUG observer" /begin REF_MEASUREMENT msg_count_DEBUG_ing_s /end REF_MEASUREMENT /end GROUP
/begin GROUP S173_Matrix_Cycle_Observation_DEBUG "HANcoder_E407_TTA_Group2/HANcoder STM32 Target - E407-STM32 algorithm/TTA CAN System/TTA System/Matrix Cycle Manager/Vehicle Emulator Matrix Cycle/Matrix_Cycle_Observation_DEBUG"
 /begin REF_MEASUREMENT BC0_sync_processed_vem__s BC1_sync_processed_vem__s Master_ID_vem_s Role_ID_vem_s outcont_miss_counter_vem sync_bc0_miss_counter_vem sync_bc1_miss_counter_vem /end REF_MEASUREMENT
/end GROUP
/begin GROUP S173_msg_count_DEBUG_observer "HANcoder_E407_TTA_Group2/HANcoder STM32 Target - E407-STM32 algorithm/TTA CAN System/TTA System/Matrix Cycle Manager/Vehicle Emulator Matrix Cycle/msg_count_DEBUG observer" /begin REF_MEASUREMENT msg_count_DEBUG_vem_s /end REF_MEASUREMENT /end GROUP
/begin GROUP S173_vehicle_emulator_basic_cycle_0 "HANcoder_E407_TTA_Group2/HANcoder STM32 Target - E407-STM32 algorithm/TTA CAN System/TTA System/Matrix Cycle Manager/Vehicle Emulator Matrix Cycle/vehicle emulator basic cycle 0"
 /begin SUB_GROUP S1265_COMM_Task___Sync_bc_0 S1265_COMP_Task___Reset_Board S1265_COMP_Task___Sync_bc0_check /end SUB_GROUP
/end GROUP
/begin GROUP S173_vehicle_emulator_basic_cycle_1 "HANcoder_E407_TTA_Group2/HANcoder STM32 Target - E407-STM32 algorithm/TTA CAN System/TTA System/Matrix Cycle Manager/Vehicle Emulator Matrix Cycle/vehicle emulator basic cycle 1"
 /begin SUB_GROUP S1266_COMM_Task___Output_Emulator S1266_COMM_Task___Sensor_Values S1266_COMM_Task___Sync_bc_1 S1266_COMP_Task___Rx_Output_Emulator_Check S1266_COMP_Task___Sync_bc1_check /end SUB_GROUP
/end GROUP
/begin GROUP S153_msg_decoding "HANcoder_E407_TTA_Group2/HANcoder STM32 Target - E407-STM32 algorithm/TTA CAN System/TTA System/Initialization/RoleID and Global Time init/Global Time Initialization Slave/msg_decoding" /begin SUB_GROUP S154_Bit_Shift S154_Bit_Shift1 S154_Bit_Shift2 /end SUB_GROUP /end GROUP
/begin GROUP S175_COMM_Task___Sync_bc_0 "HANcoder_E407_TTA_Group2/HANcoder STM32 Target - E407-STM32 algorithm/TTA CAN System/TTA System/Matrix Cycle Manager/Controller Matrix Cycle/controller basic cycle 0/COMM Task - Sync bc 0" /begin SUB_GROUP S178_Transmission_subtasks /end SUB_GROUP /end GROUP
/begin GROUP S175_COMM_Task___Vote1 "HANcoder_E407_TTA_Group2/HANcoder STM32 Target - E407-STM32 algorithm/TTA CAN System/TTA System/Matrix Cycle Manager/Controller Matrix Cycle/controller basic cycle 0/COMM Task - Vote1" /begin SUB_GROUP S179_Transmission_subtasks /end SUB_GROUP /end GROUP
/begin GROUP S175_COMM_Task___Vote2 "HANcoder_E407_TTA_Group2/HANcoder STM32 Target - E407-STM32 algorithm/TTA CAN System/TTA System/Matrix Cycle Manager/Controller Matrix Cycle/controller basic cycle 0/COMM Task - Vote2" /begin SUB_GROUP S180_Transmission_subtasks /end SUB_GROUP /end GROUP
/begin GROUP S175_COMM_Task___Vote3 "HANcoder_E407_TTA_Group2/HANcoder STM32 Target - E407-STM32 algorithm/TTA CAN System/TTA System/Matrix Cycle Manager/Controller Matrix Cycle/controller basic cycle 0/COMM Task - Vote3" /begin SUB_GROUP S181_Transmission_subtasks /end SUB_GROUP /end GROUP
/begin GROUP S175_COMM_Task___Vote4 "HANcoder_E407_TTA_Group2/HANcoder STM32 Target - E407-STM32 algorithm/TTA CAN System/TTA System/Matrix Cycle Manager/Controller Matrix Cycle/controller basic cycle 0/COMM Task - Vote4" /begin SUB_GROUP S182_Transmission_subtasks /end SUB_GROUP /end GROUP
/begin GROUP S175_COMP_Task___Check_Timeouts "HANcoder_E407_TTA_Group2/HANcoder STM32 Target - E407-STM32 algorithm/TTA CAN System/TTA System/Matrix Cycle Manager/Controller Matrix Cycle/controller basic cycle 0/COMP Task - Check Timeouts" /begin SUB_GROUP S183_Timeout_and_Board_error_counter /end SUB_GROUP /end GROUP
/begin GROUP S175_COMP_Task___New_Master "HANcoder_E407_TTA_Group2/HANcoder STM32 Target - E407-STM32 algorithm/TTA CAN System/TTA System/Matrix Cycle Manager/Controller Matrix Cycle/controller basic cycle 0/COMP Task - New Master" /begin SUB_GROUP S184_Decision_Voter_and_Membership /end SUB_GROUP /end GROUP
/begin GROUP S175_COMP_Task___Reset_Board "HANcoder_E407_TTA_Group2/HANcoder STM32 Target - E407-STM32 algorithm/TTA CAN System/TTA System/Matrix Cycle Manager/Controller Matrix Cycle/controller basic cycle 0/COMP Task - Reset Board" /begin REF_MEASUREMENT reset_s /end REF_MEASUREMENT /end GROUP
/begin GROUP S175_COMP_Task___Sync_bc0_check "HANcoder_E407_TTA_Group2/HANcoder STM32 Target - E407-STM32 algorithm/TTA CAN System/TTA System/Matrix Cycle Manager/Controller Matrix Cycle/controller basic cycle 0/COMP Task - Sync bc0 check" /begin SUB_GROUP S187_Process_Messages /end SUB_GROUP /end GROUP
/begin GROUP S175_COMP_Task___Vote_Decision "HANcoder_E407_TTA_Group2/HANcoder STM32 Target - E407-STM32 algorithm/TTA CAN System/TTA System/Matrix Cycle Manager/Controller Matrix Cycle/controller basic cycle 0/COMP Task - Vote Decision" /begin SUB_GROUP S189_Vote_Decision /end SUB_GROUP /end GROUP
/begin GROUP S176_COMM_Task___Error_Values_ "HANcoder_E407_TTA_Group2/HANcoder STM32 Target - E407-STM32 algorithm/TTA CAN System/TTA System/Matrix Cycle Manager/Controller Matrix Cycle/controller basic cycle 1/COMM Task - Error Values " /begin SUB_GROUP S551_Transmission_subtasks /end SUB_GROUP /end GROUP
/begin GROUP S176_COMM_Task___Output_Control1 "HANcoder_E407_TTA_Group2/HANcoder STM32 Target - E407-STM32 algorithm/TTA CAN System/TTA System/Matrix Cycle Manager/Controller Matrix Cycle/controller basic cycle 1/COMM Task - Output Control1" /begin SUB_GROUP S552_Transmission_subtasks1 /end SUB_GROUP /end GROUP
/begin GROUP S176_COMM_Task___Output_Control2 "HANcoder_E407_TTA_Group2/HANcoder STM32 Target - E407-STM32 algorithm/TTA CAN System/TTA System/Matrix Cycle Manager/Controller Matrix Cycle/controller basic cycle 1/COMM Task - Output Control2" /begin SUB_GROUP S553_Transmission_subtasks /end SUB_GROUP /end GROUP
/begin GROUP S176_COMM_Task___Output_Emulator "HANcoder_E407_TTA_Group2/HANcoder STM32 Target - E407-STM32 algorithm/TTA CAN System/TTA System/Matrix Cycle Manager/Controller Matrix Cycle/controller basic cycle 1/COMM Task - Output Emulator" /begin SUB_GROUP S554_Transmission_subtasks /end SUB_GROUP /end GROUP
/begin GROUP S176_COMM_Task___Sensor_Values "HANcoder_E407_TTA_Group2/HANcoder STM32 Target - E407-STM32 algorithm/TTA CAN System/TTA System/Matrix Cycle Manager/Controller Matrix Cycle/controller basic cycle 1/COMM Task - Sensor_Values" /begin SUB_GROUP S555_Transmission_subtasks /end SUB_GROUP /end GROUP
/begin GROUP S176_COMM_Task___Set_Values "HANcoder_E407_TTA_Group2/HANcoder STM32 Target - E407-STM32 algorithm/TTA CAN System/TTA System/Matrix Cycle Manager/Controller Matrix Cycle/controller basic cycle 1/COMM Task - Set_Values" /begin SUB_GROUP S556_Transmission_subtasks /end SUB_GROUP /end GROUP
/begin GROUP S176_COMM_Task___Sync_bc_1 "HANcoder_E407_TTA_Group2/HANcoder STM32 Target - E407-STM32 algorithm/TTA CAN System/TTA System/Matrix Cycle Manager/Controller Matrix Cycle/controller basic cycle 1/COMM Task - Sync bc 1" /begin SUB_GROUP S557_Transmission_subtasks1 /end SUB_GROUP /end GROUP
/begin GROUP S176_COMP_Task___Calculate_Speed "HANcoder_E407_TTA_Group2/HANcoder STM32 Target - E407-STM32 algorithm/TTA CAN System/TTA System/Matrix Cycle Manager/Controller Matrix Cycle/controller basic cycle 1/COMP Task - Calculate Speed" /begin SUB_GROUP S558_Calculate_speed /end SUB_GROUP /end GROUP
/begin GROUP S176_COMP_Task___Calculate_Steer "HANcoder_E407_TTA_Group2/HANcoder STM32 Target - E407-STM32 algorithm/TTA CAN System/TTA System/Matrix Cycle Manager/Controller Matrix Cycle/controller basic cycle 1/COMP Task - Calculate Steer" /begin SUB_GROUP S559_Calculate_steering /end SUB_GROUP /end GROUP
/begin GROUP S176_COMP_Task___Calculate_Torque "HANcoder_E407_TTA_Group2/HANcoder STM32 Target - E407-STM32 algorithm/TTA CAN System/TTA System/Matrix Cycle Manager/Controller Matrix Cycle/controller basic cycle 1/COMP Task - Calculate Torque" /begin SUB_GROUP S560_Calculate_torque /end SUB_GROUP /end GROUP
/begin GROUP S176_COMP_Task___Check_Error_Values "HANcoder_E407_TTA_Group2/HANcoder STM32 Target - E407-STM32 algorithm/TTA CAN System/TTA System/Matrix Cycle Manager/Controller Matrix Cycle/controller basic cycle 1/COMP Task - Check Error Values" /begin SUB_GROUP S561_Update_Msg_buffer /end SUB_GROUP /end GROUP
/begin GROUP S176_COMP_Task___Rx_Output_Control1_Check "HANcoder_E407_TTA_Group2/HANcoder STM32 Target - E407-STM32 algorithm/TTA CAN System/TTA System/Matrix Cycle Manager/Controller Matrix Cycle/controller basic cycle 1/COMP Task - Rx_Output_Control1_Check" /begin SUB_GROUP S564_Process_Messages /end SUB_GROUP /end GROUP
/begin GROUP S176_COMP_Task___Rx_Output_Control2_Check "HANcoder_E407_TTA_Group2/HANcoder STM32 Target - E407-STM32 algorithm/TTA CAN System/TTA System/Matrix Cycle Manager/Controller Matrix Cycle/controller basic cycle 1/COMP Task - Rx_Output_Control2_Check" /begin SUB_GROUP S565_Process_Messages /end SUB_GROUP /end GROUP
/begin GROUP S176_COMP_Task___Rx_Sensor_Values_Check "HANcoder_E407_TTA_Group2/HANcoder STM32 Target - E407-STM32 algorithm/TTA CAN System/TTA System/Matrix Cycle Manager/Controller Matrix Cycle/controller basic cycle 1/COMP Task - Rx_Sensor_Values_Check" /begin SUB_GROUP S567_Update_Msg_buffer /end SUB_GROUP /end GROUP
/begin GROUP S176_COMP_Task___Rx_Set_Values_Check "HANcoder_E407_TTA_Group2/HANcoder STM32 Target - E407-STM32 algorithm/TTA CAN System/TTA System/Matrix Cycle Manager/Controller Matrix Cycle/controller basic cycle 1/COMP Task - Rx_Set_Values_Check" /begin SUB_GROUP S568_Update_Msg_buffer /end SUB_GROUP /end GROUP
/begin GROUP S176_COMP_Task___Sync_bc1_check "HANcoder_E407_TTA_Group2/HANcoder STM32 Target - E407-STM32 algorithm/TTA CAN System/TTA System/Matrix Cycle Manager/Controller Matrix Cycle/controller basic cycle 1/COMP Task - Sync bc1 check" /begin SUB_GROUP S569_Process_Messages /end SUB_GROUP /end GROUP
/begin GROUP S176_COMP_Task___TMR "HANcoder_E407_TTA_Group2/HANcoder STM32 Target - E407-STM32 algorithm/TTA CAN System/TTA System/Matrix Cycle Manager/Controller Matrix Cycle/controller basic cycle 1/COMP Task - TMR" /begin SUB_GROUP S570_TMR_load_msgs_1 S570_TMR_load_msgs_2 S570_TMR_main /end SUB_GROUP /end GROUP
/begin GROUP S1112_COMM_Task___Sync_bc_0 "HANcoder_E407_TTA_Group2/HANcoder STM32 Target - E407-STM32 algorithm/TTA CAN System/TTA System/Matrix Cycle Manager/Input Generator Matrix Cycle/input generator basic cycle 0/COMM Task - Sync bc 0" /begin SUB_GROUP S1115_Transmission_subtasks /end SUB_GROUP /end GROUP
/begin GROUP S1112_COMP_Task___Reset_Board "HANcoder_E407_TTA_Group2/HANcoder STM32 Target - E407-STM32 algorithm/TTA CAN System/TTA System/Matrix Cycle Manager/Input Generator Matrix Cycle/input generator basic cycle 0/COMP Task - Reset Board" /begin REF_MEASUREMENT reset_ing_s /end REF_MEASUREMENT /end GROUP
/begin GROUP S1112_COMP_Task___Sync_bc0_check "HANcoder_E407_TTA_Group2/HANcoder STM32 Target - E407-STM32 algorithm/TTA CAN System/TTA System/Matrix Cycle Manager/Input Generator Matrix Cycle/input generator basic cycle 0/COMP Task - Sync bc0 check" /begin SUB_GROUP S1118_Process_Messages /end SUB_GROUP /end GROUP
/begin GROUP S1113_COMM_Task___Set_Values "HANcoder_E407_TTA_Group2/HANcoder STM32 Target - E407-STM32 algorithm/TTA CAN System/TTA System/Matrix Cycle Manager/Input Generator Matrix Cycle/input generator basic cycle 1/COMM Task - Set_Values" /begin SUB_GROUP S1174_Transmission_subtasks /end SUB_GROUP /end GROUP
/begin GROUP S1113_COMM_Task___Sync_bc_1 "HANcoder_E407_TTA_Group2/HANcoder STM32 Target - E407-STM32 algorithm/TTA CAN System/TTA System/Matrix Cycle Manager/Input Generator Matrix Cycle/input generator basic cycle 1/COMM Task - Sync bc 1" /begin SUB_GROUP S1175_Transmission_subtasks /end SUB_GROUP /end GROUP
/begin GROUP S1113_COMP_Task___Sync_bc1_check "HANcoder_E407_TTA_Group2/HANcoder STM32 Target - E407-STM32 algorithm/TTA CAN System/TTA System/Matrix Cycle Manager/Input Generator Matrix Cycle/input generator basic cycle 1/COMP Task - Sync bc1 check" /begin SUB_GROUP S1179_Process_Messages /end SUB_GROUP /end GROUP
/begin GROUP S1265_COMM_Task___Sync_bc_0 "HANcoder_E407_TTA_Group2/HANcoder STM32 Target - E407-STM32 algorithm/TTA CAN System/TTA System/Matrix Cycle Manager/Vehicle Emulator Matrix Cycle/vehicle emulator basic cycle 0/COMM Task - Sync bc 0" /begin SUB_GROUP S1267_Transmission_subtasks /end SUB_GROUP /end GROUP
/begin GROUP S1265_COMP_Task___Reset_Board "HANcoder_E407_TTA_Group2/HANcoder STM32 Target - E407-STM32 algorithm/TTA CAN System/TTA System/Matrix Cycle Manager/Vehicle Emulator Matrix Cycle/vehicle emulator basic cycle 0/COMP Task - Reset Board" /begin REF_MEASUREMENT reset_vem_s /end REF_MEASUREMENT /end GROUP
/begin GROUP S1265_COMP_Task___Sync_bc0_check "HANcoder_E407_TTA_Group2/HANcoder STM32 Target - E407-STM32 algorithm/TTA CAN System/TTA System/Matrix Cycle Manager/Vehicle Emulator Matrix Cycle/vehicle emulator basic cycle 0/COMP Task - Sync bc0 check" /begin SUB_GROUP S1270_Process_Messages /end SUB_GROUP /end GROUP
/begin GROUP S1266_COMM_Task___Output_Emulator "HANcoder_E407_TTA_Group2/HANcoder STM32 Target - E407-STM32 algorithm/TTA CAN System/TTA System/Matrix Cycle Manager/Vehicle Emulator Matrix Cycle/vehicle emulator basic cycle 1/COMM Task - Output Emulator" /begin SUB_GROUP S1339_Transmission_subtasks /end SUB_GROUP /end GROUP
/begin GROUP S1266_COMM_Task___Sensor_Values "HANcoder_E407_TTA_Group2/HANcoder STM32 Target - E407-STM32 algorithm/TTA CAN System/TTA System/Matrix Cycle Manager/Vehicle Emulator Matrix Cycle/vehicle emulator basic cycle 1/COMM Task - Sensor_Values" /begin SUB_GROUP S1340_Transmission_subtasks /end SUB_GROUP /end GROUP
/begin GROUP S1266_COMM_Task___Sync_bc_1 "HANcoder_E407_TTA_Group2/HANcoder STM32 Target - E407-STM32 algorithm/TTA CAN System/TTA System/Matrix Cycle Manager/Vehicle Emulator Matrix Cycle/vehicle emulator basic cycle 1/COMM Task - Sync bc 1" /begin SUB_GROUP S1341_Transmission_subtasks /end SUB_GROUP /end GROUP
/begin GROUP S1266_COMP_Task___Rx_Output_Emulator_Check "HANcoder_E407_TTA_Group2/HANcoder STM32 Target - E407-STM32 algorithm/TTA CAN System/TTA System/Matrix Cycle Manager/Vehicle Emulator Matrix Cycle/vehicle emulator basic cycle 1/COMP Task - Rx Output Emulator Check" /begin SUB_GROUP S1343_Update_Msg_buffer /end SUB_GROUP /end GROUP
/begin GROUP S1266_COMP_Task___Sync_bc1_check "HANcoder_E407_TTA_Group2/HANcoder STM32 Target - E407-STM32 algorithm/TTA CAN System/TTA System/Matrix Cycle Manager/Vehicle Emulator Matrix Cycle/vehicle emulator basic cycle 1/COMP Task - Sync bc1 check" /begin SUB_GROUP S1345_Process_Messages /end SUB_GROUP /end GROUP
/begin GROUP S154_Bit_Shift "HANcoder_E407_TTA_Group2/HANcoder STM32 Target - E407-STM32 algorithm/TTA CAN System/TTA System/Initialization/RoleID and Global Time init/Global Time Initialization Slave/msg_decoding/Bit Shift" /begin REF_MEASUREMENT Rx_init_bc /end REF_MEASUREMENT /end GROUP
/begin GROUP S154_Bit_Shift1 "HANcoder_E407_TTA_Group2/HANcoder STM32 Target - E407-STM32 algorithm/TTA CAN System/TTA System/Initialization/RoleID and Global Time init/Global Time Initialization Slave/msg_decoding/Bit Shift1" /begin REF_MEASUREMENT Rx_init_mc /end REF_MEASUREMENT /end GROUP
/begin GROUP S154_Bit_Shift2 "HANcoder_E407_TTA_Group2/HANcoder STM32 Target - E407-STM32 algorithm/TTA CAN System/TTA System/Initialization/RoleID and Global Time init/Global Time Initialization Slave/msg_decoding/Bit Shift2" /begin REF_MEASUREMENT Rx_init_id /end REF_MEASUREMENT /end GROUP
/begin GROUP S178_Transmission_subtasks "HANcoder_E407_TTA_Group2/HANcoder STM32 Target - E407-STM32 algorithm/TTA CAN System/TTA System/Matrix Cycle Manager/Controller Matrix Cycle/controller basic cycle 0/COMM Task - Sync bc 0/Transmission subtasks"
 /begin SUB_GROUP S199_Check_msg_transmission_CAN1 S199_Check_msg_transmission_CAN2 /end SUB_GROUP
/end GROUP
/begin GROUP S179_Transmission_subtasks "HANcoder_E407_TTA_Group2/HANcoder STM32 Target - E407-STM32 algorithm/TTA CAN System/TTA System/Matrix Cycle Manager/Controller Matrix Cycle/controller basic cycle 0/COMM Task - Vote1/Transmission subtasks"
 /begin SUB_GROUP S217_Check_msg_transmission_CAN1 S217_Check_msg_transmission_CAN2 /end SUB_GROUP
/end GROUP
/begin GROUP S180_Transmission_subtasks "HANcoder_E407_TTA_Group2/HANcoder STM32 Target - E407-STM32 algorithm/TTA CAN System/TTA System/Matrix Cycle Manager/Controller Matrix Cycle/controller basic cycle 0/COMM Task - Vote2/Transmission subtasks"
 /begin SUB_GROUP S235_Check_msg_transmission_CAN1 S235_Check_msg_transmission_CAN2 /end SUB_GROUP
/end GROUP
/begin GROUP S181_Transmission_subtasks "HANcoder_E407_TTA_Group2/HANcoder STM32 Target - E407-STM32 algorithm/TTA CAN System/TTA System/Matrix Cycle Manager/Controller Matrix Cycle/controller basic cycle 0/COMM Task - Vote3/Transmission subtasks"
 /begin SUB_GROUP S253_Check_msg_transmission_CAN1 S253_Check_msg_transmission_CAN2 /end SUB_GROUP
/end GROUP
/begin GROUP S182_Transmission_subtasks "HANcoder_E407_TTA_Group2/HANcoder STM32 Target - E407-STM32 algorithm/TTA CAN System/TTA System/Matrix Cycle Manager/Controller Matrix Cycle/controller basic cycle 0/COMM Task - Vote4/Transmission subtasks"
 /begin SUB_GROUP S271_Check_msg_transmission_CAN1 S271_Check_msg_transmission_CAN2 /end SUB_GROUP
/end GROUP
/begin GROUP S183_Timeout_and_Board_error_counter "HANcoder_E407_TTA_Group2/HANcoder STM32 Target - E407-STM32 algorithm/TTA CAN System/TTA System/Matrix Cycle Manager/Controller Matrix Cycle/controller basic cycle 0/COMP Task - Check Timeouts/Timeout and Board error counter"
 /begin SUB_GROUP S288_Timeout_Counter_1_DEBUG S288_Timeout_Counter_2_DEBUG S288_Timeout_Counter_3_DEBUG S288_Timeout_Counter_4_DEBUG /end SUB_GROUP
/end GROUP
/begin GROUP S184_Decision_Voter_and_Membership "HANcoder_E407_TTA_Group2/HANcoder STM32 Target - E407-STM32 algorithm/TTA CAN System/TTA System/Matrix Cycle Manager/Controller Matrix Cycle/controller basic cycle 0/COMP Task - New Master/Decision Voter and Membership"
 /begin SUB_GROUP S293_Decision_Voter S293_Decode_Error_1 S293_Decode_Error_2 S293_Decode_Error_3 /end SUB_GROUP
 /begin REF_CHARACTERISTIC membership_switch /end REF_CHARACTERISTIC
 /begin REF_MEASUREMENT Error1_s Error2_s Error3_s decision_voter_s membership_s /end REF_MEASUREMENT
/end GROUP
/begin GROUP S187_Process_Messages "HANcoder_E407_TTA_Group2/HANcoder STM32 Target - E407-STM32 algorithm/TTA CAN System/TTA System/Matrix Cycle Manager/Controller Matrix Cycle/controller basic cycle 0/COMP Task - Sync bc0 check/Process_Messages" /begin SUB_GROUP S398_Desync_calculation /end SUB_GROUP /end GROUP
/begin GROUP S189_Vote_Decision "HANcoder_E407_TTA_Group2/HANcoder STM32 Target - E407-STM32 algorithm/TTA CAN System/TTA System/Matrix Cycle Manager/Controller Matrix Cycle/controller basic cycle 0/COMP Task - Vote Decision/Vote Decision" /begin REF_MEASUREMENT Vote_s /end REF_MEASUREMENT /end GROUP
/begin GROUP S551_Transmission_subtasks "HANcoder_E407_TTA_Group2/HANcoder STM32 Target - E407-STM32 algorithm/TTA CAN System/TTA System/Matrix Cycle Manager/Controller Matrix Cycle/controller basic cycle 1/COMM Task - Error Values /Transmission subtasks"
 /begin SUB_GROUP S573_Check_msg_transmission_CAN1 S573_Check_msg_transmission_CAN2 /end SUB_GROUP
/end GROUP
/begin GROUP S552_Transmission_subtasks1 "HANcoder_E407_TTA_Group2/HANcoder STM32 Target - E407-STM32 algorithm/TTA CAN System/TTA System/Matrix Cycle Manager/Controller Matrix Cycle/controller basic cycle 1/COMM Task - Output Control1/Transmission subtasks1"
 /begin SUB_GROUP S592_Check_msg_transmission_CAN1 S592_Check_msg_transmission_CAN2 S592_Msg_Value_Data_Encoded /end SUB_GROUP
/end GROUP
/begin GROUP S553_Transmission_subtasks "HANcoder_E407_TTA_Group2/HANcoder STM32 Target - E407-STM32 algorithm/TTA CAN System/TTA System/Matrix Cycle Manager/Controller Matrix Cycle/controller basic cycle 1/COMM Task - Output Control2/Transmission subtasks"
 /begin SUB_GROUP S623_Check_msg_transmission_CAN1 S623_Check_msg_transmission_CAN2 /end SUB_GROUP
/end GROUP
/begin GROUP S554_Transmission_subtasks "HANcoder_E407_TTA_Group2/HANcoder STM32 Target - E407-STM32 algorithm/TTA CAN System/TTA System/Matrix Cycle Manager/Controller Matrix Cycle/controller basic cycle 1/COMM Task - Output Emulator/Transmission subtasks"
 /begin SUB_GROUP S653_Check_msg_transmission_CAN1 S653_Check_msg_transmission_CAN2 /end SUB_GROUP
/end GROUP
/begin GROUP S555_Transmission_subtasks "HANcoder_E407_TTA_Group2/HANcoder STM32 Target - E407-STM32 algorithm/TTA CAN System/TTA System/Matrix Cycle Manager/Controller Matrix Cycle/controller basic cycle 1/COMM Task - Sensor_Values/Transmission subtasks"
 /begin SUB_GROUP S683_Check_msg_transmission_CAN1 S683_Check_msg_transmission_CAN2 /end SUB_GROUP
/end GROUP
/begin GROUP S556_Transmission_subtasks "HANcoder_E407_TTA_Group2/HANcoder STM32 Target - E407-STM32 algorithm/TTA CAN System/TTA System/Matrix Cycle Manager/Controller Matrix Cycle/controller basic cycle 1/COMM Task - Set_Values/Transmission subtasks"
 /begin SUB_GROUP S713_Check_msg_transmission_CAN1 S713_Check_msg_transmission_CAN2 S713_Msg_Value_Data_Encoded /end SUB_GROUP
/end GROUP
/begin GROUP S557_Transmission_subtasks1 "HANcoder_E407_TTA_Group2/HANcoder STM32 Target - E407-STM32 algorithm/TTA CAN System/TTA System/Matrix Cycle Manager/Controller Matrix Cycle/controller basic cycle 1/COMM Task - Sync bc 1/Transmission subtasks1"
 /begin SUB_GROUP S740_Check_msg_transmission_CAN1 S740_Check_msg_transmission_CAN2 /end SUB_GROUP
/end GROUP
/begin GROUP S558_Calculate_speed "HANcoder_E407_TTA_Group2/HANcoder STM32 Target - E407-STM32 algorithm/TTA CAN System/TTA System/Matrix Cycle Manager/Controller Matrix Cycle/controller basic cycle 1/COMP Task - Calculate Speed/Calculate speed" /begin SUB_GROUP S757_Integral_speed /end SUB_GROUP /begin REF_CHARACTERISTIC speed_k_d speed_k_i speed_k_p /end REF_CHARACTERISTIC
 /begin REF_MEASUREMENT torque_al_set_s torque_ar_set_s torque_fl_set_s torque_fr_set_s v_ctreff_s v_est_s /end REF_MEASUREMENT
/end GROUP
/begin GROUP S559_Calculate_steering "HANcoder_E407_TTA_Group2/HANcoder STM32 Target - E407-STM32 algorithm/TTA CAN System/TTA System/Matrix Cycle Manager/Controller Matrix Cycle/controller basic cycle 1/COMP Task - Calculate Steer/Calculate steering"
 /begin REF_MEASUREMENT theta_al_stored_s theta_ar_stored_s theta_fl_stored_s theta_fr_stored_s /end REF_MEASUREMENT
/end GROUP
/begin GROUP S560_Calculate_torque "HANcoder_E407_TTA_Group2/HANcoder STM32 Target - E407-STM32 algorithm/TTA CAN System/TTA System/Matrix Cycle Manager/Controller Matrix Cycle/controller basic cycle 1/COMP Task - Calculate Torque/Calculate torque"
 /begin REF_CHARACTERISTIC torque_a_k_d torque_a_k_i torque_a_k_p torque_f_k_d torque_f_k_i torque_f_k_p /end REF_CHARACTERISTIC
/end GROUP
/begin GROUP S561_Update_Msg_buffer "HANcoder_E407_TTA_Group2/HANcoder STM32 Target - E407-STM32 algorithm/TTA CAN System/TTA System/Matrix Cycle Manager/Controller Matrix Cycle/controller basic cycle 1/COMP Task - Check Error Values/Update Msg buffer" /begin REF_MEASUREMENT new_error_rx_s /end REF_MEASUREMENT /end GROUP
/begin GROUP S564_Process_Messages "HANcoder_E407_TTA_Group2/HANcoder STM32 Target - E407-STM32 algorithm/TTA CAN System/TTA System/Matrix Cycle Manager/Controller Matrix Cycle/controller basic cycle 1/COMP Task - Rx_Output_Control1_Check/Process_Messages" /begin REF_MEASUREMENT out1_rx_s /end REF_MEASUREMENT /end GROUP
/begin GROUP S565_Process_Messages "HANcoder_E407_TTA_Group2/HANcoder STM32 Target - E407-STM32 algorithm/TTA CAN System/TTA System/Matrix Cycle Manager/Controller Matrix Cycle/controller basic cycle 1/COMP Task - Rx_Output_Control2_Check/Process_Messages" /begin REF_MEASUREMENT out2_rx_s /end REF_MEASUREMENT /end GROUP
/begin GROUP S567_Update_Msg_buffer "HANcoder_E407_TTA_Group2/HANcoder STM32 Target - E407-STM32 algorithm/TTA CAN System/TTA System/Matrix Cycle Manager/Controller Matrix Cycle/controller basic cycle 1/COMP Task - Rx_Sensor_Values_Check/Update Msg buffer" /begin SUB_GROUP S894_Sensor_Values_Rx_Update /end SUB_GROUP /begin REF_MEASUREMENT mc_counter_s new_sensor_rx_s /end REF_MEASUREMENT /end GROUP
/begin GROUP S568_Update_Msg_buffer "HANcoder_E407_TTA_Group2/HANcoder STM32 Target - E407-STM32 algorithm/TTA CAN System/TTA System/Matrix Cycle Manager/Controller Matrix Cycle/controller basic cycle 1/COMP Task - Rx_Set_Values_Check/Update Msg buffer" /begin REF_MEASUREMENT new_set_rx_s /end REF_MEASUREMENT /end GROUP
/begin GROUP S569_Process_Messages "HANcoder_E407_TTA_Group2/HANcoder STM32 Target - E407-STM32 algorithm/TTA CAN System/TTA System/Matrix Cycle Manager/Controller Matrix Cycle/controller basic cycle 1/COMP Task - Sync bc1 check/Process_Messages" /begin SUB_GROUP S991_Desync_calculation /end SUB_GROUP /end GROUP
/begin GROUP S570_TMR_load_msgs_1 "HANcoder_E407_TTA_Group2/HANcoder STM32 Target - E407-STM32 algorithm/TTA CAN System/TTA System/Matrix Cycle Manager/Controller Matrix Cycle/controller basic cycle 1/COMP Task - TMR/TMR_load_msgs_1"
 /begin SUB_GROUP S1020_uint8_2float S1020_uint8_2float1 S1020_uint8_2float2 S1020_uint8_2float3 /end SUB_GROUP
/end GROUP
/begin GROUP S570_TMR_load_msgs_2 "HANcoder_E407_TTA_Group2/HANcoder STM32 Target - E407-STM32 algorithm/TTA CAN System/TTA System/Matrix Cycle Manager/Controller Matrix Cycle/controller basic cycle 1/COMP Task - TMR/TMR_load_msgs_2"
 /begin SUB_GROUP S1021_uint8_2float4 S1021_uint8_2float5 S1021_uint8_2float6 S1021_uint8_2float7 /end SUB_GROUP
/end GROUP
/begin GROUP S570_TMR_main "HANcoder_E407_TTA_Group2/HANcoder STM32 Target - E407-STM32 algorithm/TTA CAN System/TTA System/Matrix Cycle Manager/Controller Matrix Cycle/controller basic cycle 1/COMP Task - TMR/TMR_main"
 /begin REF_CHARACTERISTIC switch_agree_tau_fr_out switch_agree_tau_fr_out1 switch_agree_tau_fr_out2 /end REF_CHARACTERISTIC
 /begin REF_MEASUREMENT error_log1_s error_log2_s error_log3_s torque_al_set_out_s torque_ar_set_out_s torque_fl_set_out_s torque_fr_set_out_s /end REF_MEASUREMENT
/end GROUP
/begin GROUP S1115_Transmission_subtasks "HANcoder_E407_TTA_Group2/HANcoder STM32 Target - E407-STM32 algorithm/TTA CAN System/TTA System/Matrix Cycle Manager/Input Generator Matrix Cycle/input generator basic cycle 0/COMM Task - Sync bc 0/Transmission subtasks"
 /begin SUB_GROUP S1121_Check_msg_transmission_CAN1 S1121_Check_msg_transmission_CAN2 /end SUB_GROUP
/end GROUP
/begin GROUP S1118_Process_Messages "HANcoder_E407_TTA_Group2/HANcoder STM32 Target - E407-STM32 algorithm/TTA CAN System/TTA System/Matrix Cycle Manager/Input Generator Matrix Cycle/input generator basic cycle 0/COMP Task - Sync bc0 check/Process_Messages" /begin SUB_GROUP S1141_Desync_calculation /end SUB_GROUP /end GROUP
/begin GROUP S1174_Transmission_subtasks "HANcoder_E407_TTA_Group2/HANcoder STM32 Target - E407-STM32 algorithm/TTA CAN System/TTA System/Matrix Cycle Manager/Input Generator Matrix Cycle/input generator basic cycle 1/COMM Task - Set_Values/Transmission subtasks"
 /begin SUB_GROUP S1182_Check_msg_transmission_CAN1 S1182_Check_msg_transmission_CAN2 S1182_Msg_Value_Data_Encoded /end SUB_GROUP
/end GROUP
/begin GROUP S1175_Transmission_subtasks "HANcoder_E407_TTA_Group2/HANcoder STM32 Target - E407-STM32 algorithm/TTA CAN System/TTA System/Matrix Cycle Manager/Input Generator Matrix Cycle/input generator basic cycle 1/COMM Task - Sync bc 1/Transmission subtasks"
 /begin SUB_GROUP S1209_Check_msg_transmission_CAN1 S1209_Check_msg_transmission_CAN2 /end SUB_GROUP
/end GROUP
/begin GROUP S1179_Process_Messages "HANcoder_E407_TTA_Group2/HANcoder STM32 Target - E407-STM32 algorithm/TTA CAN System/TTA System/Matrix Cycle Manager/Input Generator Matrix Cycle/input generator basic cycle 1/COMP Task - Sync bc1 check/Process_Messages" /begin SUB_GROUP S1230_Desync_calculation /end SUB_GROUP /end GROUP
/begin GROUP S1267_Transmission_subtasks "HANcoder_E407_TTA_Group2/HANcoder STM32 Target - E407-STM32 algorithm/TTA CAN System/TTA System/Matrix Cycle Manager/Vehicle Emulator Matrix Cycle/vehicle emulator basic cycle 0/COMM Task - Sync bc 0/Transmission subtasks"
 /begin SUB_GROUP S1276_Check_msg_transmission_CAN1 S1276_Check_msg_transmission_CAN2 /end SUB_GROUP
/end GROUP
/begin GROUP S1270_Process_Messages "HANcoder_E407_TTA_Group2/HANcoder STM32 Target - E407-STM32 algorithm/TTA CAN System/TTA System/Matrix Cycle Manager/Vehicle Emulator Matrix Cycle/vehicle emulator basic cycle 0/COMP Task - Sync bc0 check/Process_Messages" /begin SUB_GROUP S1296_Desync_calculation /end SUB_GROUP /end GROUP
/begin GROUP S1339_Transmission_subtasks "HANcoder_E407_TTA_Group2/HANcoder STM32 Target - E407-STM32 algorithm/TTA CAN System/TTA System/Matrix Cycle Manager/Vehicle Emulator Matrix Cycle/vehicle emulator basic cycle 1/COMM Task - Output Emulator/Transmission subtasks"
 /begin SUB_GROUP S1348_Check_msg_transmission_CAN1 S1348_Check_msg_transmission_CAN2 /end SUB_GROUP
/end GROUP
/begin GROUP S1340_Transmission_subtasks "HANcoder_E407_TTA_Group2/HANcoder STM32 Target - E407-STM32 algorithm/TTA CAN System/TTA System/Matrix Cycle Manager/Vehicle Emulator Matrix Cycle/vehicle emulator basic cycle 1/COMM Task - Sensor_Values/Transmission subtasks"
 /begin SUB_GROUP S1378_Check_msg_transmission_CAN1 S1378_Check_msg_transmission_CAN2 /end SUB_GROUP
/end GROUP
/begin GROUP S1341_Transmission_subtasks "HANcoder_E407_TTA_Group2/HANcoder STM32 Target - E407-STM32 algorithm/TTA CAN System/TTA System/Matrix Cycle Manager/Vehicle Emulator Matrix Cycle/vehicle emulator basic cycle 1/COMM Task - Sync bc 1/Transmission subtasks"
 /begin SUB_GROUP S1408_Check_msg_transmission_CAN1 S1408_Check_msg_transmission_CAN2 /end SUB_GROUP
/end GROUP
/begin GROUP S1343_Update_Msg_buffer "HANcoder_E407_TTA_Group2/HANcoder STM32 Target - E407-STM32 algorithm/TTA CAN System/TTA System/Matrix Cycle Manager/Vehicle Emulator Matrix Cycle/vehicle emulator basic cycle 1/COMP Task - Rx Output Emulator Check/Update Msg buffer" /begin REF_MEASUREMENT new_sensor_rx_vem_s /end REF_MEASUREMENT /end GROUP
/begin GROUP S1345_Process_Messages "HANcoder_E407_TTA_Group2/HANcoder STM32 Target - E407-STM32 algorithm/TTA CAN System/TTA System/Matrix Cycle Manager/Vehicle Emulator Matrix Cycle/vehicle emulator basic cycle 1/COMP Task - Sync bc1 check/Process_Messages" /begin SUB_GROUP S1479_Desync_calculation /end SUB_GROUP /end GROUP
/begin GROUP S199_Check_msg_transmission_CAN1 "HANcoder_E407_TTA_Group2/HANcoder STM32 Target - E407-STM32 algorithm/TTA CAN System/TTA System/Matrix Cycle Manager/Controller Matrix Cycle/controller basic cycle 0/COMM Task - Sync bc 0/Transmission subtasks/Check msg transmission CAN1" /begin REF_CHARACTERISTIC COMM_Phase1 COMM_Phase_init1 /end REF_CHARACTERISTIC /end GROUP
/begin GROUP S199_Check_msg_transmission_CAN2 "HANcoder_E407_TTA_Group2/HANcoder STM32 Target - E407-STM32 algorithm/TTA CAN System/TTA System/Matrix Cycle Manager/Controller Matrix Cycle/controller basic cycle 0/COMM Task - Sync bc 0/Transmission subtasks/Check msg transmission CAN2" /begin REF_CHARACTERISTIC COMM_Phase2 COMM_Phase_init2 /end REF_CHARACTERISTIC /end GROUP
/begin GROUP S217_Check_msg_transmission_CAN1 "HANcoder_E407_TTA_Group2/HANcoder STM32 Target - E407-STM32 algorithm/TTA CAN System/TTA System/Matrix Cycle Manager/Controller Matrix Cycle/controller basic cycle 0/COMM Task - Vote1/Transmission subtasks/Check msg transmission CAN1" /begin REF_CHARACTERISTIC COMM_Phase1 COMM_Phase_init1 /end REF_CHARACTERISTIC /end GROUP
/begin GROUP S217_Check_msg_transmission_CAN2 "HANcoder_E407_TTA_Group2/HANcoder STM32 Target - E407-STM32 algorithm/TTA CAN System/TTA System/Matrix Cycle Manager/Controller Matrix Cycle/controller basic cycle 0/COMM Task - Vote1/Transmission subtasks/Check msg transmission CAN2" /begin REF_CHARACTERISTIC COMM_Phase2 COMM_Phase_init2 /end REF_CHARACTERISTIC /end GROUP
/begin GROUP S235_Check_msg_transmission_CAN1 "HANcoder_E407_TTA_Group2/HANcoder STM32 Target - E407-STM32 algorithm/TTA CAN System/TTA System/Matrix Cycle Manager/Controller Matrix Cycle/controller basic cycle 0/COMM Task - Vote2/Transmission subtasks/Check msg transmission CAN1" /begin REF_CHARACTERISTIC COMM_Phase1 COMM_Phase_init1 /end REF_CHARACTERISTIC /end GROUP
/begin GROUP S235_Check_msg_transmission_CAN2 "HANcoder_E407_TTA_Group2/HANcoder STM32 Target - E407-STM32 algorithm/TTA CAN System/TTA System/Matrix Cycle Manager/Controller Matrix Cycle/controller basic cycle 0/COMM Task - Vote2/Transmission subtasks/Check msg transmission CAN2" /begin REF_CHARACTERISTIC COMM_Phase2 COMM_Phase_init2 /end REF_CHARACTERISTIC /end GROUP
/begin GROUP S253_Check_msg_transmission_CAN1 "HANcoder_E407_TTA_Group2/HANcoder STM32 Target - E407-STM32 algorithm/TTA CAN System/TTA System/Matrix Cycle Manager/Controller Matrix Cycle/controller basic cycle 0/COMM Task - Vote3/Transmission subtasks/Check msg transmission CAN1" /begin REF_CHARACTERISTIC COMM_Phase1 COMM_Phase_init1 /end REF_CHARACTERISTIC /end GROUP
/begin GROUP S253_Check_msg_transmission_CAN2 "HANcoder_E407_TTA_Group2/HANcoder STM32 Target - E407-STM32 algorithm/TTA CAN System/TTA System/Matrix Cycle Manager/Controller Matrix Cycle/controller basic cycle 0/COMM Task - Vote3/Transmission subtasks/Check msg transmission CAN2" /begin REF_CHARACTERISTIC COMM_Phase2 COMM_Phase_init2 /end REF_CHARACTERISTIC /end GROUP
/begin GROUP S271_Check_msg_transmission_CAN1 "HANcoder_E407_TTA_Group2/HANcoder STM32 Target - E407-STM32 algorithm/TTA CAN System/TTA System/Matrix Cycle Manager/Controller Matrix Cycle/controller basic cycle 0/COMM Task - Vote4/Transmission subtasks/Check msg transmission CAN1" /begin REF_CHARACTERISTIC COMM_Phase1 COMM_Phase_init1 /end REF_CHARACTERISTIC /end GROUP
/begin GROUP S271_Check_msg_transmission_CAN2 "HANcoder_E407_TTA_Group2/HANcoder STM32 Target - E407-STM32 algorithm/TTA CAN System/TTA System/Matrix Cycle Manager/Controller Matrix Cycle/controller basic cycle 0/COMM Task - Vote4/Transmission subtasks/Check msg transmission CAN2" /begin REF_CHARACTERISTIC COMM_Phase2 COMM_Phase_init2 /end REF_CHARACTERISTIC /end GROUP
/begin GROUP S288_Timeout_Counter_1_DEBUG "HANcoder_E407_TTA_Group2/HANcoder STM32 Target - E407-STM32 algorithm/TTA CAN System/TTA System/Matrix Cycle Manager/Controller Matrix Cycle/controller basic cycle 0/COMP Task - Check Timeouts/Timeout and Board error counter/Timeout Counter 1 DEBUG" /begin REF_MEASUREMENT TM1_timeout_counter_s /end REF_MEASUREMENT /end GROUP
/begin GROUP S288_Timeout_Counter_2_DEBUG "HANcoder_E407_TTA_Group2/HANcoder STM32 Target - E407-STM32 algorithm/TTA CAN System/TTA System/Matrix Cycle Manager/Controller Matrix Cycle/controller basic cycle 0/COMP Task - Check Timeouts/Timeout and Board error counter/Timeout Counter 2 DEBUG" /begin REF_MEASUREMENT TM2_timeout_counter_s /end REF_MEASUREMENT /end GROUP
/begin GROUP S288_Timeout_Counter_3_DEBUG "HANcoder_E407_TTA_Group2/HANcoder STM32 Target - E407-STM32 algorithm/TTA CAN System/TTA System/Matrix Cycle Manager/Controller Matrix Cycle/controller basic cycle 0/COMP Task - Check Timeouts/Timeout and Board error counter/Timeout Counter 3 DEBUG" /begin REF_MEASUREMENT TM3_timeout_counter_s /end REF_MEASUREMENT /end GROUP
/begin GROUP S288_Timeout_Counter_4_DEBUG "HANcoder_E407_TTA_Group2/HANcoder STM32 Target - E407-STM32 algorithm/TTA CAN System/TTA System/Matrix Cycle Manager/Controller Matrix Cycle/controller basic cycle 0/COMP Task - Check Timeouts/Timeout and Board error counter/Timeout Counter 4 DEBUG" /begin REF_MEASUREMENT TM4_timeout_counter_s /end REF_MEASUREMENT /end GROUP
/begin GROUP S293_Decision_Voter "HANcoder_E407_TTA_Group2/HANcoder STM32 Target - E407-STM32 algorithm/TTA CAN System/TTA System/Matrix Cycle Manager/Controller Matrix Cycle/controller basic cycle 0/COMP Task - New Master/Decision Voter and Membership/Decision Voter" /begin SUB_GROUP S294_Votes_recount_to_choose_Master /end SUB_GROUP /end GROUP
/begin GROUP S293_Decode_Error_1 "HANcoder_E407_TTA_Group2/HANcoder STM32 Target - E407-STM32 algorithm/TTA CAN System/TTA System/Matrix Cycle Manager/Controller Matrix Cycle/controller basic cycle 0/COMP Task - New Master/Decision Voter and Membership/Decode Error 1"
 /begin SUB_GROUP S295_Bit_Shift11 S295_Bit_Shift12 S295_Bit_Shift14 S295_Bit_Shift7 S295_Bit_Shift8 S295_Bit_Shift9 /end SUB_GROUP
 /begin REF_MEASUREMENT Voter_error_s /end REF_MEASUREMENT
/end GROUP
/begin GROUP S293_Decode_Error_2 "HANcoder_E407_TTA_Group2/HANcoder STM32 Target - E407-STM32 algorithm/TTA CAN System/TTA System/Matrix Cycle Manager/Controller Matrix Cycle/controller basic cycle 0/COMP Task - New Master/Decision Voter and Membership/Decode Error 2"
 /begin SUB_GROUP S296_Bit_Shift10 S296_Bit_Shift11 S296_Bit_Shift12 S296_Bit_Shift14 S296_Bit_Shift7 S296_Bit_Shift8 S296_Bit_Shift9 /end SUB_GROUP
 /begin REF_MEASUREMENT Master_error_s /end REF_MEASUREMENT
/end GROUP
/begin GROUP S293_Decode_Error_3 "HANcoder_E407_TTA_Group2/HANcoder STM32 Target - E407-STM32 algorithm/TTA CAN System/TTA System/Matrix Cycle Manager/Controller Matrix Cycle/controller basic cycle 0/COMP Task - New Master/Decision Voter and Membership/Decode Error 3"
 /begin SUB_GROUP S297_Bit_Shift10 S297_Bit_Shift11 S297_Bit_Shift12 S297_Bit_Shift14 S297_Bit_Shift7 S297_Bit_Shift8 S297_Bit_Shift9 /end SUB_GROUP
 /begin REF_MEASUREMENT Slave_error_s /end REF_MEASUREMENT
/end GROUP
/begin GROUP S398_Desync_calculation "HANcoder_E407_TTA_Group2/HANcoder STM32 Target - E407-STM32 algorithm/TTA CAN System/TTA System/Matrix Cycle Manager/Controller Matrix Cycle/controller basic cycle 0/COMP Task - Sync bc0 check/Process_Messages/Desync calculation" /begin REF_CHARACTERISTIC COMM_Phase1 COMM_Phase2 /end REF_CHARACTERISTIC /begin REF_MEASUREMENT Desync_Sync_bc0_s /end REF_MEASUREMENT /end GROUP
/begin GROUP S573_Check_msg_transmission_CAN1 "HANcoder_E407_TTA_Group2/HANcoder STM32 Target - E407-STM32 algorithm/TTA CAN System/TTA System/Matrix Cycle Manager/Controller Matrix Cycle/controller basic cycle 1/COMM Task - Error Values /Transmission subtasks/Check msg transmission CAN1" /begin REF_CHARACTERISTIC COMM_Phase1 COMM_Phase_init1 /end REF_CHARACTERISTIC /end GROUP
/begin GROUP S573_Check_msg_transmission_CAN2 "HANcoder_E407_TTA_Group2/HANcoder STM32 Target - E407-STM32 algorithm/TTA CAN System/TTA System/Matrix Cycle Manager/Controller Matrix Cycle/controller basic cycle 1/COMM Task - Error Values /Transmission subtasks/Check msg transmission CAN2" /begin REF_CHARACTERISTIC COMM_Phase2 COMM_Phase_init2 /end REF_CHARACTERISTIC /end GROUP
/begin GROUP S592_Check_msg_transmission_CAN1 "HANcoder_E407_TTA_Group2/HANcoder STM32 Target - E407-STM32 algorithm/TTA CAN System/TTA System/Matrix Cycle Manager/Controller Matrix Cycle/controller basic cycle 1/COMM Task - Output Control1/Transmission subtasks1/Check msg transmission CAN1" /begin REF_CHARACTERISTIC COMM_Phase1 COMM_Phase_init1 /end REF_CHARACTERISTIC /end GROUP
/begin GROUP S592_Check_msg_transmission_CAN2 "HANcoder_E407_TTA_Group2/HANcoder STM32 Target - E407-STM32 algorithm/TTA CAN System/TTA System/Matrix Cycle Manager/Controller Matrix Cycle/controller basic cycle 1/COMM Task - Output Control1/Transmission subtasks1/Check msg transmission CAN2" /begin REF_CHARACTERISTIC COMM_Phase2 COMM_Phase_init2 /end REF_CHARACTERISTIC /end GROUP
/begin GROUP S592_Msg_Value_Data_Encoded "HANcoder_E407_TTA_Group2/HANcoder STM32 Target - E407-STM32 algorithm/TTA CAN System/TTA System/Matrix Cycle Manager/Controller Matrix Cycle/controller basic cycle 1/COMM Task - Output Control1/Transmission subtasks1/Msg_Value_Data_Encoded" /begin REF_CHARACTERISTIC switch_manipulate_torque torque_fr_set_manipulated /end REF_CHARACTERISTIC /end GROUP
/begin GROUP S623_Check_msg_transmission_CAN1 "HANcoder_E407_TTA_Group2/HANcoder STM32 Target - E407-STM32 algorithm/TTA CAN System/TTA System/Matrix Cycle Manager/Controller Matrix Cycle/controller basic cycle 1/COMM Task - Output Control2/Transmission subtasks/Check msg transmission CAN1" /begin REF_CHARACTERISTIC COMM_Phase1 COMM_Phase_init1 /end REF_CHARACTERISTIC /end GROUP
/begin GROUP S623_Check_msg_transmission_CAN2 "HANcoder_E407_TTA_Group2/HANcoder STM32 Target - E407-STM32 algorithm/TTA CAN System/TTA System/Matrix Cycle Manager/Controller Matrix Cycle/controller basic cycle 1/COMM Task - Output Control2/Transmission subtasks/Check msg transmission CAN2" /begin REF_CHARACTERISTIC COMM_Phase2 COMM_Phase_init2 /end REF_CHARACTERISTIC /end GROUP
/begin GROUP S653_Check_msg_transmission_CAN1 "HANcoder_E407_TTA_Group2/HANcoder STM32 Target - E407-STM32 algorithm/TTA CAN System/TTA System/Matrix Cycle Manager/Controller Matrix Cycle/controller basic cycle 1/COMM Task - Output Emulator/Transmission subtasks/Check msg transmission CAN1" /begin REF_CHARACTERISTIC COMM_Phase1 COMM_Phase_init1 /end REF_CHARACTERISTIC /end GROUP
/begin GROUP S653_Check_msg_transmission_CAN2 "HANcoder_E407_TTA_Group2/HANcoder STM32 Target - E407-STM32 algorithm/TTA CAN System/TTA System/Matrix Cycle Manager/Controller Matrix Cycle/controller basic cycle 1/COMM Task - Output Emulator/Transmission subtasks/Check msg transmission CAN2" /begin REF_CHARACTERISTIC COMM_Phase2 COMM_Phase_init2 /end REF_CHARACTERISTIC /end GROUP
/begin GROUP S683_Check_msg_transmission_CAN1 "HANcoder_E407_TTA_Group2/HANcoder STM32 Target - E407-STM32 algorithm/TTA CAN System/TTA System/Matrix Cycle Manager/Controller Matrix Cycle/controller basic cycle 1/COMM Task - Sensor_Values/Transmission subtasks/Check msg transmission CAN1" /begin REF_CHARACTERISTIC COMM_Phase1 COMM_Phase_init1 /end REF_CHARACTERISTIC /end GROUP
/begin GROUP S683_Check_msg_transmission_CAN2 "HANcoder_E407_TTA_Group2/HANcoder STM32 Target - E407-STM32 algorithm/TTA CAN System/TTA System/Matrix Cycle Manager/Controller Matrix Cycle/controller basic cycle 1/COMM Task - Sensor_Values/Transmission subtasks/Check msg transmission CAN2" /begin REF_CHARACTERISTIC COMM_Phase2 COMM_Phase_init2 /end REF_CHARACTERISTIC /end GROUP
/begin GROUP S713_Check_msg_transmission_CAN1 "HANcoder_E407_TTA_Group2/HANcoder STM32 Target - E407-STM32 algorithm/TTA CAN System/TTA System/Matrix Cycle Manager/Controller Matrix Cycle/controller basic cycle 1/COMM Task - Set_Values/Transmission subtasks/Check msg transmission CAN1" /begin REF_CHARACTERISTIC COMM_Phase1 COMM_Phase_init1 /end REF_CHARACTERISTIC /end GROUP
/begin GROUP S713_Check_msg_transmission_CAN2 "HANcoder_E407_TTA_Group2/HANcoder STM32 Target - E407-STM32 algorithm/TTA CAN System/TTA System/Matrix Cycle Manager/Controller Matrix Cycle/controller basic cycle 1/COMM Task - Set_Values/Transmission subtasks/Check msg transmission CAN2" /begin REF_CHARACTERISTIC COMM_Phase2 COMM_Phase_init2 /end REF_CHARACTERISTIC /end GROUP
/begin GROUP S713_Msg_Value_Data_Encoded "HANcoder_E407_TTA_Group2/HANcoder STM32 Target - E407-STM32 algorithm/TTA CAN System/TTA System/Matrix Cycle Manager/Controller Matrix Cycle/controller basic cycle 1/COMM Task - Set_Values/Transmission subtasks/Msg_Value_Data_Encoded" /begin REF_CHARACTERISTIC delta_a_set delta_f_set v_set /end REF_CHARACTERISTIC /end GROUP
/begin GROUP S740_Check_msg_transmission_CAN1 "HANcoder_E407_TTA_Group2/HANcoder STM32 Target - E407-STM32 algorithm/TTA CAN System/TTA System/Matrix Cycle Manager/Controller Matrix Cycle/controller basic cycle 1/COMM Task - Sync bc 1/Transmission subtasks1/Check msg transmission CAN1" /begin REF_CHARACTERISTIC COMM_Phase1 COMM_Phase_init1 /end REF_CHARACTERISTIC /end GROUP
/begin GROUP S740_Check_msg_transmission_CAN2 "HANcoder_E407_TTA_Group2/HANcoder STM32 Target - E407-STM32 algorithm/TTA CAN System/TTA System/Matrix Cycle Manager/Controller Matrix Cycle/controller basic cycle 1/COMM Task - Sync bc 1/Transmission subtasks1/Check msg transmission CAN2" /begin REF_CHARACTERISTIC COMM_Phase2 COMM_Phase_init2 /end REF_CHARACTERISTIC /end GROUP
/begin GROUP S757_Integral_speed "HANcoder_E407_TTA_Group2/HANcoder STM32 Target - E407-STM32 algorithm/TTA CAN System/TTA System/Matrix Cycle Manager/Controller Matrix Cycle/controller basic cycle 1/COMP Task - Calculate Speed/Calculate speed/Integral speed" /begin REF_MEASUREMENT v_integral_s /end REF_MEASUREMENT /end GROUP
/begin GROUP S894_Sensor_Values_Rx_Update "HANcoder_E407_TTA_Group2/HANcoder STM32 Target - E407-STM32 algorithm/TTA CAN System/TTA System/Matrix Cycle Manager/Controller Matrix Cycle/controller basic cycle 1/COMP Task - Rx_Sensor_Values_Check/Update Msg buffer/Sensor Values Rx Update" /begin SUB_GROUP S921_Inputs_Rx_OK /end SUB_GROUP /end GROUP
/begin GROUP S991_Desync_calculation "HANcoder_E407_TTA_Group2/HANcoder STM32 Target - E407-STM32 algorithm/TTA CAN System/TTA System/Matrix Cycle Manager/Controller Matrix Cycle/controller basic cycle 1/COMP Task - Sync bc1 check/Process_Messages/Desync calculation" /begin REF_CHARACTERISTIC COMM_Phase1 COMM_Phase2 /end REF_CHARACTERISTIC /begin REF_MEASUREMENT Desync_Sync_bc1_s /end REF_MEASUREMENT /end GROUP
/begin GROUP S1020_uint8_2float "HANcoder_E407_TTA_Group2/HANcoder STM32 Target - E407-STM32 algorithm/TTA CAN System/TTA System/Matrix Cycle Manager/Controller Matrix Cycle/controller basic cycle 1/COMP Task - TMR/TMR_load_msgs_1/uint8_2float" /begin REF_MEASUREMENT torque_fr_out1_s /end REF_MEASUREMENT /end GROUP
/begin GROUP S1020_uint8_2float1 "HANcoder_E407_TTA_Group2/HANcoder STM32 Target - E407-STM32 algorithm/TTA CAN System/TTA System/Matrix Cycle Manager/Controller Matrix Cycle/controller basic cycle 1/COMP Task - TMR/TMR_load_msgs_1/uint8_2float1" /begin REF_MEASUREMENT torque_fl_out1_s /end REF_MEASUREMENT /end GROUP
/begin GROUP S1020_uint8_2float2 "HANcoder_E407_TTA_Group2/HANcoder STM32 Target - E407-STM32 algorithm/TTA CAN System/TTA System/Matrix Cycle Manager/Controller Matrix Cycle/controller basic cycle 1/COMP Task - TMR/TMR_load_msgs_1/uint8_2float2" /begin REF_MEASUREMENT torque_ar_out1_s /end REF_MEASUREMENT /end GROUP
/begin GROUP S1020_uint8_2float3 "HANcoder_E407_TTA_Group2/HANcoder STM32 Target - E407-STM32 algorithm/TTA CAN System/TTA System/Matrix Cycle Manager/Controller Matrix Cycle/controller basic cycle 1/COMP Task - TMR/TMR_load_msgs_1/uint8_2float3" /begin REF_MEASUREMENT torque_al_out1_s /end REF_MEASUREMENT /end GROUP
/begin GROUP S1021_uint8_2float4 "HANcoder_E407_TTA_Group2/HANcoder STM32 Target - E407-STM32 algorithm/TTA CAN System/TTA System/Matrix Cycle Manager/Controller Matrix Cycle/controller basic cycle 1/COMP Task - TMR/TMR_load_msgs_2/uint8_2float4" /begin REF_MEASUREMENT torque_fr_out2_s /end REF_MEASUREMENT /end GROUP
/begin GROUP S1021_uint8_2float5 "HANcoder_E407_TTA_Group2/HANcoder STM32 Target - E407-STM32 algorithm/TTA CAN System/TTA System/Matrix Cycle Manager/Controller Matrix Cycle/controller basic cycle 1/COMP Task - TMR/TMR_load_msgs_2/uint8_2float5" /begin REF_MEASUREMENT torque_fl_out2_s /end REF_MEASUREMENT /end GROUP
/begin GROUP S1021_uint8_2float6 "HANcoder_E407_TTA_Group2/HANcoder STM32 Target - E407-STM32 algorithm/TTA CAN System/TTA System/Matrix Cycle Manager/Controller Matrix Cycle/controller basic cycle 1/COMP Task - TMR/TMR_load_msgs_2/uint8_2float6" /begin REF_MEASUREMENT torque_ar_out2_s /end REF_MEASUREMENT /end GROUP
/begin GROUP S1021_uint8_2float7 "HANcoder_E407_TTA_Group2/HANcoder STM32 Target - E407-STM32 algorithm/TTA CAN System/TTA System/Matrix Cycle Manager/Controller Matrix Cycle/controller basic cycle 1/COMP Task - TMR/TMR_load_msgs_2/uint8_2float7" /begin REF_MEASUREMENT torque_al_out2_s /end REF_MEASUREMENT /end GROUP
/begin GROUP S1121_Check_msg_transmission_CAN1 "HANcoder_E407_TTA_Group2/HANcoder STM32 Target - E407-STM32 algorithm/TTA CAN System/TTA System/Matrix Cycle Manager/Input Generator Matrix Cycle/input generator basic cycle 0/COMM Task - Sync bc 0/Transmission subtasks/Check msg transmission CAN1" /begin REF_CHARACTERISTIC COMM_Phase1 COMM_Phase_init1 /end REF_CHARACTERISTIC /end GROUP
/begin GROUP S1121_Check_msg_transmission_CAN2 "HANcoder_E407_TTA_Group2/HANcoder STM32 Target - E407-STM32 algorithm/TTA CAN System/TTA System/Matrix Cycle Manager/Input Generator Matrix Cycle/input generator basic cycle 0/COMM Task - Sync bc 0/Transmission subtasks/Check msg transmission CAN2" /begin REF_CHARACTERISTIC COMM_Phase2 COMM_Phase_init2 /end REF_CHARACTERISTIC /end GROUP
/begin GROUP S1141_Desync_calculation "HANcoder_E407_TTA_Group2/HANcoder STM32 Target - E407-STM32 algorithm/TTA CAN System/TTA System/Matrix Cycle Manager/Input Generator Matrix Cycle/input generator basic cycle 0/COMP Task - Sync bc0 check/Process_Messages/Desync calculation" /begin REF_CHARACTERISTIC COMM_Phase1 COMM_Phase2 /end REF_CHARACTERISTIC /begin REF_MEASUREMENT Desync_Sync_bc0_ing_s /end REF_MEASUREMENT /end GROUP
/begin GROUP S1182_Check_msg_transmission_CAN1 "HANcoder_E407_TTA_Group2/HANcoder STM32 Target - E407-STM32 algorithm/TTA CAN System/TTA System/Matrix Cycle Manager/Input Generator Matrix Cycle/input generator basic cycle 1/COMM Task - Set_Values/Transmission subtasks/Check msg transmission CAN1" /begin REF_CHARACTERISTIC COMM_Phase1 COMM_Phase_init1 /end REF_CHARACTERISTIC /end GROUP
/begin GROUP S1182_Check_msg_transmission_CAN2 "HANcoder_E407_TTA_Group2/HANcoder STM32 Target - E407-STM32 algorithm/TTA CAN System/TTA System/Matrix Cycle Manager/Input Generator Matrix Cycle/input generator basic cycle 1/COMM Task - Set_Values/Transmission subtasks/Check msg transmission CAN2" /begin REF_CHARACTERISTIC COMM_Phase2 COMM_Phase_init2 /end REF_CHARACTERISTIC /end GROUP
/begin GROUP S1182_Msg_Value_Data_Encoded "HANcoder_E407_TTA_Group2/HANcoder STM32 Target - E407-STM32 algorithm/TTA CAN System/TTA System/Matrix Cycle Manager/Input Generator Matrix Cycle/input generator basic cycle 1/COMM Task - Set_Values/Transmission subtasks/Msg_Value_Data_Encoded" /begin REF_CHARACTERISTIC delta_a_set delta_f_set v_set /end REF_CHARACTERISTIC /end GROUP
/begin GROUP S1209_Check_msg_transmission_CAN1 "HANcoder_E407_TTA_Group2/HANcoder STM32 Target - E407-STM32 algorithm/TTA CAN System/TTA System/Matrix Cycle Manager/Input Generator Matrix Cycle/input generator basic cycle 1/COMM Task - Sync bc 1/Transmission subtasks/Check msg transmission CAN1" /begin REF_CHARACTERISTIC COMM_Phase1 COMM_Phase_init1 /end REF_CHARACTERISTIC /end GROUP
/begin GROUP S1209_Check_msg_transmission_CAN2 "HANcoder_E407_TTA_Group2/HANcoder STM32 Target - E407-STM32 algorithm/TTA CAN System/TTA System/Matrix Cycle Manager/Input Generator Matrix Cycle/input generator basic cycle 1/COMM Task - Sync bc 1/Transmission subtasks/Check msg transmission CAN2" /begin REF_CHARACTERISTIC COMM_Phase2 COMM_Phase_init2 /end REF_CHARACTERISTIC /end GROUP
/begin GROUP S1230_Desync_calculation "HANcoder_E407_TTA_Group2/HANcoder STM32 Target - E407-STM32 algorithm/TTA CAN System/TTA System/Matrix Cycle Manager/Input Generator Matrix Cycle/input generator basic cycle 1/COMP Task - Sync bc1 check/Process_Messages/Desync calculation" /begin REF_CHARACTERISTIC COMM_Phase1 COMM_Phase2 /end REF_CHARACTERISTIC /begin REF_MEASUREMENT Desync_Sync_bc1_ing_s /end REF_MEASUREMENT /end GROUP
/begin GROUP S1276_Check_msg_transmission_CAN1 "HANcoder_E407_TTA_Group2/HANcoder STM32 Target - E407-STM32 algorithm/TTA CAN System/TTA System/Matrix Cycle Manager/Vehicle Emulator Matrix Cycle/vehicle emulator basic cycle 0/COMM Task - Sync bc 0/Transmission subtasks/Check msg transmission CAN1" /begin REF_CHARACTERISTIC COMM_Phase1 COMM_Phase_init1 /end REF_CHARACTERISTIC /end GROUP
/begin GROUP S1276_Check_msg_transmission_CAN2 "HANcoder_E407_TTA_Group2/HANcoder STM32 Target - E407-STM32 algorithm/TTA CAN System/TTA System/Matrix Cycle Manager/Vehicle Emulator Matrix Cycle/vehicle emulator basic cycle 0/COMM Task - Sync bc 0/Transmission subtasks/Check msg transmission CAN2" /begin REF_CHARACTERISTIC COMM_Phase2 COMM_Phase_init2 /end REF_CHARACTERISTIC /end GROUP
/begin GROUP S1296_Desync_calculation "HANcoder_E407_TTA_Group2/HANcoder STM32 Target - E407-STM32 algorithm/TTA CAN System/TTA System/Matrix Cycle Manager/Vehicle Emulator Matrix Cycle/vehicle emulator basic cycle 0/COMP Task - Sync bc0 check/Process_Messages/Desync calculation" /begin REF_CHARACTERISTIC COMM_Phase1 COMM_Phase2 /end REF_CHARACTERISTIC /begin REF_MEASUREMENT Desync_Sync_bc0_vem_s /end REF_MEASUREMENT /end GROUP
/begin GROUP S1348_Check_msg_transmission_CAN1 "HANcoder_E407_TTA_Group2/HANcoder STM32 Target - E407-STM32 algorithm/TTA CAN System/TTA System/Matrix Cycle Manager/Vehicle Emulator Matrix Cycle/vehicle emulator basic cycle 1/COMM Task - Output Emulator/Transmission subtasks/Check msg transmission CAN1" /begin REF_CHARACTERISTIC COMM_Phase1 COMM_Phase_init1 /end REF_CHARACTERISTIC /end GROUP
/begin GROUP S1348_Check_msg_transmission_CAN2 "HANcoder_E407_TTA_Group2/HANcoder STM32 Target - E407-STM32 algorithm/TTA CAN System/TTA System/Matrix Cycle Manager/Vehicle Emulator Matrix Cycle/vehicle emulator basic cycle 1/COMM Task - Output Emulator/Transmission subtasks/Check msg transmission CAN2" /begin REF_CHARACTERISTIC COMM_Phase2 COMM_Phase_init2 /end REF_CHARACTERISTIC /end GROUP
/begin GROUP S1378_Check_msg_transmission_CAN1 "HANcoder_E407_TTA_Group2/HANcoder STM32 Target - E407-STM32 algorithm/TTA CAN System/TTA System/Matrix Cycle Manager/Vehicle Emulator Matrix Cycle/vehicle emulator basic cycle 1/COMM Task - Sensor_Values/Transmission subtasks/Check msg transmission CAN1" /begin REF_CHARACTERISTIC COMM_Phase1 COMM_Phase_init1 /end REF_CHARACTERISTIC /end GROUP
/begin GROUP S1378_Check_msg_transmission_CAN2 "HANcoder_E407_TTA_Group2/HANcoder STM32 Target - E407-STM32 algorithm/TTA CAN System/TTA System/Matrix Cycle Manager/Vehicle Emulator Matrix Cycle/vehicle emulator basic cycle 1/COMM Task - Sensor_Values/Transmission subtasks/Check msg transmission CAN2" /begin REF_CHARACTERISTIC COMM_Phase2 COMM_Phase_init2 /end REF_CHARACTERISTIC /end GROUP
/begin GROUP S1408_Check_msg_transmission_CAN1 "HANcoder_E407_TTA_Group2/HANcoder STM32 Target - E407-STM32 algorithm/TTA CAN System/TTA System/Matrix Cycle Manager/Vehicle Emulator Matrix Cycle/vehicle emulator basic cycle 1/COMM Task - Sync bc 1/Transmission subtasks/Check msg transmission CAN1" /begin REF_CHARACTERISTIC COMM_Phase1 COMM_Phase_init1 /end REF_CHARACTERISTIC /end GROUP
/begin GROUP S1408_Check_msg_transmission_CAN2 "HANcoder_E407_TTA_Group2/HANcoder STM32 Target - E407-STM32 algorithm/TTA CAN System/TTA System/Matrix Cycle Manager/Vehicle Emulator Matrix Cycle/vehicle emulator basic cycle 1/COMM Task - Sync bc 1/Transmission subtasks/Check msg transmission CAN2" /begin REF_CHARACTERISTIC COMM_Phase2 COMM_Phase_init2 /end REF_CHARACTERISTIC /end GROUP
/begin GROUP S1479_Desync_calculation "HANcoder_E407_TTA_Group2/HANcoder STM32 Target - E407-STM32 algorithm/TTA CAN System/TTA System/Matrix Cycle Manager/Vehicle Emulator Matrix Cycle/vehicle emulator basic cycle 1/COMP Task - Sync bc1 check/Process_Messages/Desync calculation" /begin REF_CHARACTERISTIC COMM_Phase1 COMM_Phase2 /end REF_CHARACTERISTIC /begin REF_MEASUREMENT Desync_Sync_bc1_vem_s /end REF_MEASUREMENT /end GROUP
/begin GROUP S294_Votes_recount_to_choose_Master "HANcoder_E407_TTA_Group2/HANcoder STM32 Target - E407-STM32 algorithm/TTA CAN System/TTA System/Matrix Cycle Manager/Controller Matrix Cycle/controller basic cycle 0/COMP Task - New Master/Decision Voter and Membership/Decision Voter/Votes recount to choose Master" /begin REF_MEASUREMENT Vote1_s Vote2_s Vote3_s Vote4_s /end REF_MEASUREMENT /end GROUP
/begin GROUP S295_Bit_Shift11 "HANcoder_E407_TTA_Group2/HANcoder STM32 Target - E407-STM32 algorithm/TTA CAN System/TTA System/Matrix Cycle Manager/Controller Matrix Cycle/controller basic cycle 0/COMP Task - New Master/Decision Voter and Membership/Decode Error 1/Bit Shift11" /begin REF_MEASUREMENT TMR_miss_set /end REF_MEASUREMENT /end GROUP
/begin GROUP S295_Bit_Shift12 "HANcoder_E407_TTA_Group2/HANcoder STM32 Target - E407-STM32 algorithm/TTA CAN System/TTA System/Matrix Cycle Manager/Controller Matrix Cycle/controller basic cycle 0/COMP Task - New Master/Decision Voter and Membership/Decode Error 1/Bit Shift12" /begin REF_MEASUREMENT TMR_miss_sensor /end REF_MEASUREMENT /end GROUP
/begin GROUP S295_Bit_Shift14 "HANcoder_E407_TTA_Group2/HANcoder STM32 Target - E407-STM32 algorithm/TTA CAN System/TTA System/Matrix Cycle Manager/Controller Matrix Cycle/controller basic cycle 0/COMP Task - New Master/Decision Voter and Membership/Decode Error 1/Bit Shift14" /begin REF_MEASUREMENT tau_fr_disagree_s /end REF_MEASUREMENT /end GROUP
/begin GROUP S295_Bit_Shift7 "HANcoder_E407_TTA_Group2/HANcoder STM32 Target - E407-STM32 algorithm/TTA CAN System/TTA System/Matrix Cycle Manager/Controller Matrix Cycle/controller basic cycle 0/COMP Task - New Master/Decision Voter and Membership/Decode Error 1/Bit Shift7" /begin REF_MEASUREMENT tau_fl_disagree_s /end REF_MEASUREMENT /end GROUP
/begin GROUP S295_Bit_Shift8 "HANcoder_E407_TTA_Group2/HANcoder STM32 Target - E407-STM32 algorithm/TTA CAN System/TTA System/Matrix Cycle Manager/Controller Matrix Cycle/controller basic cycle 0/COMP Task - New Master/Decision Voter and Membership/Decode Error 1/Bit Shift8" /begin REF_MEASUREMENT tau_ar_disagree_s /end REF_MEASUREMENT /end GROUP
/begin GROUP S295_Bit_Shift9 "HANcoder_E407_TTA_Group2/HANcoder STM32 Target - E407-STM32 algorithm/TTA CAN System/TTA System/Matrix Cycle Manager/Controller Matrix Cycle/controller basic cycle 0/COMP Task - New Master/Decision Voter and Membership/Decode Error 1/Bit Shift9" /begin REF_MEASUREMENT tau_al_disagree_s /end REF_MEASUREMENT /end GROUP
/begin GROUP S296_Bit_Shift10 "HANcoder_E407_TTA_Group2/HANcoder STM32 Target - E407-STM32 algorithm/TTA CAN System/TTA System/Matrix Cycle Manager/Controller Matrix Cycle/controller basic cycle 0/COMP Task - New Master/Decision Voter and Membership/Decode Error 2/Bit Shift10" /begin REF_MEASUREMENT TMR_miss_out1 /end REF_MEASUREMENT /end GROUP
/begin GROUP S296_Bit_Shift11 "HANcoder_E407_TTA_Group2/HANcoder STM32 Target - E407-STM32 algorithm/TTA CAN System/TTA System/Matrix Cycle Manager/Controller Matrix Cycle/controller basic cycle 0/COMP Task - New Master/Decision Voter and Membership/Decode Error 2/Bit Shift11" /begin REF_MEASUREMENT TMR_miss1_set /end REF_MEASUREMENT /end GROUP
/begin GROUP S296_Bit_Shift12 "HANcoder_E407_TTA_Group2/HANcoder STM32 Target - E407-STM32 algorithm/TTA CAN System/TTA System/Matrix Cycle Manager/Controller Matrix Cycle/controller basic cycle 0/COMP Task - New Master/Decision Voter and Membership/Decode Error 2/Bit Shift12" /begin REF_MEASUREMENT TMR_miss1_sensor /end REF_MEASUREMENT /end GROUP
/begin GROUP S296_Bit_Shift14 "HANcoder_E407_TTA_Group2/HANcoder STM32 Target - E407-STM32 algorithm/TTA CAN System/TTA System/Matrix Cycle Manager/Controller Matrix Cycle/controller basic cycle 0/COMP Task - New Master/Decision Voter and Membership/Decode Error 2/Bit Shift14" /begin REF_MEASUREMENT tau_fr1_disagree_s /end REF_MEASUREMENT /end GROUP
/begin GROUP S296_Bit_Shift7 "HANcoder_E407_TTA_Group2/HANcoder STM32 Target - E407-STM32 algorithm/TTA CAN System/TTA System/Matrix Cycle Manager/Controller Matrix Cycle/controller basic cycle 0/COMP Task - New Master/Decision Voter and Membership/Decode Error 2/Bit Shift7" /begin REF_MEASUREMENT tau_fl1_disagree_s /end REF_MEASUREMENT /end GROUP
/begin GROUP S296_Bit_Shift8 "HANcoder_E407_TTA_Group2/HANcoder STM32 Target - E407-STM32 algorithm/TTA CAN System/TTA System/Matrix Cycle Manager/Controller Matrix Cycle/controller basic cycle 0/COMP Task - New Master/Decision Voter and Membership/Decode Error 2/Bit Shift8" /begin REF_MEASUREMENT tau_ar1_disagree_s /end REF_MEASUREMENT /end GROUP
/begin GROUP S296_Bit_Shift9 "HANcoder_E407_TTA_Group2/HANcoder STM32 Target - E407-STM32 algorithm/TTA CAN System/TTA System/Matrix Cycle Manager/Controller Matrix Cycle/controller basic cycle 0/COMP Task - New Master/Decision Voter and Membership/Decode Error 2/Bit Shift9" /begin REF_MEASUREMENT tau_al1_disagree_s /end REF_MEASUREMENT /end GROUP
/begin GROUP S297_Bit_Shift10 "HANcoder_E407_TTA_Group2/HANcoder STM32 Target - E407-STM32 algorithm/TTA CAN System/TTA System/Matrix Cycle Manager/Controller Matrix Cycle/controller basic cycle 0/COMP Task - New Master/Decision Voter and Membership/Decode Error 3/Bit Shift10" /begin REF_MEASUREMENT TMR_miss_out2 /end REF_MEASUREMENT /end GROUP
/begin GROUP S297_Bit_Shift11 "HANcoder_E407_TTA_Group2/HANcoder STM32 Target - E407-STM32 algorithm/TTA CAN System/TTA System/Matrix Cycle Manager/Controller Matrix Cycle/controller basic cycle 0/COMP Task - New Master/Decision Voter and Membership/Decode Error 3/Bit Shift11" /begin REF_MEASUREMENT TMR_miss2_set /end REF_MEASUREMENT /end GROUP
/begin GROUP S297_Bit_Shift12 "HANcoder_E407_TTA_Group2/HANcoder STM32 Target - E407-STM32 algorithm/TTA CAN System/TTA System/Matrix Cycle Manager/Controller Matrix Cycle/controller basic cycle 0/COMP Task - New Master/Decision Voter and Membership/Decode Error 3/Bit Shift12" /begin REF_MEASUREMENT TMR_miss2_sensor /end REF_MEASUREMENT /end GROUP
/begin GROUP S297_Bit_Shift14 "HANcoder_E407_TTA_Group2/HANcoder STM32 Target - E407-STM32 algorithm/TTA CAN System/TTA System/Matrix Cycle Manager/Controller Matrix Cycle/controller basic cycle 0/COMP Task - New Master/Decision Voter and Membership/Decode Error 3/Bit Shift14" /begin REF_MEASUREMENT tau_fr2_disagree_s /end REF_MEASUREMENT /end GROUP
/begin GROUP S297_Bit_Shift7 "HANcoder_E407_TTA_Group2/HANcoder STM32 Target - E407-STM32 algorithm/TTA CAN System/TTA System/Matrix Cycle Manager/Controller Matrix Cycle/controller basic cycle 0/COMP Task - New Master/Decision Voter and Membership/Decode Error 3/Bit Shift7" /begin REF_MEASUREMENT tau_fl2_disagree_s /end REF_MEASUREMENT /end GROUP
/begin GROUP S297_Bit_Shift8 "HANcoder_E407_TTA_Group2/HANcoder STM32 Target - E407-STM32 algorithm/TTA CAN System/TTA System/Matrix Cycle Manager/Controller Matrix Cycle/controller basic cycle 0/COMP Task - New Master/Decision Voter and Membership/Decode Error 3/Bit Shift8" /begin REF_MEASUREMENT tau_ar2_disagree_s /end REF_MEASUREMENT /end GROUP
/begin GROUP S297_Bit_Shift9 "HANcoder_E407_TTA_Group2/HANcoder STM32 Target - E407-STM32 algorithm/TTA CAN System/TTA System/Matrix Cycle Manager/Controller Matrix Cycle/controller basic cycle 0/COMP Task - New Master/Decision Voter and Membership/Decode Error 3/Bit Shift9" /begin REF_MEASUREMENT tau_al2_disagree_s /end REF_MEASUREMENT /end GROUP
/begin GROUP S921_Inputs_Rx_OK "HANcoder_E407_TTA_Group2/HANcoder STM32 Target - E407-STM32 algorithm/TTA CAN System/TTA System/Matrix Cycle Manager/Controller Matrix Cycle/controller basic cycle 1/COMP Task - Rx_Sensor_Values_Check/Update Msg buffer/Sensor Values Rx Update/Inputs Rx OK" /begin REF_MEASUREMENT rx_data_incr_time_s /end REF_MEASUREMENT /end GROUP
/end MODULE
/end PROJECT
/* (add any file trailer comments here) */
/* EOF HANcoder_E407_TTA_Group2.a2l */
